## CMakeLists.txt
```
# (C) Copyright 2024, SECO Mind Srl
#
# SPDX-License-Identifier: Apache-2.0

cmake_minimum_required(VERSION 3.20.0)
find_package(Zephyr REQUIRED HINTS $ENV{ZEPHYR_BASE})
project(astarte_device_sdk_integration_backoff)

target_include_directories(app PRIVATE
    ${ZEPHYR_BASE}/../astarte-device-sdk-zephyr/lib/astarte_device_sdk/include
)

FILE(GLOB app_sources src/*.c)
target_sources(app PRIVATE ${app_sources})
```

## prj.conf
```kconfig
# (C) Copyright 2024, SECO Mind Srl
#
# SPDX-License-Identifier: Apache-2.0

CONFIG_ZTEST=y
CONFIG_ENTROPY_GENERATOR=y
CONFIG_TEST_RANDOM_GENERATOR=y
CONFIG_LOG=y
CONFIG_TEST_LOGGING_DEFAULTS=n

# Base MbedTLS & heap configuration
CONFIG_MBEDTLS=y
CONFIG_MBEDTLS_BUILTIN=y
CONFIG_MBEDTLS_ENABLE_HEAP=y
CONFIG_MBEDTLS_HEAP_SIZE=55000

# Enable PSA Crypto Backend
CONFIG_PSA_CRYPTO=y
CONFIG_PSA_CRYPTO_ENABLE_ALL=y
CONFIG_MBEDTLS_PSA_CRYPTO_C=y

# TLS & X.509
CONFIG_MBEDTLS_SSL_MAX_CONTENT_LEN=8192
CONFIG_MBEDTLS_PEM_PARSE_C=y
CONFIG_MBEDTLS_PEM_WRITE_C=y
CONFIG_MBEDTLS_BASE64_C=y
CONFIG_MBEDTLS_PK_WRITE_C=y
CONFIG_MBEDTLS_SSL_PROTO_TLS1_2=y
CONFIG_MBEDTLS_SSL_SERVER_NAME_INDICATION=y
CONFIG_MBEDTLS_X509_USE_C=y
CONFIG_MBEDTLS_X509_CRT_PARSE_C=y
CONFIG_MBEDTLS_X509_CRL_PARSE_C=y
CONFIG_MBEDTLS_X509_CSR_PARSE_C=y
CONFIG_MBEDTLS_X509_CSR_WRITE_C=y
CONFIG_MBEDTLS_PKCS5_C=y
CONFIG_MBEDTLS_KEY_EXCHANGE_ECDHE_ECDSA_ENABLED=y
CONFIG_MBEDTLS_KEY_EXCHANGE_ECDHE_RSA_ENABLED=y

# Astarte device SDK
CONFIG_ASTARTE_DEVICE_SDK=y
CONFIG_ASTARTE_DEVICE_SDK_HOSTNAME="."
CONFIG_ASTARTE_DEVICE_SDK_HTTPS_CA_CERT_TAG=1
CONFIG_ASTARTE_DEVICE_SDK_MQTTS_CA_CERT_TAG=1
CONFIG_ASTARTE_DEVICE_SDK_CLIENT_CERT_TAG=2
CONFIG_ASTARTE_DEVICE_SDK_PAIRING_JWT=""
CONFIG_ASTARTE_DEVICE_SDK_REALM_NAME="."

# Use picolib
CONFIG_PICOLIBC_USE_MODULE=y
CONFIG_PICOLIBC=y

# Enable networking
CONFIG_NETWORKING=y

# Enable HTTP client
CONFIG_HTTP_CLIENT=y

# MQTT options
CONFIG_MQTT_LIB=y
CONFIG_MQTT_LIB_TLS=y
CONFIG_MQTT_KEEPALIVE=60

# Enable base64 encoding and decoding
CONFIG_BASE64=y

# Enable system hashmaps
CONFIG_SYS_HASH_MAP=y

# Enable JSON library
CONFIG_JSON_LIBRARY=y

# Enable entropy generator
CONFIG_ENTROPY_GENERATOR=y

# DNS resolver
CONFIG_DNS_RESOLVER=y

# Enable UUID
CONFIG_UUID=y
CONFIG_UUID_V4=y
CONFIG_UUID_V5=y
CONFIG_UUID_BASE64=y

# Enable scoped cleanup helpers
CONFIG_SCOPE_CLEANUP_HELPERS=y

# Enable events
CONFIG_EVENTS=y
```

## src/main.c
```c
/*
 * (C) Copyright 2025, SECO Mind Srl
 *
 * SPDX-License-Identifier: Apache-2.0
 */

#include <zephyr/ztest.h>

#include "backoff.h"

#include <errno.h>

#define MS_IN_MINUTE (60U * 1000U)
#define MS_IN_HOUR (60U * MS_IN_MINUTE)
#define MS_IN_DAY (24U * MS_IN_HOUR)

ZTEST_SUITE(astarte_device_sdk_backoff, NULL, NULL, NULL, NULL, NULL);

ZTEST(astarte_device_sdk_backoff, test_incorrect_inputs)
{
    struct backoff_context backoff;

    // cutoff_coeff < mul_coeff
    zassert_equal(-EINVAL, backoff_init(&backoff, 2 * MS_IN_MINUTE, 1 * MS_IN_MINUTE),
        "backoff_init should fail when cutoff_coeff < mul_coeff");

    // mul_coeff == 0
    zassert_equal(-EINVAL, backoff_init(&backoff, 0, 1 * MS_IN_MINUTE),
        "backoff_init should fail when mul_coeff is 0");

    // cutoff_coeff == 0
    zassert_equal(-EINVAL, backoff_init(&backoff, 1 * MS_IN_MINUTE, 0),
        "backoff_init should fail when cutoff_coeff is 0");

    // NULL context
    zassert_equal(-EINVAL, backoff_init(NULL, 1 * MS_IN_MINUTE, 2 * MS_IN_MINUTE),
        "backoff_init should fail when context is NULL");
}

ZTEST(astarte_device_sdk_backoff, test_ordinary_backoff)
{
    struct backoff_context backoff;
    int err = backoff_init(&backoff, 1 * MS_IN_MINUTE, 18 * MS_IN_MINUTE);
    zassert_equal(0, err, "backoff_init returned an error");

    uint32_t delay;

    delay = backoff_get_next_delay(&backoff);
    zassert_true(delay >= 0 && delay <= 2 * MS_IN_MINUTE, "Delay out of bounds");

    delay = backoff_get_next_delay(&backoff);
    zassert_true(delay >= 1 * MS_IN_MINUTE && delay <= 3 * MS_IN_MINUTE, "Delay out of bounds");

    delay = backoff_get_next_delay(&backoff);
    zassert_true(delay >= 3 * MS_IN_MINUTE && delay <= 5 * MS_IN_MINUTE, "Delay out of bounds");

    delay = backoff_get_next_delay(&backoff);
    zassert_true(delay >= 7 * MS_IN_MINUTE && delay <= 9 * MS_IN_MINUTE, "Delay out of bounds");

    delay = backoff_get_next_delay(&backoff);
    zassert_true(delay >= 15 * MS_IN_MINUTE && delay <= 17 * MS_IN_MINUTE, "Delay out of bounds");

    for (size_t i = 0; i < 1048576u; i++) {
        delay = backoff_get_next_delay(&backoff);
        zassert_true(delay >= 17 * MS_IN_MINUTE && delay <= 19 * MS_IN_MINUTE,
            "Delay out of bounds in loop");
    }
}

ZTEST(astarte_device_sdk_backoff, test_very_large_backoff)
{
    struct backoff_context backoff;
    int err = backoff_init(&backoff, 1 * MS_IN_HOUR, 40 * MS_IN_DAY);
    zassert_equal(0, err, "backoff_init returned an error");

    uint32_t delay;

    delay = backoff_get_next_delay(&backoff);
    zassert_true(delay >= 0 && delay <= 2 * MS_IN_HOUR, "Delay out of bounds");

    delay = backoff_get_next_delay(&backoff);
    zassert_true(delay >= 1 * MS_IN_HOUR && delay <= 3 * MS_IN_HOUR, "Delay out of bounds");

    delay = backoff_get_next_delay(&backoff);
    zassert_true(delay >= 3 * MS_IN_HOUR && delay <= 5 * MS_IN_HOUR, "Delay out of bounds");

    delay = backoff_get_next_delay(&backoff);
    zassert_true(delay >= 7 * MS_IN_HOUR && delay <= 9 * MS_IN_HOUR, "Delay out of bounds");

    // A lot of calls in between
    for (size_t i = 0; i < 1000000u; i++) {
        backoff_get_next_delay(&backoff);
    }

    // Check it settled around the proper value (40 days +/- 1 hour of jitter)
    uint32_t lower_bound = 40 * MS_IN_DAY - 1 * MS_IN_HOUR;
    uint32_t upper_bound = 40 * MS_IN_DAY + 1 * MS_IN_HOUR;
    for (size_t i = 0; i < 100u; i++) {
        delay = backoff_get_next_delay(&backoff);
        zassert_true(
            delay >= lower_bound && delay <= upper_bound, "Delay out of bounds after settling");
    }
}
```

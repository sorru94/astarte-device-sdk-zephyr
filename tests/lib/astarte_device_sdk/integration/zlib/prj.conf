## CMakeLists.txt
```
# (C) Copyright 2024, SECO Mind Srl
#
# SPDX-License-Identifier: Apache-2.0

cmake_minimum_required(VERSION 3.20.0)
find_package(Zephyr REQUIRED HINTS $ENV{ZEPHYR_BASE})
project(astarte_device_sdk_integration_introspection)

target_include_directories(app PRIVATE
    ${ZEPHYR_BASE}/../astarte-device-sdk-zephyr/lib/astarte_device_sdk/include
)

FILE(GLOB app_sources src/*.c)
target_sources(app PRIVATE ${app_sources})
```

## prj.conf
```kconfig
# (C) Copyright 2024, SECO Mind Srl
#
# SPDX-License-Identifier: Apache-2.0

CONFIG_ZTEST=y
CONFIG_ENTROPY_GENERATOR=y
CONFIG_TEST_RANDOM_GENERATOR=y
CONFIG_TEST_LOGGING_DEFAULTS=y

CONFIG_LOG=y

# Use custom heap
CONFIG_ASTARTE_DEVICE_SDK_ENABLE_HEAP=y

# Base MbedTLS & heap configuration
CONFIG_MBEDTLS=y
CONFIG_MBEDTLS_BUILTIN=y
CONFIG_MBEDTLS_ENABLE_HEAP=y
CONFIG_MBEDTLS_HEAP_SIZE=55000

# Enable PSA Crypto Backend
CONFIG_PSA_CRYPTO=y
CONFIG_PSA_CRYPTO_ENABLE_ALL=y
CONFIG_MBEDTLS_PSA_CRYPTO_C=y

# TLS & X.509
CONFIG_MBEDTLS_SSL_MAX_CONTENT_LEN=8192
CONFIG_MBEDTLS_PEM_PARSE_C=y
CONFIG_MBEDTLS_PEM_WRITE_C=y
CONFIG_MBEDTLS_BASE64_C=y
CONFIG_MBEDTLS_PK_WRITE_C=y
CONFIG_MBEDTLS_SSL_PROTO_TLS1_2=y
CONFIG_MBEDTLS_SSL_SERVER_NAME_INDICATION=y
CONFIG_MBEDTLS_X509_USE_C=y
CONFIG_MBEDTLS_X509_CRT_PARSE_C=y
CONFIG_MBEDTLS_X509_CRL_PARSE_C=y
CONFIG_MBEDTLS_X509_CSR_PARSE_C=y
CONFIG_MBEDTLS_X509_CSR_WRITE_C=y
CONFIG_MBEDTLS_PKCS5_C=y
CONFIG_MBEDTLS_KEY_EXCHANGE_ECDHE_ECDSA_ENABLED=y
CONFIG_MBEDTLS_KEY_EXCHANGE_ECDHE_RSA_ENABLED=y

# Astarte device SDK
CONFIG_ASTARTE_DEVICE_SDK=y
CONFIG_ASTARTE_DEVICE_SDK_HOSTNAME="."
CONFIG_ASTARTE_DEVICE_SDK_HTTPS_CA_CERT_TAG=1
CONFIG_ASTARTE_DEVICE_SDK_MQTTS_CA_CERT_TAG=1
CONFIG_ASTARTE_DEVICE_SDK_CLIENT_CERT_TAG=2
CONFIG_ASTARTE_DEVICE_SDK_PAIRING_JWT=""
CONFIG_ASTARTE_DEVICE_SDK_REALM_NAME="."

# Use picolib
CONFIG_PICOLIBC_USE_MODULE=y
CONFIG_PICOLIBC=y

# Enable networking
CONFIG_NETWORKING=y

# Enable HTTP client
CONFIG_HTTP_CLIENT=y

# MQTT options
CONFIG_MQTT_LIB=y
CONFIG_MQTT_LIB_TLS=y
CONFIG_MQTT_KEEPALIVE=60

# Enable base64 encoding and decoding
CONFIG_BASE64=y

# Enable system hashmaps
CONFIG_SYS_HASH_MAP=y

# Enable JSON library
CONFIG_JSON_LIBRARY=y

# Enable entropy generator
CONFIG_ENTROPY_GENERATOR=y

# DNS resolver
CONFIG_DNS_RESOLVER=y

# Enable UUID
CONFIG_UUID=y
CONFIG_UUID_V4=y
CONFIG_UUID_V5=y
CONFIG_UUID_BASE64=y

# Enable scoped cleanup helpers
CONFIG_SCOPE_CLEANUP_HELPERS=y

# Enable events
CONFIG_EVENTS=y
```

## src/zlib_test.c
```c
/*
 * (C) Copyright 2024, SECO Mind Srl
 *
 * SPDX-License-Identifier: Apache-2.0
 */

#include <string.h>
#include <zephyr/logging/log.h>
#include <zephyr/ztest.h>

#include "astarte_device_sdk/result.h"

#include <astarte_zlib.h>

LOG_MODULE_REGISTER(zlib_test, CONFIG_LOG_DEFAULT_LEVEL); // NOLINT

ZTEST_SUITE(astarte_device_sdk_zlib, NULL, NULL, NULL, NULL, NULL); // NOLINT

#define EXP_EMPTY_COMPRESSED_BOUND 13
#define EXP_EMPTY_COMPRESSED_LEN 8

ZTEST(astarte_device_sdk_zlib, test_zlib_compress_empty) // NOLINT
{
    char input_text[] = "";
    size_t input_text_len = ARRAY_SIZE(input_text) - 1;

    uLongf compressed_len = compressBound(input_text_len);
    zassert_equal(compressed_len, EXP_EMPTY_COMPRESSED_BOUND,
        "compressBound unexpected result: %zu", compressed_len);

    uint8_t compressed[EXP_EMPTY_COMPRESSED_BOUND] = { 0 };
    int res = astarte_zlib_compress(compressed, &compressed_len, input_text, input_text_len);
    zassert_equal(res, Z_OK, "compress unexpected result: %d", res);
    zassert_equal(compressed_len, EXP_EMPTY_COMPRESSED_LEN,
        "astarte_zlib_compress unexpected result: %zu", compressed_len);
    uint8_t exp_compressed[EXP_EMPTY_COMPRESSED_LEN] = { 0x18, 0x95, 0x3, 0x0, 0x0, 0x0, 0x0, 0x1 };

    zassert_mem_equal(compressed, exp_compressed, EXP_EMPTY_COMPRESSED_LEN,
        "0x%x, 0x%x, 0x%x, 0x%x, 0x%x, 0x%x, 0x%x, 0x%x", compressed[0], compressed[1],
        compressed[2], compressed[3], compressed[4], compressed[5], compressed[6], compressed[7]);

    char output_text[ARRAY_SIZE(input_text)] = { 0 };
    uLongf output_text_len = ARRAY_SIZE(output_text);
    res = astarte_zlib_uncompress(output_text, &output_text_len, exp_compressed, compressed_len);
    zassert_equal(res, Z_OK, "compress unexpected result: %d", res);
    zassert_mem_equal(output_text, input_text, ARRAY_SIZE(input_text),
        "Incorrectly decompressed data '%s'", output_text);
}

#define EXP_COMPRESSED_BOUND 23
#define EXP_COMPRESSED_LEN 18

ZTEST(astarte_device_sdk_zlib, test_zlib_compress) // NOLINT
{
    char input_text[] = "HelloWorld";
    size_t input_text_len = ARRAY_SIZE(input_text) - 1;

    uLongf compressed_len = compressBound(input_text_len);
    zassert_equal(compressed_len, EXP_COMPRESSED_BOUND, "compressBound unexpected result: %zu",
        compressed_len);

    uint8_t compressed[EXP_COMPRESSED_BOUND] = { 0 };
    int res = astarte_zlib_compress(compressed, &compressed_len, input_text, input_text_len);
    zassert_equal(res, Z_OK, "compress unexpected result: %d", res);
    zassert_equal(compressed_len, EXP_COMPRESSED_LEN,
        "astarte_zlib_compress unexpected result: %zu", compressed_len);
    uint8_t exp_compressed[EXP_COMPRESSED_LEN] = { 0x18, 0x95, 0xf3, 0x48, 0xcd, 0xc9, 0xc9, 0xf,
        0xcf, 0x2f, 0xca, 0x49, 0x1, 0x0, 0x15, 0x56, 0x3, 0xfd };

    zassert_mem_equal(compressed, exp_compressed, EXP_COMPRESSED_LEN,
        "0x%x, 0x%x, 0x%x, 0x%x, 0x%x, 0x%x, 0x%x, 0x%x, 0x%x, 0x%x, 0x%x, 0x%x, "
        "0x%x, 0x%x, 0x%x, 0x%x, 0x%x, 0x%x",
        compressed[0], compressed[1], compressed[2], compressed[3], compressed[4], compressed[5],
        compressed[6], compressed[7], compressed[8], compressed[9], compressed[10], compressed[11],
        compressed[12], compressed[13], compressed[14], compressed[15], compressed[16],
        compressed[17]);

    char output_text[ARRAY_SIZE(input_text)] = { 0 };
    uLongf output_text_len = ARRAY_SIZE(output_text);
    res = astarte_zlib_uncompress(output_text, &output_text_len, exp_compressed, compressed_len);
    zassert_equal(res, Z_OK, "compress unexpected result: %d", res);
    zassert_mem_equal(output_text, input_text, ARRAY_SIZE(input_text),
        "Incorrectly decompressed data '%s'", output_text);
}
```

## prj.conf
```kconfig
# (C) Copyright 2024, SECO Mind Srl
#
# SPDX-License-Identifier: Apache-2.0

CONFIG_ZTEST=y

CONFIG_ENTROPY_GENERATOR=y
CONFIG_TEST_RANDOM_GENERATOR=y
CONFIG_TEST_LOGGING_DEFAULTS=y

CONFIG_LOG=y

CONFIG_HEAP_MEM_POOL_SIZE=16384

# Base MbedTLS & heap configuration
CONFIG_MBEDTLS=y
CONFIG_MBEDTLS_BUILTIN=y
CONFIG_MBEDTLS_ENABLE_HEAP=y
CONFIG_MBEDTLS_HEAP_SIZE=55000

# Enable PSA Crypto Backend
CONFIG_PSA_CRYPTO=y
CONFIG_PSA_CRYPTO_ENABLE_ALL=y
CONFIG_MBEDTLS_PSA_CRYPTO_C=y

# TLS & X.509
CONFIG_MBEDTLS_SSL_MAX_CONTENT_LEN=8192
CONFIG_MBEDTLS_PEM_PARSE_C=y
CONFIG_MBEDTLS_PEM_WRITE_C=y
CONFIG_MBEDTLS_BASE64_C=y
CONFIG_MBEDTLS_PK_WRITE_C=y
CONFIG_MBEDTLS_SSL_PROTO_TLS1_2=y
CONFIG_MBEDTLS_SSL_SERVER_NAME_INDICATION=y
CONFIG_MBEDTLS_X509_USE_C=y
CONFIG_MBEDTLS_X509_CRT_PARSE_C=y
CONFIG_MBEDTLS_X509_CRL_PARSE_C=y
CONFIG_MBEDTLS_X509_CSR_PARSE_C=y
CONFIG_MBEDTLS_X509_CSR_WRITE_C=y
CONFIG_MBEDTLS_PKCS5_C=y
CONFIG_MBEDTLS_KEY_EXCHANGE_ECDHE_ECDSA_ENABLED=y
CONFIG_MBEDTLS_KEY_EXCHANGE_ECDHE_RSA_ENABLED=y

# Astarte device SDK
CONFIG_ASTARTE_DEVICE_SDK=y
CONFIG_ASTARTE_DEVICE_SDK_HOSTNAME="."
CONFIG_ASTARTE_DEVICE_SDK_HTTPS_CA_CERT_TAG=1
CONFIG_ASTARTE_DEVICE_SDK_MQTTS_CA_CERT_TAG=1
CONFIG_ASTARTE_DEVICE_SDK_CLIENT_CERT_TAG=2
CONFIG_ASTARTE_DEVICE_SDK_PAIRING_JWT=""
CONFIG_ASTARTE_DEVICE_SDK_REALM_NAME="."

# Use picolib
CONFIG_PICOLIBC_USE_MODULE=y
CONFIG_PICOLIBC=y

# Enable networking
CONFIG_NETWORKING=y

# Enable HTTP client
CONFIG_HTTP_CLIENT=y

# MQTT options
CONFIG_MQTT_LIB=y
CONFIG_MQTT_LIB_TLS=y
CONFIG_MQTT_KEEPALIVE=60

# Enable base64 encoding and decoding
CONFIG_BASE64=y

# Enable system hashmaps
CONFIG_SYS_HASH_MAP=y

# Enable JSON library
CONFIG_JSON_LIBRARY=y

# Enable entropy generator
CONFIG_ENTROPY_GENERATOR=y

# DNS resolver
CONFIG_DNS_RESOLVER=y

# Enable UUID
CONFIG_UUID=y
CONFIG_UUID_V4=y
CONFIG_UUID_V5=y
CONFIG_UUID_BASE64=y

# Enable scoped cleanup helpers
CONFIG_SCOPE_CLEANUP_HELPERS=y

# Enable events
CONFIG_EVENTS=y
```

## src/introspection_test.c
```c
/*
 * (C) Copyright 2024, SECO Mind Srl
 *
 * SPDX-License-Identifier: Apache-2.0
 */

#include <stdlib.h>

#include <string.h>
#include <zephyr/logging/log.h>
#include <zephyr/ztest.h>

#include "astarte_device_sdk/interface.h"
#include "astarte_device_sdk/result.h"

#include "alloc.h"
#include "introspection.h"

LOG_MODULE_REGISTER(introspection_test, CONFIG_LOG_DEFAULT_LEVEL); // NOLINT

ZTEST_SUITE(astarte_device_sdk_introspection, NULL, NULL, NULL, NULL, NULL); // NOLINT

const static astarte_interface_t test_interface_a = {
    .name = "test.interface.a",
    .major_version = 0,
    .minor_version = 1,
    .ownership = ASTARTE_INTERFACE_OWNERSHIP_SERVER,
    .type = ASTARTE_INTERFACE_TYPE_PROPERTIES,
    .aggregation = ASTARTE_INTERFACE_AGGREGATION_INDIVIDUAL,
};

const static astarte_interface_t test_interface_b = {
    .name = "test.interface.b",
    .major_version = 0,
    .minor_version = 1,
    .ownership = ASTARTE_INTERFACE_OWNERSHIP_DEVICE,
    .type = ASTARTE_INTERFACE_TYPE_DATASTREAM,
    .aggregation = ASTARTE_INTERFACE_AGGREGATION_INDIVIDUAL,
};

const static astarte_interface_t test_interface_c = {
    .name = "test.interface.c",
    .major_version = 1,
    .minor_version = 0,
    .ownership = ASTARTE_INTERFACE_OWNERSHIP_SERVER,
    .type = ASTARTE_INTERFACE_TYPE_DATASTREAM,
    .aggregation = ASTARTE_INTERFACE_AGGREGATION_INDIVIDUAL,
};

static char *get_introspection_string(introspection_t *introspection)
{
    size_t introspection_buf_len = introspection_get_string_size(introspection);
    char *introspection_buf = astarte_calloc(introspection_buf_len, sizeof(char));
    introspection_fill_string(introspection, introspection_buf, introspection_buf_len);
    return introspection_buf;
}

static void check_add_interface(introspection_t *introspection,
    const astarte_interface_t *interface, astarte_result_t expected_res)
{
    LOG_INF("Adding interface '%s'", interface->name); // NOLINT

    zassert_equal(expected_res, introspection_add(introspection, interface),
        "Unexpected result while inserting interface '%s'", interface->name);
}

static void check_add_interface_ok(
    introspection_t *introspection, const astarte_interface_t *interface)
{
    check_add_interface(introspection, interface, ASTARTE_RESULT_OK);
}

// since ordering of the interfaces is not guardanteed we first compare the length
static void check_introspection(char *expected, char *got)
{
    size_t expected_len = strnlen(expected, ASTARTE_INTERFACE_NAME_MAX_SIZE);
    size_t got_len = strnlen(got, ASTARTE_INTERFACE_NAME_MAX_SIZE);

    zassert_equal(got_len, expected_len,
        "The introspection len does not match the expected one\nExpected: %s\nGot: %s",
        expected_len, got_len);
}

const static char expected_introspection_all[]
    = "test.interface.a:0:1;test.interface.b:0:1;test.interface.c:1:0";

ZTEST(astarte_device_sdk_introspection, test_introspection_add) // NOLINT
{
    LOG_INF("Creating introspection"); // NOLINT
    introspection_t introspection;
    introspection_init(&introspection);

    LOG_INF("Adding interfaces"); // NOLINT
    check_add_interface_ok(&introspection, &test_interface_a);
    check_add_interface_ok(&introspection, &test_interface_b);
    check_add_interface_ok(&introspection, &test_interface_c);

    char *introspection_buf = get_introspection_string(&introspection);
    LOG_INF("Introspection string '%s'", introspection_buf); // NOLINT

    check_introspection((char *) expected_introspection_all, introspection_buf);

    zassert_equal_ptr(
        &test_interface_a, introspection_get(&introspection, (char *) test_interface_a.name));
    zassert_equal_ptr(
        &test_interface_b, introspection_get(&introspection, (char *) test_interface_b.name));
    zassert_equal_ptr(
        &test_interface_c, introspection_get(&introspection, (char *) test_interface_c.name));

    LOG_INF("Freeing introspection"); // NOLINT
    introspection_free(introspection);
}

const static char expected_introspection_ab[] = "test.interface.a:0:1;test.interface.b:0:1";

static void check_remove_interface(
    introspection_t *introspection, char *interface_name, astarte_result_t expected_res)
{
    LOG_INF("Removing interface '%s'", interface_name); // NOLINT

    zassert_equal(expected_res, introspection_remove(introspection, interface_name),
        "Unexpected result while removing interface '%s'", interface_name);
}

static void check_remove_interface_ok(introspection_t *introspection, char *interface_name)
{
    check_remove_interface(introspection, interface_name, ASTARTE_RESULT_OK);
}

ZTEST(astarte_device_sdk_introspection, test_introspection_add_remove) // NOLINT
{
    LOG_INF("Creating introspection"); // NOLINT
    introspection_t introspection;
    introspection_init(&introspection);

    LOG_INF("Adding interfaces"); // NOLINT
    check_add_interface_ok(&introspection, &test_interface_a);
    check_add_interface_ok(&introspection, &test_interface_b);
    check_add_interface_ok(&introspection, &test_interface_c);

    char *introspection_buf = get_introspection_string(&introspection);
    LOG_INF("Complete introspection string '%s'", introspection_buf); // NOLINT

    check_introspection((char *) expected_introspection_all, introspection_buf);

    LOG_INF("Removing interface '%s'", test_interface_c.name); // NOLINT
    check_remove_interface_ok(&introspection, (char *) test_interface_c.name);

    char *introspection_buf_ab = get_introspection_string(&introspection);
    LOG_INF("Introspection string '%s'", introspection_buf); // NOLINT

    check_introspection((char *) expected_introspection_ab, introspection_buf_ab);

    zassert_equal_ptr(
        &test_interface_a, introspection_get(&introspection, (char *) test_interface_a.name));
    zassert_equal_ptr(
        &test_interface_b, introspection_get(&introspection, (char *) test_interface_b.name));
    zassert_equal_ptr(NULL, introspection_get(&introspection, (char *) test_interface_c.name));

    LOG_INF("Freeing introspection"); // NOLINT
    introspection_free(introspection);
}

ZTEST(astarte_device_sdk_introspection, test_introspection_add_twice) // NOLINT
{
    LOG_INF("Creating introspection"); // NOLINT
    introspection_t introspection;
    introspection_init(&introspection);

    LOG_INF("Adding interfaces"); // NOLINT
    check_add_interface_ok(&introspection, &test_interface_a);
    check_add_interface_ok(&introspection, &test_interface_b);
    check_add_interface_ok(&introspection, &test_interface_c);

    char *introspection_buf = get_introspection_string(&introspection);
    LOG_INF("Complete introspection string '%s'", introspection_buf); // NOLINT

    check_introspection((char *) expected_introspection_all, introspection_buf);

    check_add_interface(
        &introspection, &test_interface_a, ASTARTE_RESULT_INTERFACE_ALREADY_PRESENT);

    char *introspection_buf_abc = get_introspection_string(&introspection);
    LOG_INF("Introspection string '%s'", introspection_buf); // NOLINT

    check_introspection((char *) expected_introspection_all, introspection_buf_abc);

    LOG_INF("Freeing introspection"); // NOLINT
    introspection_free(introspection);
}

const static char expected_introspection_a[] = "test.interface.a:0:1";

ZTEST(astarte_device_sdk_introspection, test_introspection_remove_twice) // NOLINT
{
    LOG_INF("Creating introspection"); // NOLINT
    introspection_t introspection;
    introspection_init(&introspection);

    LOG_INF("Adding interface"); // NOLINT
    check_add_interface_ok(&introspection, &test_interface_a);

    char *introspection_buf = get_introspection_string(&introspection);
    LOG_INF("Complete introspection string '%s'", introspection_buf); // NOLINT
    check_introspection((char *) expected_introspection_a, introspection_buf);

    check_remove_interface_ok(&introspection, (char *) test_interface_a.name);

    char *introspection_buf_empty = get_introspection_string(&introspection);
    LOG_INF("Introspection string '%s'", introspection_buf); // NOLINT
    check_introspection("", introspection_buf_empty);

    check_remove_interface(
        &introspection, (char *) test_interface_a.name, ASTARTE_RESULT_INTERFACE_NOT_FOUND);

    char *introspection_buf_empty_2 = get_introspection_string(&introspection);
    LOG_INF("Introspection string '%s'", introspection_buf_empty_2); // NOLINT
    check_introspection("", introspection_buf_empty_2);

    LOG_INF("Freeing introspection"); // NOLINT
    introspection_free(introspection);
}

ZTEST(astarte_device_sdk_introspection, test_introspection_iter) // NOLINT
{
    LOG_INF("Creating introspection"); // NOLINT
    introspection_t introspection;
    introspection_init(&introspection);

    LOG_INF("Adding interfaces"); // NOLINT
    check_add_interface_ok(&introspection, &test_interface_a);
    check_add_interface_ok(&introspection, &test_interface_b);
    check_add_interface_ok(&introspection, &test_interface_c);

    LOG_INF("Creating introspection iterator"); // NOLINT
    introspection_node_t *introspection_iterator = introspection_iter(&introspection);
    LOG_INF("First interface '%s'", introspection_iterator->interface); // NOLINT
    zassert_equal_ptr(&test_interface_a, introspection_iterator->interface);

    LOG_INF("Advancing iterator"); // NOLINT
    introspection_iterator = introspection_iter_next(&introspection, introspection_iterator);
    LOG_INF("Second interface '%s'", introspection_iterator->interface); // NOLINT
    zassert_equal_ptr(&test_interface_b, introspection_iterator->interface);

    LOG_INF("Advancing iterator"); // NOLINT
    introspection_iterator = introspection_iter_next(&introspection, introspection_iterator);
    LOG_INF("Third interface '%s'", introspection_iterator->interface); // NOLINT
    zassert_equal_ptr(&test_interface_c, introspection_iterator->interface);

    LOG_INF("Advancing iterator"); // NOLINT
    introspection_iterator = introspection_iter_next(&introspection, introspection_iterator);
    LOG_INF("No fourth interface %p", introspection_iterator); // NOLINT
    zassert_equal_ptr(NULL, introspection_iterator);

    LOG_INF("Advancing iterator"); // NOLINT
    introspection_iterator = introspection_iter_next(&introspection, introspection_iterator);
    LOG_INF("No fourth interface %p", introspection_iterator); // NOLINT
    zassert_equal_ptr(NULL, introspection_iterator);

    LOG_INF("Freeing introspection"); // NOLINT
    introspection_free(introspection);
}

static void check_update_interface(introspection_t *introspection,
    const astarte_interface_t *interface, astarte_result_t expected_res)
{
    LOG_INF("Updating interface '%s'", interface->name); // NOLINT

    zassert_equal(expected_res, introspection_update(introspection, interface),
        "Unexpected result while updating interface '%s'", interface->name);
}

static void check_update_interface_ok(
    introspection_t *introspection, const astarte_interface_t *interface)
{
    check_update_interface(introspection, interface, ASTARTE_RESULT_OK);
}

const astarte_interface_t test_interface_a_v2_valid = {
    .name = "test.interface.a",
    .major_version = 0,
    .minor_version = 2,
    .ownership = ASTARTE_INTERFACE_OWNERSHIP_SERVER,
    .type = ASTARTE_INTERFACE_TYPE_PROPERTIES,
    .aggregation = ASTARTE_INTERFACE_AGGREGATION_INDIVIDUAL,
};

ZTEST(astarte_device_sdk_introspection, test_introspection_update_ok) // NOLINT
{
    LOG_INF("Creating introspection"); // NOLINT
    introspection_t introspection;
    introspection_init(&introspection);

    LOG_INF("Adding interfaces"); // NOLINT
    check_add_interface_ok(&introspection, &test_interface_a);
    check_add_interface_ok(&introspection, &test_interface_b);
    check_add_interface_ok(&introspection, &test_interface_c);

    LOG_INF("Updating the interface '%s'", test_interface_a_v2_valid.name); // NOLINT
    check_update_interface_ok(&introspection, &test_interface_a_v2_valid);

    LOG_INF("Freeing introspection"); // NOLINT
    introspection_free(introspection);
}

ZTEST(astarte_device_sdk_introspection, test_introspection_update_invalid_version) // NOLINT
{
    LOG_INF("Creating introspection"); // NOLINT
    introspection_t introspection;
    introspection_init(&introspection);

    LOG_INF("Adding interfaces"); // NOLINT
    check_add_interface_ok(&introspection, &test_interface_a);
    check_add_interface_ok(&introspection, &test_interface_b);
    check_add_interface_ok(&introspection, &test_interface_c);

    LOG_INF("Updating the interface '%s' with the same struct", test_interface_a.name); // NOLINT
    check_update_interface(&introspection, &test_interface_a, ASTARTE_RESULT_INTERFACE_CONFLICTING);

    LOG_INF("Freeing introspection"); // NOLINT
    introspection_free(introspection);
}
```

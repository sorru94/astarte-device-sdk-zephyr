## Kconfig
```
# (C) Copyright 2024, SECO Mind Srl
#
# SPDX-License-Identifier: Apache-2.0
#
# This file is the application Kconfig entry point. All application Kconfig
# options can be defined here or included via other application Kconfig files.
# You can browse these options using the west targets menuconfig (terminal) or
# guiconfig (GUI).

menu "Zephyr"
source "Kconfig.zephyr"
endmenu

menu "Sample application"

config DEVICE_ID
	string "Astarte device ID"
    default ""
	help
	  Device ID to be used to connect to Astarte.

config CREDENTIAL_SECRET
    string "Astarte credential secret"
    default ""
    help
        The credential secret to be used to connect to Astarte.

config DEVICE_RX_THREAD_STACK_SIZE
    int "Device reception thread stack size (Bytes)"
    default 16384
    help
        Use this setting to change the size of the stack for the thread running the Astarte device
        receiving functionality.

config DEVICE_TX_THREAD_STACK_SIZE
    int "Device transmission thread stack size (Bytes)"
    default 4096
    help
        Use this setting to change the size of the stack for the thread running the Astarte device
        transmitting functionality.

config DEVICE_THREAD_PRIORITY
    int "Device thread(s) priority"
    default 0
    help
        Use this setting to change the priority of the receive and transmit threads running the
        Astarte device.

config DEVICE_POLL_PERIOD_MS
    int "Device thread polling period (ms)"
    default 100
    help
        Use this setting to change the polling period for the Astarte device.

config MQTT_CONNECTION_TIMEOUT_MS
    int "MQTT first polling timeout (ms)"
    default 3000
    help
        Use this setting to change the MQTT polling timeout for first polling operations.

config MQTT_POLL_TIMEOUT_MS
    int "MQTT subsequent polling timeout (ms)"
    default 500
    help
        Use this setting to change the MQTT polling timeout for subsequent polling operations.

config HTTP_TIMEOUT_MS
    int "HTTP operations timeout (ms)"
    default 3000
    help
        Use this setting to change the timeout for HTTP requests.

config DEVICE_OPERATIONAL_TIMEOUT
    int "Operational time in sedonds for which the device will stay connected to astarte"
    default 60
    depends on !DEVICE_INDIVIDUAL_TRANSMISSION
    depends on !DEVICE_OBJECT_TRANSMISSION
    depends on !DEVICE_PROPERTY_SET_TRANSMISSION
    depends on !DEVICE_PROPERTY_UNSET_TRANSMISSION
    help
        The device will stay connected to astarte for the specified number of seconds,
        after this time the device will be disconnected and the sample will end.
        This option gets automatically enabled when no transmission is configured to
        allow the device to wait for messages from the server.

menu "Individual transmission"

config DEVICE_INDIVIDUAL_TRANSMISSION
    bool "Enable sample transmission of astarte individuals"
    default y
    help
        Use this setting to enable the transmission of astarte inviduals in the sample.

config DEVICE_INDIVIDUAL_TRANSMISSION_DELAY_SECONDS
    int "Device transmission delay (s)"
    default 10
    depends on DEVICE_INDIVIDUAL_TRANSMISSION
    help
        Use this setting to change how long to wait before sending individuals.
        This delay starts after the device connects to astarte: a delay of 0 means that all
        individuals will be sent just after a connection event.

endmenu

menu "Object transmission"

config DEVICE_OBJECT_TRANSMISSION
    bool "Enable sample transmission of astarte objects"
    default y
    help
        Use this setting to enable the transmission of astarte objects in the sample.

config DEVICE_OBJECT_TRANSMISSION_DELAY_SECONDS
    int "Device transmission delay (s)"
    default 10
    depends on DEVICE_OBJECT_TRANSMISSION
    help
        Use this setting to change how long to wait before sending objects.
        This delay starts after all individuals got sent: a delay of 0 means that all objects
        will be sent just after the individual got sent.

endmenu

menu "Property transmission"

config DEVICE_PROPERTY_SET_TRANSMISSION
    bool "Enable sample transmission of astarte properties set"
    default y
    help
        Use this setting to enable the transmission of astarte properties set in the sample.

config DEVICE_PROPERTY_SET_TRANSMISSION_DELAY_SECONDS
    int "Device transmission delay (s)"
    default 10
    depends on DEVICE_PROPERTY_SET_TRANSMISSION
    help
        Use this setting to change how long to wait before setting properties.
        This delay starts after all objects got sent: a delay of 0 means that all properties
        will be set just after the object got sent.

config DEVICE_PROPERTY_UNSET_TRANSMISSION
    bool "Enable sample transmission of astarte properties unset"
    default y
    help
        Use this setting to enable the transmission of astarte properties unset in the sample.

config DEVICE_PROPERTY_UNSET_TRANSMISSION_DELAY_SECONDS
    int "Send property unset transmission delay (s)"
    default 10
    depends on DEVICE_PROPERTY_UNSET_TRANSMISSION
    help
        Use this setting to change how long to wait before sending properties unsets.
        This delay starts after all properties got set: a delay of 0 means that all properties
        will be unset just after they got set.

endmenu

module = APP
module-str = APP
source "subsys/logging/Kconfig.template.log_config"

module = REGISTER
module-str = REGISTER
source "subsys/logging/Kconfig.template.log_config"

module = INDIVIDUAL
module-str = INDIVIDUAL
source "subsys/logging/Kconfig.template.log_config"

module = OBJECT
module-str = OBJECT
source "subsys/logging/Kconfig.template.log_config"

module = PROPERTY
module-str = PROPERTY
source "subsys/logging/Kconfig.template.log_config"

endmenu
```

## prj.conf
```kconfig
# (C) Copyright 2024, SECO Mind Srl
#
# SPDX-License-Identifier: Apache-2.0
#
# This is a Kconfig fragment which can be used to enable debug-related options
# in the application. See the README for more details.

# Astarte device SDK
CONFIG_ASTARTE_DEVICE_SDK=y
CONFIG_ASTARTE_DEVICE_SDK_HOSTNAME="."
# The two certificate tags are the same as the root CA is the same for Astarte API and MQTT broker.
CONFIG_ASTARTE_DEVICE_SDK_HTTPS_CA_CERT_TAG=1
CONFIG_ASTARTE_DEVICE_SDK_MQTTS_CA_CERT_TAG=1
CONFIG_ASTARTE_DEVICE_SDK_CLIENT_CERT_TAG=2
CONFIG_ASTARTE_DEVICE_SDK_PAIRING_JWT=""
CONFIG_ASTARTE_DEVICE_SDK_REALM_NAME="."

# Sample configuration
CONFIG_DEVICE_ID="......................"
CONFIG_CREDENTIAL_SECRET="............................................"

CONFIG_DEVICE_INDIVIDUAL_TRANSMISSION=y
CONFIG_DEVICE_OBJECT_TRANSMISSION=y
CONFIG_DEVICE_PROPERTY_SET_TRANSMISSION=y
CONFIG_DEVICE_PROPERTY_UNSET_TRANSMISSION=y

# Enable logging with floating point support
CONFIG_LOG=y
CONFIG_REQUIRES_FLOAT_PRINTF=y
CONFIG_CBPRINTF_FP_SUPPORT=y

# Increased stack size
CONFIG_MAIN_STACK_SIZE=4096

# Enable base64 encoding and decoding
CONFIG_BASE64=y

# Enable system hashmaps
CONFIG_SYS_HASH_MAP=y

# Enable JSON library
CONFIG_JSON_LIBRARY=y

# Enable entropy generator
CONFIG_ENTROPY_GENERATOR=y

# DNS resolver
CONFIG_DNS_RESOLVER=y
CONFIG_DNS_SERVER_IP_ADDRESSES=y
CONFIG_DNS_SERVER1="8.8.8.8" # Google DNS

# MbedTLS
CONFIG_MBEDTLS=y
CONFIG_MBEDTLS_BUILTIN=y
CONFIG_MBEDTLS_ENABLE_HEAP=y
CONFIG_MBEDTLS_HEAP_SIZE=55000
CONFIG_MBEDTLS_SSL_MAX_CONTENT_LEN=16384
CONFIG_MBEDTLS_PEM_CERTIFICATE_FORMAT=y
CONFIG_MBEDTLS_PK_WRITE_C=y # Required for PEM writing
CONFIG_MBEDTLS_ENTROPY_C=y
CONFIG_MBEDTLS_ENTROPY_POLL_ZEPHYR=y
CONFIG_MBEDTLS_TLS_VERSION_1_2=y
CONFIG_MBEDTLS_CIPHER=y
CONFIG_MBEDTLS_CIPHER_ALL_ENABLED=y
CONFIG_MBEDTLS_SERVER_NAME_INDICATION=y
CONFIG_MBEDTLS_KEY_EXCHANGE_ALL_ENABLED=y
CONFIG_MBEDTLS_HASH_ALL_ENABLED=y
CONFIG_MBEDTLS_CTR_DRBG_ENABLED=y
CONFIG_MBEDTLS_HMAC_DRBG_ENABLED=y
CONFIG_MBEDTLS_CHACHAPOLY_AEAD_ENABLED=y
CONFIG_MBEDTLS_ECDH_C=y
CONFIG_MBEDTLS_ECDSA_C=y
CONFIG_MBEDTLS_ECJPAKE_C=y
CONFIG_MBEDTLS_ECP_C=y
CONFIG_MBEDTLS_ECP_ALL_ENABLED=y
CONFIG_MBEDTLS_GENPRIME_ENABLED=y
CONFIG_MBEDTLS_PKCS5_C=y
CONFIG_MBEDTLS_X509_CRL_PARSE_C=y
CONFIG_MBEDTLS_X509_CSR_PARSE_C=y
CONFIG_MBEDTLS_X509_CSR_WRITE_C=y

# Enable networking
CONFIG_NETWORKING=y

# Sockets
CONFIG_NET_SOCKETS=y
CONFIG_NET_SOCKETS_SOCKOPT_TLS=y

# Use DHCP for IPv4 and IPv6
CONFIG_NET_DHCPV4=y
CONFIG_NET_DHCPV6=y

# Generic networking options
CONFIG_NET_TX_STACK_SIZE=4096
CONFIG_NET_RX_STACK_SIZE=4096
CONFIG_NET_PKT_RX_COUNT=20
CONFIG_NET_PKT_TX_COUNT=20
CONFIG_NET_BUF_RX_COUNT=40
CONFIG_NET_BUF_TX_COUNT=40
CONFIG_NET_MAX_CONTEXTS=20
CONFIG_NET_MGMT=y
CONFIG_NET_MGMT_EVENT=y
CONFIG_NET_IPV4=y
CONFIG_NET_IPV6=y
CONFIG_NET_TCP=y

# Enable HTTP client
CONFIG_HTTP_CLIENT=y

# MQTT options
CONFIG_MQTT_LIB=y
CONFIG_MQTT_LIB_TLS=y
CONFIG_MQTT_KEEPALIVE=60

CONFIG_BUILD_OUTPUT_META=y
```

## src/main.c
```c
/*
 * (C) Copyright 2024, SECO Mind Srl
 *
 * SPDX-License-Identifier: Apache-2.0
 */

#include <string.h>

#include <zephyr/data/json.h>
#include <zephyr/kernel.h>
#include <zephyr/logging/log.h>
#include <zephyr/net/http/client.h>
#include <zephyr/net/socket.h>
#include <zephyr/posix/arpa/inet.h>
#include <zephyr/toolchain.h>

#if (!defined(CONFIG_ASTARTE_DEVICE_SDK_DEVELOP_USE_NON_TLS_HTTP)                                  \
    || !defined(CONFIG_ASTARTE_DEVICE_SDK_DEVELOP_USE_NON_TLS_MQTT))
#include "ca_certificates.h"
#include <zephyr/net/tls_credentials.h>
#endif

#include <astarte_device_sdk/data.h>
#include <astarte_device_sdk/device.h>
#include <astarte_device_sdk/interface.h>
#include <astarte_device_sdk/mapping.h>
#include <astarte_device_sdk/pairing.h>

#include "utils.h"

#include "generated_interfaces.h"

#if defined(CONFIG_DEVICE_INDIVIDUAL_TRANSMISSION)
#include "individual_send.h"
#endif
#if defined(CONFIG_DEVICE_OBJECT_TRANSMISSION)
#include "object_send.h"
#endif
#if defined(CONFIG_DEVICE_PROPERTY_SET_TRANSMISSION)                                               \
    || defined(CONFIG_DEVICE_PROPERTY_UNSET_TRANSMISSION)
#include "property_send.h"
#endif

/************************************************
 *       Checks over configuration values       *
 ***********************************************/

BUILD_ASSERT(sizeof(CONFIG_DEVICE_ID) == ASTARTE_DEVICE_ID_LEN + 1,
    "Missing device ID in datastreams example");

BUILD_ASSERT(sizeof(CONFIG_CREDENTIAL_SECRET) == ASTARTE_PAIRING_CRED_SECR_LEN + 1,
    "Missing credential secret in datastreams example");

/************************************************
 * Constants, static variables and defines
 ***********************************************/

LOG_MODULE_REGISTER(main, CONFIG_APP_LOG_LEVEL); // NOLINT

#define THREAD_SLEEP_MS 500

// NOLINTBEGIN(cppcoreguidelines-avoid-non-const-global-variables)
K_MSGQ_DEFINE(device_msgq, sizeof(astarte_device_handle_t), 1, 1);

enum thread_flags
{
    THREAD_FLAGS_CONNECTED = 1U,
    THREAD_FLAGS_TX_COMPLETE,
    THREAD_FLAGS_RX_TERMINATION,
};
static atomic_t device_thread_flags;

K_THREAD_STACK_DEFINE(device_rx_thread_stack_area, CONFIG_DEVICE_RX_THREAD_STACK_SIZE);
static struct k_thread device_rx_thread_data;

K_THREAD_STACK_DEFINE(device_tx_thread_stack_area, CONFIG_DEVICE_TX_THREAD_STACK_SIZE);
static struct k_thread device_tx_thread_data;
// NOLINTEND(cppcoreguidelines-avoid-non-const-global-variables)

/************************************************
 * Static functions declaration
 ***********************************************/

/**
 * @brief Entry point for the Astarte device reception thread.
 *
 * @param arg1 Unused argument.
 * @param arg2 Unused argument.
 * @param arg3 Unused argument.
 */
static void device_rx_thread_entry_point(void *arg1, void *arg2, void *arg3);
/**
 * @brief Entry point for the Astarte device transmission thread.
 *
 * @param arg1 Unused argument.
 * @param arg2 Unused argument.
 * @param arg3 Unused argument.
 */
static void device_tx_thread_entry_point(void *arg1, void *arg2, void *arg3);
/**
 * @brief Callback handler for Astarte connection events.
 *
 * @param event Astarte device connection event.
 */
static void connection_callback(astarte_device_connection_event_t event);
/**
 * @brief Callback handler for Astarte disconnection events.
 *
 * @param event Astarte device disconnection event.
 */
static void disconnection_callback(astarte_device_disconnection_event_t event);
/**
 * @brief Callback handler for Astarte datastream individual event.
 *
 * @param event Astarte device datastream individual event.
 */
static void datastream_individual_callback(astarte_device_datastream_individual_event_t event);
/**
 * @brief Callback handler for Astarte datastream object event.
 *
 * @param event Astarte device datastream object event.
 */
static void datastream_object_callback(astarte_device_datastream_object_event_t event);
/**
 * @brief Callback handler for Astarte set property event.
 *
 * @param event Astarte device set property event.
 */
static void set_property_callback(astarte_device_property_set_event_t event);
/**
 * @brief Callback handler for Astarte unset property event.
 *
 * @param event Astarte device unset property event.
 */
static void unset_property_callback(astarte_device_data_event_t event);

/************************************************
 * Global functions definition
 ***********************************************/

int main(void)
{
    LOG_INF("Astarte device sample"); // NOLINT
    LOG_INF("Board: %s", CONFIG_BOARD); // NOLINT

    // Add TLS certificate if required
#if (!defined(CONFIG_ASTARTE_DEVICE_SDK_DEVELOP_USE_NON_TLS_HTTP)                                  \
    || !defined(CONFIG_ASTARTE_DEVICE_SDK_DEVELOP_USE_NON_TLS_MQTT))
    tls_credential_add(CONFIG_ASTARTE_DEVICE_SDK_HTTPS_CA_CERT_TAG, TLS_CREDENTIAL_CA_CERTIFICATE,
        ca_certificate_root, sizeof(ca_certificate_root));
#endif

    // Spawn new rx thread for the Astarte device
    k_thread_create(&device_rx_thread_data, device_rx_thread_stack_area,
        K_THREAD_STACK_SIZEOF(device_rx_thread_stack_area), device_rx_thread_entry_point, NULL,
        NULL, NULL, CONFIG_DEVICE_THREAD_PRIORITY, 0, K_NO_WAIT);
    // Spawn new tx thread for the Astarte device
    k_thread_create(&device_tx_thread_data, device_tx_thread_stack_area,
        K_THREAD_STACK_SIZEOF(device_tx_thread_stack_area), device_tx_thread_entry_point, NULL,
        NULL, NULL, CONFIG_DEVICE_THREAD_PRIORITY, 0, K_NO_WAIT);

    while (!atomic_test_bit(&device_thread_flags, THREAD_FLAGS_TX_COMPLETE)) {
        k_sleep(K_MSEC(THREAD_SLEEP_MS));
    }

    // Ensure the Astarte tx thread has properly terminated and no more data is being sent.
    if (k_thread_join(&device_tx_thread_data, K_FOREVER) != 0) {
        LOG_ERR("Failed in waiting for the Astarte tx thread to terminate."); // NOLINT
    }

    // Signal to the Astarte rx thread that is should terminate.
    atomic_set_bit(&device_thread_flags, THREAD_FLAGS_RX_TERMINATION);

    // Wait for the Astarte rx thread to terminate.
    if (k_thread_join(&device_rx_thread_data, K_FOREVER) != 0) {
        LOG_ERR("Failed in waiting for the Astarte rx threads to terminate."); // NOLINT
    }

    LOG_INF("Astarte device sample finished."); // NOLINT
    k_sleep(K_MSEC(MSEC_PER_SEC));

    return 0;
}

/************************************************
 * Static functions definitions
 ***********************************************/

static void device_rx_thread_entry_point(void *arg1, void *arg2, void *arg3)
{
    ARG_UNUSED(arg1);
    ARG_UNUSED(arg2);
    ARG_UNUSED(arg3);

    astarte_device_handle_t device = NULL;
    astarte_result_t res = ASTARTE_RESULT_OK;

    char device_id[ASTARTE_DEVICE_ID_LEN + 1] = CONFIG_DEVICE_ID;
    char cred_secr[ASTARTE_PAIRING_CRED_SECR_LEN + 1] = CONFIG_CREDENTIAL_SECRET;

    const astarte_interface_t *interfaces[] = {
        &org_astarteplatform_zephyr_examples_DeviceDatastream,
        &org_astarteplatform_zephyr_examples_ServerDatastream,
        &org_astarteplatform_zephyr_examples_DeviceAggregate,
        &org_astarteplatform_zephyr_examples_ServerAggregate,
        &org_astarteplatform_zephyr_examples_DeviceProperty,
        &org_astarteplatform_zephyr_examples_ServerProperty,
    };

    astarte_device_config_t device_config = { 0 };
    device_config.http_timeout_ms = CONFIG_HTTP_TIMEOUT_MS;
    device_config.mqtt_connection_timeout_ms = CONFIG_MQTT_CONNECTION_TIMEOUT_MS;
    device_config.mqtt_poll_timeout_ms = CONFIG_MQTT_POLL_TIMEOUT_MS;
    device_config.connection_cbk = connection_callback;
    device_config.disconnection_cbk = disconnection_callback;
    device_config.datastream_individual_cbk = datastream_individual_callback;
    device_config.datastream_object_cbk = datastream_object_callback;
    device_config.property_set_cbk = set_property_callback;
    device_config.property_unset_cbk = unset_property_callback;
    device_config.interfaces = interfaces;
    device_config.interfaces_size = ARRAY_SIZE(interfaces);
    memcpy(device_config.device_id, device_id, sizeof(device_id));
    memcpy(device_config.cred_secr, cred_secr, sizeof(cred_secr));

    res = astarte_device_new(&device_config, &device);
    if (res != ASTARTE_RESULT_OK) {
        LOG_ERR("Astarte device creation failure."); // NOLINT
        k_msgq_put(&device_msgq, (void *) &device, K_FOREVER);
        return;
    }

    res = astarte_device_connect(device);
    if (res != ASTARTE_RESULT_OK) {
        LOG_ERR("Astarte device connection failure."); // NOLINT
        k_msgq_put(&device_msgq, (void *) &device, K_FOREVER);
        return;
    }

    // Add the message to the queue for the transmit thread
    // NO_WAIT is used since we know we are the only therad writing
    k_msgq_put(&device_msgq, (void *) &device, K_NO_WAIT);

    while (!atomic_test_bit(&device_thread_flags, THREAD_FLAGS_RX_TERMINATION)) {
        k_timepoint_t timepoint = sys_timepoint_calc(K_MSEC(CONFIG_DEVICE_POLL_PERIOD_MS));

        res = astarte_device_poll(device);
        if (res != ASTARTE_RESULT_OK) {
            LOG_ERR("Astarte device poll failure."); // NOLINT
            return;
        }

        k_sleep(sys_timepoint_timeout(timepoint));
    }

    LOG_INF("End of loop, disconnection imminent."); // NOLINT

    res = astarte_device_disconnect(device, K_SECONDS(10));
    if (res != ASTARTE_RESULT_OK) {
        LOG_ERR("Astarte device disconnection failure %s.", astarte_result_to_name(res)); // NOLINT
        return;
    }

    // we wait for a complete disconnection to avoid loosing some messages
    while (atomic_test_bit(&device_thread_flags, THREAD_FLAGS_CONNECTED)) {
        k_sleep(K_MSEC(THREAD_SLEEP_MS));
    }

    LOG_INF("Astarte device will now be destroyed."); // NOLINT
    res = astarte_device_destroy(device);
    if (res != ASTARTE_RESULT_OK) {
        LOG_ERR("Astarte device destroy failure."); // NOLINT
        return;
    }

    LOG_INF("Astarte thread will now be terminated."); // NOLINT

    k_sleep(K_MSEC(MSEC_PER_SEC));
}

static void device_tx_thread_entry_point(void *arg1, void *arg2, void *arg3)
{
    ARG_UNUSED(arg1);
    ARG_UNUSED(arg2);
    ARG_UNUSED(arg3);

    astarte_device_handle_t device = NULL;
    k_msgq_get(&device_msgq, (void *) &device, K_FOREVER);
    if (!device) {
        LOG_ERR("Received a failed device initialization, stopping transmission thread"); // NOLINT
        goto stop_transmission;
    }

    // wait for the device to be connected before sending data
    while (!atomic_test_bit(&device_thread_flags, THREAD_FLAGS_CONNECTED)) {
        k_sleep(K_MSEC(THREAD_SLEEP_MS));
    }

#if defined(CONFIG_DEVICE_INDIVIDUAL_TRANSMISSION)
    // NOLINTNEXTLINE
    LOG_INF("Waiting %d seconds to send individuals.",
        CONFIG_DEVICE_INDIVIDUAL_TRANSMISSION_DELAY_SECONDS);
    k_sleep(K_SECONDS(CONFIG_DEVICE_INDIVIDUAL_TRANSMISSION_DELAY_SECONDS));
    sample_individual_transmission(device);
#endif
#if defined(CONFIG_DEVICE_OBJECT_TRANSMISSION)
    // NOLINTNEXTLINE
    LOG_INF("Waiting %d seconds to send objects.", CONFIG_DEVICE_OBJECT_TRANSMISSION_DELAY_SECONDS);
    k_sleep(K_SECONDS(CONFIG_DEVICE_OBJECT_TRANSMISSION_DELAY_SECONDS));
    sample_object_transmission(device);
#endif
#if defined(CONFIG_DEVICE_PROPERTY_SET_TRANSMISSION)
    // NOLINTNEXTLINE
    LOG_INF("Waiting %d seconds to set properties.",
        CONFIG_DEVICE_PROPERTY_SET_TRANSMISSION_DELAY_SECONDS);
    k_sleep(K_SECONDS(CONFIG_DEVICE_PROPERTY_SET_TRANSMISSION_DELAY_SECONDS));
    sample_property_set_transmission(device);
#endif
#if defined(CONFIG_DEVICE_PROPERTY_UNSET_TRANSMISSION)
    // NOLINTNEXTLINE
    LOG_INF("Waiting %d seconds to unset properties.",
        CONFIG_DEVICE_PROPERTY_UNSET_TRANSMISSION_DELAY_SECONDS);
    k_sleep(K_SECONDS(CONFIG_DEVICE_PROPERTY_UNSET_TRANSMISSION_DELAY_SECONDS));
    sample_property_unset_transmission(device);
#endif

#if defined(CONFIG_DEVICE_INDIVIDUAL_TRANSMISSION) || defined(CONFIG_DEVICE_OBJECT_TRANSMISSION)   \
    || defined(CONFIG_DEVICE_PROPERTY_SET_TRANSMISSION)                                            \
    || defined(CONFIG_DEVICE_PROPERTY_UNSET_TRANSMISSION)
    LOG_INF("Transmission completed."); // NOLINT
#else
    // avoid unused device warnings
    (void) device;

    // NOLINTNEXTLINE
    LOG_INF("No transmission to perform. Keeping the device connected for %d seconds",
        CONFIG_DEVICE_OPERATIONAL_TIMEOUT);
    k_sleep(K_SECONDS(CONFIG_DEVICE_OPERATIONAL_TIMEOUT));
#endif

stop_transmission:
    // Signal to the main thread that the transmission is complete and the thread can be joined.
    atomic_set_bit(&device_thread_flags, THREAD_FLAGS_TX_COMPLETE);
}

static void connection_callback(astarte_device_connection_event_t event)
{
    ARG_UNUSED(event);
    LOG_INF("Astarte device connected."); // NOLINT
    atomic_set_bit(&device_thread_flags, THREAD_FLAGS_CONNECTED);
}

static void disconnection_callback(astarte_device_disconnection_event_t event)
{
    ARG_UNUSED(event);
    LOG_INF("Astarte device disconnected"); // NOLINT
    atomic_clear_bit(&device_thread_flags, THREAD_FLAGS_CONNECTED);
}

static void datastream_individual_callback(astarte_device_datastream_individual_event_t event)
{
    const char *interface_name = event.base_event.interface_name;
    const char *path = event.base_event.path;
    astarte_data_t individual = event.data;

    LOG_INF("Datastream individual event, interface: %s, path: %s", interface_name, path); // NOLINT

    utils_log_astarte_data(individual);
}

static void datastream_object_callback(astarte_device_datastream_object_event_t event)
{
    const char *interface_name = event.base_event.interface_name;
    const char *path = event.base_event.path;
    astarte_object_entry_t *entries = event.entries;
    size_t entries_length = event.entries_len;

    LOG_INF("Datastream object event, interface: %s, path: %s", interface_name, path); // NOLINT

    utils_log_astarte_object(entries, entries_length);
}

static void set_property_callback(astarte_device_property_set_event_t event)
{
    const char *interface_name = event.base_event.interface_name;
    const char *path = event.base_event.path;
    astarte_data_t individual = event.data;

    LOG_INF("Property set event, interface: %s, path: %s", interface_name, path); // NOLINT

    utils_log_astarte_data(individual);
}

static void unset_property_callback(astarte_device_data_event_t event)
{
    const char *interface_name = event.interface_name;
    const char *path = event.path;
    LOG_INF("Property unset event, interface: %s, path: %s", interface_name, path); // NOLINT
}
```

## include/object_send.h
```c
/*
 * (C) Copyright 2024, SECO Mind Srl
 *
 * SPDX-License-Identifier: Apache-2.0
 */

#ifndef OBJECT_SEND_H
#define OBJECT_SEND_H

#include <astarte_device_sdk/device.h>

void sample_object_transmission(astarte_device_handle_t device);

#endif // OBJECT_SEND_H
```

## src/individual_send.c
```c
/*
 * (C) Copyright 2024, SECO Mind Srl
 *
 * SPDX-License-Identifier: Apache-2.0
 */

#include "individual_send.h"

#include <zephyr/logging/log.h>
#include <zephyr/sys/util.h>

#include <astarte_device_sdk/data.h>

#include "astarte_device_sdk/result.h"
#include "generated_interfaces.h"
#include "utils.h"

LOG_MODULE_REGISTER(individual_send, CONFIG_INDIVIDUAL_LOG_LEVEL); // NOLINT

void sample_individual_transmission(astarte_device_handle_t device)
{
    LOG_INF("Sending some individuals using the Astarte device."); // NOLINT
    const char *interface_name = org_astarteplatform_zephyr_examples_DeviceDatastream.name;

    astarte_data_t individuals[] = { astarte_data_from_binaryblob((void *) utils_binary_blob_data,
                                         ARRAY_SIZE(utils_binary_blob_data)),
        astarte_data_from_binaryblob_array((const void **) utils_binary_blobs_data,
            (size_t *) utils_binary_blobs_sizes_data, ARRAY_SIZE(utils_binary_blobs_data)),
        astarte_data_from_boolean(utils_boolean_data),
        astarte_data_from_boolean_array(
            (bool *) utils_boolean_array_data, ARRAY_SIZE(utils_boolean_array_data)),
        astarte_data_from_datetime(utils_unix_time_data),
        astarte_data_from_datetime_array(
            (int64_t *) utils_unix_time_array_data, ARRAY_SIZE(utils_unix_time_array_data)),
        astarte_data_from_double(utils_double_data),
        astarte_data_from_double_array(
            (double *) utils_double_array_data, ARRAY_SIZE(utils_double_array_data)),
        astarte_data_from_integer(utils_integer_data),
        astarte_data_from_integer_array(
            (int32_t *) utils_integer_array_data, ARRAY_SIZE(utils_integer_array_data)),
        astarte_data_from_longinteger(utils_longinteger_data),
        astarte_data_from_longinteger_array(
            (int64_t *) utils_longinteger_array_data, ARRAY_SIZE(utils_longinteger_array_data)),
        astarte_data_from_string(utils_string_data),
        astarte_data_from_string_array(
            (const char **) utils_string_array_data, ARRAY_SIZE(utils_string_array_data)) };

    const char *paths[] = {
        "/binaryblob_endpoint",
        "/binaryblobarray_endpoint",
        "/boolean_endpoint",
        "/booleanarray_endpoint",
        "/datetime_endpoint",
        "/datetimearray_endpoint",
        "/double_endpoint",
        "/doublearray_endpoint",
        "/integer_endpoint",
        "/integerarray_endpoint",
        "/longinteger_endpoint",
        "/longintegerarray_endpoint",
        "/string_endpoint",
        "/stringarray_endpoint",
    };

    const int64_t tms = 1714748755;

    BUILD_ASSERT(ARRAY_SIZE(individuals) == ARRAY_SIZE(paths),
        "The number of paths does not match the number of individuals");
    for (size_t i = 0; i < ARRAY_SIZE(individuals); i++) {
        LOG_INF("Stream on %s:", paths[i]); // NOLINT
        utils_log_astarte_data(individuals[i]);
        astarte_result_t res = astarte_device_send_individual(
            device, interface_name, paths[i], individuals[i], &tms);
        if (res != ASTARTE_RESULT_OK) {
            LOG_INF("Astarte device transmission failure."); // NOLINT
        }
    }

    LOG_INF("Individual transmission completed."); // NOLINT
}
```

## src/utils.c
```c
/*
 * (C) Copyright 2024, SECO Mind Srl
 *
 * SPDX-License-Identifier: Apache-2.0
 */

#include "utils.h"

#include <stdlib.h>

#include <zephyr/logging/log.h>
#include <zephyr/sys/timeutil.h>

LOG_MODULE_REGISTER(utils, CONFIG_APP_LOG_LEVEL); // NOLINT

/************************************************
 * Constants, static variables and defines
 ***********************************************/

// NOLINTBEGIN(readability-magic-numbers, cppcoreguidelines-avoid-magic-numbers)
const uint8_t utils_binary_blob_data[8] = { 0x53, 0x47, 0x56, 0x73, 0x62, 0x47, 0x38, 0x3d };
static const uint8_t binblob_1[8] = { 0x53, 0x47, 0x56, 0x73, 0x62, 0x47, 0x38, 0x3d };
static const uint8_t binblob_2[5] = { 0x64, 0x32, 0x39, 0x79, 0x62 };
const uint8_t *const utils_binary_blobs_data[2] = { binblob_1, binblob_2 };
const size_t utils_binary_blobs_sizes_data[2] = { ARRAY_SIZE(binblob_1), ARRAY_SIZE(binblob_2) };
const bool utils_boolean_data = true;
const bool utils_boolean_array_data[3] = { true, false, true };
const int64_t utils_unix_time_data = 1710940988984;
const int64_t utils_unix_time_array_data[1] = { 1710940988984 };
const double utils_double_data = 15.42;
const double utils_double_array_data[2] = { 1542.25, 88852.6 };
const int32_t utils_integer_data = 42;
const int32_t utils_integer_array_data[3] = { 4525, 0, 11 };
const int64_t utils_longinteger_data = 8589934592;
const int64_t utils_longinteger_array_data[3] = { 8589930067, 42, 8589934592 };
const char utils_string_data[] = "Hello world!";
const char *const utils_string_array_data[2] = { "Hello ", "world!" };
// NOLINTEND(readability-magic-numbers, cppcoreguidelines-avoid-magic-numbers)

// Maximum size for the datetime string
#define DATETIME_MAX_BUF_SIZE 30

static size_t utils_datetime_to_string(
    int64_t datetime, char out_string[const DATETIME_MAX_BUF_SIZE]);

/************************************************
 * Global functions definition
 ***********************************************/

// NOLINTNEXTLINE(hicpp-function-size)
void utils_log_astarte_data(astarte_data_t data)
{
    char tm_str[DATETIME_MAX_BUF_SIZE] = { 0 };

    switch (astarte_data_get_type(data)) {
        case ASTARTE_MAPPING_TYPE_BINARYBLOB:
            void *blob = NULL;
            size_t blob_len = 0;
            (void) astarte_data_to_binaryblob(data, &blob, &blob_len);
            LOG_HEXDUMP_INF(blob, blob_len, "Astarte binaryblob:"); // NOLINT
            break;
        case ASTARTE_MAPPING_TYPE_BINARYBLOBARRAY:
            LOG_INF("Astarte binaryblobarray:"); // NOLINT
            const void **blobs = NULL;
            size_t *sizes = NULL;
            size_t count = 0;
            (void) astarte_data_to_binaryblob_array(data, &blobs, &sizes, &count);
            for (size_t i = 0; i < count; i++) {
                LOG_HEXDUMP_INF(blobs[i], sizes[i], ""); // NOLINT
            }
            break;
        case ASTARTE_MAPPING_TYPE_BOOLEAN:
            bool boolean = false;
            (void) astarte_data_to_boolean(data, &boolean);
            LOG_INF("Astarte boolean: %s", (boolean) ? "true" : "false"); // NOLINT
            break;
        case ASTARTE_MAPPING_TYPE_BOOLEANARRAY:
            LOG_INF("Astarte booleanarray:"); // NOLINT
            bool *bools = NULL;
            size_t bools_len = 0;
            (void) astarte_data_to_boolean_array(data, &bools, &bools_len);
            for (size_t i = 0; i < bools_len; i++) {
                LOG_INF("    %zi: %s", i, (bools[i]) ? "true" : "false"); // NOLINT
            }
            break;
        case ASTARTE_MAPPING_TYPE_DATETIME:
            int64_t datetime = 0;
            (void) astarte_data_to_datetime(data, &datetime);
            if (utils_datetime_to_string(datetime, tm_str) != 0) {
                LOG_INF("Astarte datetime: %s", tm_str); // NOLINT
            } else {
                LOG_ERR("Buffer size for datetime conversion too small"); // NOLINT
            }
            break;
        case ASTARTE_MAPPING_TYPE_DATETIMEARRAY:
            LOG_INF("Astarte datetimearray:"); // NOLINT
            int64_t *datetimes = NULL;
            size_t datetimes_len = 0;
            (void) astarte_data_to_datetime_array(data, &datetimes, &datetimes_len);
            for (size_t i = 0; i < datetimes_len; i++) {
                if (utils_datetime_to_string(datetimes[i], tm_str) != 0) {
                    LOG_INF("    %zi: %s", i, tm_str); // NOLINT
                } else {
                    LOG_ERR("Buffer size for datetime conversion too small"); // NOLINT
                }
            }
            break;
        case ASTARTE_MAPPING_TYPE_DOUBLE:
            double dbl = false;
            (void) astarte_data_to_double(data, &dbl);
            LOG_INF("Astarte double: %f", dbl); // NOLINT
            break;
        case ASTARTE_MAPPING_TYPE_DOUBLEARRAY:
            LOG_INF("Astarte doublearray:"); // NOLINT
            double *doubles = NULL;
            size_t doubles_len = 0;
            (void) astarte_data_to_double_array(data, &doubles, &doubles_len);
            for (size_t i = 0; i < doubles_len; i++) {
                LOG_INF("    %zi: %f", i, doubles[i]); // NOLINT
            }
            break;
        case ASTARTE_MAPPING_TYPE_INTEGER:
            int32_t integer = false;
            (void) astarte_data_to_integer(data, &integer);
            LOG_INF("Astarte integer: %i", integer); // NOLINT
            break;
        case ASTARTE_MAPPING_TYPE_INTEGERARRAY:
            LOG_INF("Astarte integerarray:"); // NOLINT
            int32_t *integers = NULL;
            size_t integers_len = 0;
            (void) astarte_data_to_integer_array(data, &integers, &integers_len);
            for (size_t i = 0; i < integers_len; i++) {
                LOG_INF("    %zi: %i", i, integers[i]); // NOLINT
            }
            break;
        case ASTARTE_MAPPING_TYPE_LONGINTEGER:
            int64_t longinteger = false;
            (void) astarte_data_to_longinteger(data, &longinteger);
            LOG_INF("Astarte longinteger: %lli", longinteger); // NOLINT
            break;
        case ASTARTE_MAPPING_TYPE_LONGINTEGERARRAY:
            LOG_INF("Astarte longintegerarray:"); // NOLINT
            int64_t *longintegers = NULL;
            size_t longintegers_len = 0;
            (void) astarte_data_to_longinteger_array(data, &longintegers, &longintegers_len);
            for (size_t i = 0; i < longintegers_len; i++) {
                LOG_INF("    %zi: %lli", i, longintegers[i]); // NOLINT
            }
            break;
        case ASTARTE_MAPPING_TYPE_STRING:
            const char *string = false;
            (void) astarte_data_to_string(data, &string);
            LOG_INF("Astarte string: %s", string); // NOLINT
            break;
        case ASTARTE_MAPPING_TYPE_STRINGARRAY:
            LOG_INF("Astarte stringarray:"); // NOLINT
            const char **strings = NULL;
            size_t strings_len = 0;
            (void) astarte_data_to_string_array(data, &strings, &strings_len);
            for (size_t i = 0; i < strings_len; i++) {
                LOG_INF("    %zi: %s", i, strings[i]); // NOLINT
            }
            break;
        default:
            LOG_ERR("Astarte data has invalid tag!"); // NOLINT
            break;
    }
}

void utils_log_astarte_object(astarte_object_entry_t *entries, size_t entries_length)
{
    LOG_INF("Astarte object:"); // NOLINT

    for (size_t i = 0; i < entries_length; i++) {
        const char *mapping_path = NULL;
        astarte_data_t data = { 0 };
        astarte_result_t astarte_rc
            = astarte_object_entry_to_path_and_data(entries[i], &mapping_path, &data);
        if (astarte_rc == ASTARTE_RESULT_OK) {
            LOG_INF("Mapping path: %s", mapping_path); // NOLINT
            utils_log_astarte_data(data);
        }
    }
}

static size_t utils_datetime_to_string(
    int64_t datetime, char out_string[const DATETIME_MAX_BUF_SIZE])
{
    struct tm *tm_obj = gmtime(&datetime);
    return strftime(out_string, DATETIME_MAX_BUF_SIZE, "%Y-%m-%dT%H:%M:%S%z", tm_obj);
}
```

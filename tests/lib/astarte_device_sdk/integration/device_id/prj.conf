## CMakeLists.txt
```
# (C) Copyright 2024, SECO Mind Srl
#
# SPDX-License-Identifier: Apache-2.0

cmake_minimum_required(VERSION 3.20.0)
find_package(Zephyr REQUIRED HINTS $ENV{ZEPHYR_BASE})
project(astarte_device_sdk_integration_device_id)

target_include_directories(app PRIVATE
    ${ZEPHYR_BASE}/../astarte-device-sdk-zephyr/include
)

FILE(GLOB app_sources src/*.c)
target_sources(app PRIVATE ${app_sources})
```

## prj.conf
```kconfig
# (C) Copyright 2024, SECO Mind Srl
#
# SPDX-License-Identifier: Apache-2.0

CONFIG_ZTEST=y
CONFIG_ENTROPY_GENERATOR=y
CONFIG_TEST_RANDOM_GENERATOR=y
CONFIG_LOG=y
CONFIG_TEST_LOGGING_DEFAULTS=n

# Base MbedTLS & heap configuration
CONFIG_MBEDTLS=y
CONFIG_MBEDTLS_BUILTIN=y
CONFIG_MBEDTLS_ENABLE_HEAP=y
CONFIG_MBEDTLS_HEAP_SIZE=55000

# Enable PSA Crypto Backend
CONFIG_PSA_CRYPTO=y
CONFIG_PSA_CRYPTO_ENABLE_ALL=y
CONFIG_MBEDTLS_PSA_CRYPTO_C=y

# TLS & X.509
CONFIG_MBEDTLS_SSL_MAX_CONTENT_LEN=16384
CONFIG_MBEDTLS_PEM_PARSE_C=y
CONFIG_MBEDTLS_PEM_WRITE_C=y
CONFIG_MBEDTLS_BASE64_C=y
CONFIG_MBEDTLS_PK_WRITE_C=y
CONFIG_MBEDTLS_SSL_PROTO_TLS1_2=y
CONFIG_MBEDTLS_SSL_SERVER_NAME_INDICATION=y
CONFIG_MBEDTLS_X509_USE_C=y
CONFIG_MBEDTLS_X509_CRT_PARSE_C=y
CONFIG_MBEDTLS_X509_CRL_PARSE_C=y
CONFIG_MBEDTLS_X509_CSR_PARSE_C=y
CONFIG_MBEDTLS_X509_CSR_WRITE_C=y
CONFIG_MBEDTLS_PKCS5_C=y
CONFIG_MBEDTLS_KEY_EXCHANGE_ECDHE_ECDSA_ENABLED=y
CONFIG_MBEDTLS_KEY_EXCHANGE_ECDHE_RSA_ENABLED=y

# Astarte device SDK
CONFIG_ASTARTE_DEVICE_SDK=y
CONFIG_ASTARTE_DEVICE_SDK_HOSTNAME="."
CONFIG_ASTARTE_DEVICE_SDK_HTTPS_CA_CERT_TAG=1
CONFIG_ASTARTE_DEVICE_SDK_MQTTS_CA_CERT_TAG=1
CONFIG_ASTARTE_DEVICE_SDK_CLIENT_CERT_TAG=2
CONFIG_ASTARTE_DEVICE_SDK_PAIRING_JWT=""
CONFIG_ASTARTE_DEVICE_SDK_REALM_NAME="."

# Use picolib
CONFIG_PICOLIBC_USE_MODULE=y
CONFIG_PICOLIBC=y

# Enable networking
CONFIG_NETWORKING=y

# Enable HTTP client
CONFIG_HTTP_CLIENT=y

# MQTT options
CONFIG_MQTT_LIB=y
CONFIG_MQTT_LIB_TLS=y
CONFIG_MQTT_KEEPALIVE=60

# Enable base64 encoding and decoding
CONFIG_BASE64=y

# Enable system hashmaps
CONFIG_SYS_HASH_MAP=y

# Enable JSON library
CONFIG_JSON_LIBRARY=y

# Enable entropy generator
CONFIG_ENTROPY_GENERATOR=y

# DNS resolver
CONFIG_DNS_RESOLVER=y

# Enable UUID
CONFIG_UUID=y
CONFIG_UUID_V4=y
CONFIG_UUID_V5=y
CONFIG_UUID_BASE64=y

# Enable scoped cleanup helpers
CONFIG_SCOPE_CLEANUP_HELPERS=y

# Enable events
CONFIG_EVENTS=y
```

## src/main.c
```c
/*
 * (C) Copyright 2024, SECO Mind Srl
 *
 * SPDX-License-Identifier: Apache-2.0
 */

#include <string.h>
#include <zephyr/ztest.h>

#include "astarte_device_sdk/device_id.h"
#include "astarte_device_sdk/result.h"
#include <zephyr/sys/uuid.h>

ZTEST_SUITE(astarte_device_sdk_device_id, NULL, NULL, NULL, NULL, NULL);

ZTEST(astarte_device_sdk_device_id, test_device_id_generate_random)
{
    char device_id_1[ASTARTE_DEVICE_ID_LEN + 1] = { 0 };
    char device_id_2[ASTARTE_DEVICE_ID_LEN + 1] = { 0 };

    /* Generate first random ID */
    astarte_result_t res = astarte_device_id_generate_random(device_id_1);
    zassert_equal(
        ASTARTE_RESULT_OK, res, "astarte_device_id_generate_random returned an error: %d", res);
    zassert_equal(
        ASTARTE_DEVICE_ID_LEN, strlen(device_id_1), "Generated device ID 1 length is incorrect");

    /* Generate second random ID */
    res = astarte_device_id_generate_random(device_id_2);
    zassert_equal(
        ASTARTE_RESULT_OK, res, "astarte_device_id_generate_random returned an error: %d", res);
    zassert_equal(
        ASTARTE_DEVICE_ID_LEN, strlen(device_id_2), "Generated device ID 2 length is incorrect");

    /* Since they are UUIDv4-based, they should practically never be identical */
    zassert_true(
        strcmp(device_id_1, device_id_2) != 0, "Generated random device IDs should be unique");
}

ZTEST(astarte_device_sdk_device_id, test_device_id_generate_deterministic_example_from_standard)
{
    struct uuid namespace;
    int result = uuid_from_string("6ba7b810-9dad-11d1-80b4-00c04fd430c8", &namespace);
    zassert_true(result == 0, "uuid_from_string returned an error");

    const char *name = "www.example.com";
    char device_id[ASTARTE_DEVICE_ID_LEN + 1] = { 0 };

    astarte_result_t res = astarte_device_id_generate_deterministic(
        namespace.val, (const uint8_t *) name, strlen(name), device_id);

    zassert_equal(ASTARTE_RESULT_OK, res,
        "astarte_device_id_generate_deterministic returned an error: %d", res);
    zassert_equal(ASTARTE_DEVICE_ID_LEN, strlen(device_id),
        "Generated deterministic device ID length is incorrect");

    /* * The expected UUIDv5 for namespace "6ba7b810-9dad-11d1-80b4-00c04fd430c8" and
     * name "www.example.com" is "2ed6657d-e927-568b-95e1-2665a8aea6a2".
     * Converting those bytes to Base64URL encoding results in "LtZlfeknVouV4SZlqK6mog".
     */
    const char *expected_device_id = "LtZlfeknVouV4SZlqK6mog";
    zassert_true(strcmp(expected_device_id, device_id) == 0, "device_id != %s. Got: %s",
        expected_device_id, device_id);
}

ZTEST(astarte_device_sdk_device_id, test_device_id_generate_deterministic)
{
    struct uuid namespace;
    int result = uuid_from_string("c21fb11c-b6c9-452a-9e86-6075e313d7e2", &namespace);
    zassert_true(result == 0, "uuid_from_string returned an error");

    const char *name = "00225588";
    char device_id[ASTARTE_DEVICE_ID_LEN + 1] = { 0 };

    astarte_result_t res = astarte_device_id_generate_deterministic(
        namespace.val, (const uint8_t *) name, strlen(name), device_id);

    zassert_equal(ASTARTE_RESULT_OK, res,
        "astarte_device_id_generate_deterministic returned an error: %d", res);
    zassert_equal(ASTARTE_DEVICE_ID_LEN, strlen(device_id),
        "Generated deterministic device ID length is incorrect");

    /*
     * The expected UUIDv5 for namespace "c21fb11c-b6c9-452a-9e86-6075e313d7e2" and
     * name "00225588" is "63c8fb48-02ab-53f4-a254-52956dcbbce4".
     * Converting those bytes to Base64URL encoding results in "Y8j7SAKrU_SiVFKVbcu85A".
     */
    const char *expected_device_id = "Y8j7SAKrU_SiVFKVbcu85A";
    zassert_true(strcmp(expected_device_id, device_id) == 0, "device_id != %s. Got: %s",
        expected_device_id, device_id);
}

ZTEST(astarte_device_sdk_device_id, test_device_id_generate_deterministic_consistency)
{
    struct uuid namespace;
    uuid_from_string("c21fb11c-b6c9-452a-9e86-6075e313d7e2", &namespace);

    const char *name_1 = "astarte_device_1";
    char device_id_1[ASTARTE_DEVICE_ID_LEN + 1] = { 0 };
    char device_id_2[ASTARTE_DEVICE_ID_LEN + 1] = { 0 };

    astarte_result_t res = astarte_device_id_generate_deterministic(
        namespace.val, (const uint8_t *) name_1, strlen(name_1), device_id_1);
    zassert_equal(
        ASTARTE_RESULT_OK, res, "astarte_device_id_generate_deterministic returned an error");

    res = astarte_device_id_generate_deterministic(
        namespace.val, (const uint8_t *) name_1, strlen(name_1), device_id_2);
    zassert_equal(
        ASTARTE_RESULT_OK, res, "astarte_device_id_generate_deterministic returned an error");

    /* Passing the exact same namespace and name must yield the exact same device ID */
    zassert_true(strcmp(device_id_1, device_id_2) == 0,
        "Deterministic IDs for the same input parameters must match");

    /* Testing with a different name */
    const char *name_2 = "astarte_device_2";
    char device_id_3[ASTARTE_DEVICE_ID_LEN + 1] = { 0 };

    res = astarte_device_id_generate_deterministic(
        namespace.val, (const uint8_t *) name_2, strlen(name_2), device_id_3);
    zassert_equal(
        ASTARTE_RESULT_OK, res, "astarte_device_id_generate_deterministic returned an error");

    /* Passing a different name must yield a different device ID */
    zassert_true(strcmp(device_id_1, device_id_3) != 0,
        "Deterministic IDs for different input names must not match");
}
```

## CMakeLists.txt
```
# (C) Copyright 2024, SECO Mind Srl
#
# SPDX-License-Identifier: Apache-2.0

cmake_minimum_required(VERSION 3.20.0)

set(CMAKE_EXPORT_COMPILE_COMMANDS ON)

# add some custom functions from the sample directory
set(SAMPLE_DIR "${CMAKE_CURRENT_LIST_DIR}/../samples/astarte_app")
include(${SAMPLE_DIR}/Utils.cmake)

# add the sample specific private configuration
concat_if_exists(${CMAKE_SOURCE_DIR}/private.conf EXTRA_CONF_FILE)

find_package(Zephyr REQUIRED HINTS $ENV{ZEPHYR_BASE})
project(e2e_test)

# add sources and includes from the sample dir
target_sources(app PRIVATE ${SAMPLE_DIR}/src/eth.c)
target_include_directories(app PRIVATE ${SAMPLE_DIR}/include)

# handle generating certificate inc file
include(certificate.cmake)

# add astarte private headers
target_include_directories(app PRIVATE ${CMAKE_SOURCE_DIR}/../lib/astarte_device_sdk/include)

# add sources
FILE(GLOB app_sources src/*.c)
target_sources(app PRIVATE ${app_sources})
target_include_directories(app PRIVATE include)
```

## Kconfig
```
# (C) Copyright 2024, SECO Mind Srl
#
# SPDX-License-Identifier: Apache-2.0
#
# This file is the application Kconfig entry point. All application Kconfig
# options can be defined here or included via other application Kconfig files.
# You can browse these options using the west targets menuconfig (terminal) or
# guiconfig (GUI).

menu "Zephyr"
source "Kconfig.zephyr"
endmenu

rsource "../Kconfig"

menu "E2E test"

config TLS_CERTIFICATE_PATH
	string "Path of the tls certificate"
	help
	  Path to a certificate in PEM format. it will be included in the binary and used for TLS
	  authentication.
	  This path should be relative to the end to end project folder.

config DEVICE_ID
	string "Astarte device ID"
    default ""
	help
	  Device ID to be used to connect to Astarte.

config CREDENTIAL_SECRET
    string "Astarte credential secret"
    default ""
    help
        The credential secret to be used to connect to Astarte.

config E2E_APPENGINE_TOKEN
	string "Token to access appengine APIs"
    default ""
	help
	  Token used to access the Astarte appengine APIs.

config E2E_APPENGINE_URL
    string "Url of the appengine APIs"
    default ""
    help
        Url of the appengine APIs exposed by astarte

config LOG_ONLY
    bool "Enable device log only mode"
    default n
    help
        Incoming astarte server messages will only be logged and no check will be
        performed against incoming data

config DEVICE_THREAD_STACK_SIZE
    int "Device thread stack size (Bytes)"
    default 8192
    help
        Use this setting to change the size of the stack for the thread running the Astarte device.

config DEVICE_THREAD_PRIORITY
    int "Device thread priority"
    default 0
    help
        Use this setting to change the priority of the thread running the Astarte device.

config ETH_POLL_PERIOD_MS
    int "Device thread polling period (ms)"
    default 100
    help
        Use this setting to change the polling period for the ethernet connection.

config MQTT_CONNECTION_TIMEOUT_MS
    int "MQTT connection timeout (ms)"
    default 3000
    help
        Use this setting to change the MQTT connection timeout.

config MQTT_POLL_TIMEOUT_MS
    int "MQTT subsequent polling timeout (ms)"
    default 200
    help
        Use this setting to change the MQTT polling timeout.

config HTTP_TIMEOUT_MS
    int "HTTP operations timeout (ms)"
    default 3000
    help
        Use this setting to change the timeout for HTTP requests.

menu "Logging options"

module = APP
module-str = APP
source "subsys/logging/Kconfig.template.log_config"

module = RUNNER
module-str = Log level for e2e runner and command handler
module-help = Sets log level for e2e runner and command handler
source "subsys/logging/Kconfig.template.log_config"

module = DATA
module-str = Log level for e2e data functions
module-help = Sets log level for e2e data functions
source "subsys/logging/Kconfig.template.log_config"

module = UTILITIES
module-str = Log level for e2e utilities functions
module-help = Sets log level for e2e utilities functions
source "subsys/logging/Kconfig.template.log_config"

module = SHELL_HANDLERS
module-str = Log level for shell handlers
module-help = Sets log level for zephyr shell handlers
source "subsys/logging/Kconfig.template.log_config"

module = DEVICE_HANDLER
module-str = Log level for device handler
module-help = Sets log level for zephyr device handler
source "subsys/logging/Kconfig.template.log_config"

endmenu

endmenu
```

## prj.conf
```kconfig
# (C) Copyright 2024, SECO Mind Srl
#
# SPDX-License-Identifier: Apache-2.0
#
# This is a Kconfig fragment which can be used to enable debug-related options
# in the application. See the README for more details.

# Enable custom heap
CONFIG_ASTARTE_DEVICE_SDK_ENABLE_HEAP=y

# Zero out the system heap to ensure that the SDK uses only its own heap implementation.
CONFIG_HEAP_MEM_POOL_SIZE=0
CONFIG_HEAP_MEM_POOL_IGNORE_MIN=y

# Increase the UART RX ring buffer to handle long automated commands
CONFIG_SHELL_BACKEND_SERIAL_RX_RING_BUFFER_SIZE=1024
# Ensure the shell command buffer is large enough
CONFIG_SHELL_CMD_BUFF_SIZE=1024
# Prevent the terminal from line-wrapping the echo, which breaks Twister's regex
CONFIG_SHELL_DEFAULT_TERMINAL_WIDTH=1024

CONFIG_SHELL=y
CONFIG_SHELL_BACKEND_SERIAL=y
CONFIG_SHELL_BACKEND_SERIAL_LOG_LEVEL_DBG=y

CONFIG_TLS_CERTIFICATE_PATH="certificate/api.astarte.clea-dev.midgar.services.pem"

CONFIG_DEBUG_OPTIMIZATIONS=y
CONFIG_MBEDTLS_DEBUG=y

# Enables debug logging
CONFIG_APP_LOG_LEVEL_DBG=y
CONFIG_RUNNER_LOG_LEVEL_DBG=y
CONFIG_DATA_LOG_LEVEL_DBG=y
CONFIG_UTILITIES_LOG_LEVEL_DBG=y
CONFIG_SHELL_HANDLERS_LOG_LEVEL_DBG=y
CONFIG_DEVICE_HANDLER_LOG_LEVEL_DBG=y

# Astarte device SDK
CONFIG_ASTARTE_DEVICE_SDK=y
# The two certificate tags are the same as the root CA is the same for Astarte API and MQTT broker.
CONFIG_ASTARTE_DEVICE_SDK_HTTPS_CA_CERT_TAG=1
CONFIG_ASTARTE_DEVICE_SDK_MQTTS_CA_CERT_TAG=1
CONFIG_ASTARTE_DEVICE_SDK_CLIENT_CERT_TAG=2
# Enable sdk code generation
CONFIG_ASTARTE_DEVICE_SDK_ADVANCED_CODE_GENERATION=y
CONFIG_ASTARTE_DEVICE_SDK_ADVANCED_CODE_GENERATION_INTERFACE_DIRECTORY="interfaces/"
# Logging
CONFIG_ASTARTE_DEVICE_SDK_PAIRING_LOG_LEVEL_DBG=y
CONFIG_ASTARTE_DEVICE_SDK_CRYPTO_LOG_LEVEL_DBG=y
CONFIG_ASTARTE_DEVICE_SDK_HTTP_LOG_LEVEL_DBG=y
CONFIG_ASTARTE_DEVICE_SDK_DEVICE_LOG_LEVEL_DBG=y
CONFIG_ASTARTE_DEVICE_SDK_UUID_LOG_LEVEL_DBG=y
CONFIG_ASTARTE_DEVICE_SDK_BSON_LOG_LEVEL_DBG=y
CONFIG_ASTARTE_DEVICE_SDK_INTROSPECTION_LOG_LEVEL_DBG=y
CONFIG_ASTARTE_DEVICE_SDK_DATA_LOG_LEVEL_DBG=y
CONFIG_ASTARTE_DEVICE_SDK_VALIDATION_LOG_LEVEL_DBG=y
CONFIG_ASTARTE_DEVICE_SDK_OBJECT_LOG_LEVEL_DBG=y
CONFIG_ASTARTE_DEVICE_SDK_MAPPING_LOG_LEVEL_DBG=y
CONFIG_ASTARTE_DEVICE_SDK_MQTT_LOG_LEVEL_DBG=y
CONFIG_ASTARTE_DEVICE_SDK_TLS_CREDENTIALS_LOG_LEVEL_DBG=y
CONFIG_ASTARTE_DEVICE_SDK_STORAGE_LOG_LEVEL_DBG=y
CONFIG_ASTARTE_DEVICE_SDK_KEY_VALUE_LOG_LEVEL_DBG=y
CONFIG_ASTARTE_DEVICE_SDK_DEVICE_RX_LOG_LEVEL_DBG=y
CONFIG_ASTARTE_DEVICE_SDK_DEVICE_TX_LOG_LEVEL_DBG=y
CONFIG_ASTARTE_DEVICE_SDK_DEVICE_CONNECTION_LOG_LEVEL_DBG=y
CONFIG_ASTARTE_DEVICE_SDK_DEVICE_ID_LOG_LEVEL_DBG=y

# Enable logging with floating point support
CONFIG_LOG=y
CONFIG_CBPRINTF_FP_SUPPORT=y

# Increased stack size
CONFIG_MAIN_STACK_SIZE=16384

# Enable base64 encoding and decoding
CONFIG_BASE64=y

# Enable system hashmaps
CONFIG_SYS_HASH_MAP=y

# Enable JSON library
CONFIG_JSON_LIBRARY=y

# Enable entropy generator
CONFIG_ENTROPY_GENERATOR=y

# DNS resolver
CONFIG_DNS_RESOLVER=y
CONFIG_DNS_SERVER_IP_ADDRESSES=y
CONFIG_DNS_SERVER1="8.8.8.8" # Google DNS

# Base MbedTLS & heap configuration
CONFIG_MBEDTLS=y
CONFIG_MBEDTLS_BUILTIN=y
CONFIG_MBEDTLS_ENABLE_HEAP=y
CONFIG_MBEDTLS_HEAP_SIZE=55000

# Enable PSA Crypto Backend
CONFIG_PSA_CRYPTO=y
CONFIG_PSA_CRYPTO_ENABLE_ALL=y
CONFIG_MBEDTLS_PSA_CRYPTO_C=y

# TLS & X.509
CONFIG_MBEDTLS_SSL_MAX_CONTENT_LEN=8192
CONFIG_MBEDTLS_PEM_PARSE_C=y
CONFIG_MBEDTLS_PEM_WRITE_C=y
CONFIG_MBEDTLS_BASE64_C=y
CONFIG_MBEDTLS_PK_WRITE_C=y
CONFIG_MBEDTLS_SSL_PROTO_TLS1_2=y
CONFIG_MBEDTLS_SSL_SERVER_NAME_INDICATION=y
CONFIG_MBEDTLS_X509_USE_C=y
CONFIG_MBEDTLS_X509_CRT_PARSE_C=y
CONFIG_MBEDTLS_X509_CRL_PARSE_C=y
CONFIG_MBEDTLS_X509_CSR_PARSE_C=y
CONFIG_MBEDTLS_X509_CSR_WRITE_C=y
CONFIG_MBEDTLS_PKCS5_C=y
CONFIG_MBEDTLS_KEY_EXCHANGE_ECDHE_ECDSA_ENABLED=y
CONFIG_MBEDTLS_KEY_EXCHANGE_ECDHE_RSA_ENABLED=y

# Enable networking
CONFIG_NETWORKING=y

# Sockets
CONFIG_NET_SOCKETS=y
CONFIG_NET_SOCKETS_SOCKOPT_TLS=y

# Use DHCP for IPv4 and IPv6
CONFIG_NET_DHCPV4=y
CONFIG_NET_DHCPV6=y

# Generic networking options
CONFIG_NET_TX_STACK_SIZE=4096
CONFIG_NET_RX_STACK_SIZE=4096
CONFIG_NET_PKT_RX_COUNT=20
CONFIG_NET_PKT_TX_COUNT=20
CONFIG_NET_BUF_RX_COUNT=40
CONFIG_NET_BUF_TX_COUNT=40
CONFIG_NET_MAX_CONTEXTS=20
CONFIG_NET_MAX_CONN=6
CONFIG_NET_MGMT=y
CONFIG_NET_MGMT_EVENT=y
CONFIG_NET_IPV4=y
CONFIG_NET_IPV6=y
CONFIG_NET_TCP=y

# Enable HTTP client
CONFIG_HTTP_CLIENT=y

# MQTT options
CONFIG_MQTT_LIB=y
CONFIG_MQTT_LIB_TLS=y
CONFIG_MQTT_KEEPALIVE=60

# Enable flash
CONFIG_FLASH=y
CONFIG_FLASH_MAP=y
CONFIG_FLASH_PAGE_LAYOUT=y

# Enable storage
CONFIG_ZMS=y
CONFIG_ZMS_LOG_LEVEL_WRN=y

# Enable hash functions
CONFIG_SYS_HASH_FUNC32=y
CONFIG_SYS_HASH_FUNC32_MURMUR3=y

# Enable UUID
CONFIG_UUID=y
CONFIG_UUID_V4=y
CONFIG_UUID_V5=y
CONFIG_UUID_BASE64=y

# Enable scope-based cleanup
CONFIG_SCOPE_CLEANUP_HELPERS=y

# Enable events
CONFIG_EVENTS=y
```

## boards/native_sim.conf
```kconfig
# (C) Copyright 2024, SECO Mind Srl
#
# SPDX-License-Identifier: Apache-2.0

CONFIG_LOG_BACKEND_NATIVE_POSIX=n
CONFIG_UART_NATIVE_PTY_0_ON_STDINOUT=y

CONFIG_PICOLIBC_USE_MODULE=y
CONFIG_PICOLIBC=y

# Ethernet settings
CONFIG_NET_L2_ETHERNET=y
CONFIG_NET_L2_ETHERNET_MGMT=y

# Network application options and configuration
CONFIG_NET_DHCPV4=n
CONFIG_NET_DHCPV6=n
CONFIG_NET_CONFIG_SETTINGS=y
CONFIG_NET_CONFIG_NEED_IPV6=y
CONFIG_NET_CONFIG_MY_IPV6_ADDR="2001:db8::1"
CONFIG_NET_CONFIG_PEER_IPV6_ADDR="2001:db8::2"
CONFIG_NET_CONFIG_NEED_IPV4=y
CONFIG_NET_CONFIG_MY_IPV4_ADDR="192.0.2.1"
CONFIG_NET_CONFIG_PEER_IPV4_ADDR="192.0.2.2"
CONFIG_NET_CONFIG_MY_IPV4_GW="192.0.2.2"
```

## boards/qemu_x86.conf
```kconfig
# (C) Copyright 2026, SECO Mind Srl
#
# SPDX-License-Identifier: Apache-2.0

# Provide enough stack space for MbedTLS crypto and HTTPS handshakes
CONFIG_DEVICE_THREAD_STACK_SIZE=16384
CONFIG_SHELL_STACK_SIZE=16384
CONFIG_NET_SOCKETS_SERVICE_STACK_SIZE=2400

# Enable the simulated flash driver for storage
CONFIG_FLASH_SIMULATOR=y

# Print logs immediately to catch fatal errors before exit
CONFIG_LOG_MODE_IMMEDIATE=y

# Enable PCIe bus to support the e1000 driver
CONFIG_PCIE=y

# QEMU Ethernet settings (emulated e1000)
CONFIG_NET_L2_ETHERNET=y
CONFIG_ETH_E1000=y

# Enable the QEMU network backend
CONFIG_NET_QEMU_ETHERNET=y

# Network application options and configuration
CONFIG_NET_DHCPV4=n
CONFIG_NET_DHCPV6=n
CONFIG_NET_CONFIG_SETTINGS=y
CONFIG_NET_CONFIG_NEED_IPV6=y
CONFIG_NET_CONFIG_MY_IPV6_ADDR="2001:db8::1"
CONFIG_NET_CONFIG_PEER_IPV6_ADDR="2001:db8::2"
CONFIG_NET_CONFIG_NEED_IPV4=y
CONFIG_NET_CONFIG_MY_IPV4_ADDR="192.0.2.1"
CONFIG_NET_CONFIG_PEER_IPV4_ADDR="192.0.2.2"
CONFIG_NET_CONFIG_MY_IPV4_GW="192.0.2.2"
```

## boards/stm32h573i_dk.conf
```kconfig
# (C) Copyright 2026, SECO Mind Srl
#
# SPDX-License-Identifier: Apache-2.0

CONFIG_NET_L2_ETHERNET=y

CONFIG_FLASH=y
CONFIG_FLASH_MAP=y
CONFIG_FLASH_PAGE_LAYOUT=y
CONFIG_NVS=y
CONFIG_MPU_ALLOW_FLASH_WRITE=y

CONFIG_ENTROPY_GENERATOR=y

CONFIG_LOG_MODE_IMMEDIATE=y

CONFIG_NET_RX_STACK_SIZE=8192
CONFIG_NET_MGMT_EVENT_STACK_SIZE=4096
CONFIG_NET_SOCKETS_SERVICE_STACK_SIZE=4096
CONFIG_SHELL_STACK_SIZE=32768
```

## boards/qemu_x86.overlay
```dts
/*
 * (C) Copyright 2026, SECO Mind Srl
 *
 * SPDX-License-Identifier: Apache-2.0
 */

&flash_sim0 {
    partitions {
        compatible = "fixed-partitions";
        #address-cells = <1>;
        #size-cells = <1>;

        astarte_partition: partition@e0000 {
            label = "astarte";
            reg = <0x000e0000 DT_SIZE_K(128)>;
        };
    };
};
```

## boards/stm32h573i_dk.overlay
```dts
/*
 * (C) Copyright 2026, SECO Mind Srl
 *
 * SPDX-License-Identifier: Apache-2.0
 */

&flash0 {
    partitions {
        compatible = "fixed-partitions";
        #address-cells = <1>;
        #size-cells = <1>;

        astarte_partition: partition@100000 {
            label = "astarte";
            reg = <0x00100000 DT_SIZE_K(128)>;
        };
    };
};
```

## src/main.c
```c
/*
 * (C) Copyright 2024, SECO Mind Srl
 *
 * SPDX-License-Identifier: Apache-2.0
 */

#include <zephyr/kernel.h>
#include <zephyr/logging/log.h>
#include <zephyr/sys/atomic.h>
#include <zephyr/sys/clock.h>
#include <zephyr/sys/util.h>

#if defined(CONFIG_ARCH_POSIX)
#include <nsi_main.h>
#endif

#include <astarte_device_sdk/device_id.h>
#include <astarte_device_sdk/pairing.h>

#if !defined(CONFIG_ASTARTE_DEVICE_SDK_DEVELOP_USE_NON_TLS_HTTP)                                   \
    || !defined(CONFIG_ASTARTE_DEVICE_SDK_DEVELOP_USE_NON_TLS_MQTT)
#define NEEDS_TLS
#endif

#if defined(NEEDS_TLS)

// Enable mbed tls debug
#define MBEDTLS_DEBUG_C

#if defined(CONFIG_TLS_CERTIFICATE_PATH)
#include "ca_certificate_inc.h"
#else
#error TLS enabled but no generated certificate found: check the CONFIG_TLS_CERTIFICATE_PATH option
#endif

#include <mbedtls/debug.h>
#include <zephyr/net/tls_credentials.h>

#endif

#include "eth.h"

#include "runner.h"
#include "utilities.h"

LOG_MODULE_REGISTER(main, CONFIG_APP_LOG_LEVEL);

/************************************************
 *       Checks over configuration values       *
 ***********************************************/

BUILD_ASSERT(
    sizeof(CONFIG_DEVICE_ID) == ASTARTE_DEVICE_ID_LEN + 1, "Missing device ID in e2e tets");
BUILD_ASSERT(sizeof(CONFIG_CREDENTIAL_SECRET) == ASTARTE_PAIRING_CRED_SECR_LEN + 1,
    "Missing credential secret in e2e test");

/************************************************
 *   Constants, static variables and defines    *
 ***********************************************/

#define ETH_THREAD_STACK_SIZE 4096
K_THREAD_STACK_DEFINE(eth_thread_stack_area, ETH_THREAD_STACK_SIZE);
static struct k_thread eth_thread_data;
enum eth_thread_flags
{
    ETH_THREAD_TERMINATION_FLAG = 0,
};
static atomic_t eth_thread_flags;

/************************************************
 *         Static functions declaration         *
 ***********************************************/

static void eth_thread_entry_point(void *unused1, void *unused2, void *unused3);

/************************************************
 *         Global functions definition          *
 ***********************************************/

int main(void)
{
    LOG_INF("Astarte device end to end test");

    // Initialize Ethernet driver
    LOG_INF("Initializing Ethernet driver.");
    if (eth_connect() != 0) {
        LOG_ERR("Connectivity intialization failed!");
        return -1;
    }

#if defined(NEEDS_TLS)

    // Add TLS certificate
    tls_credential_add(CONFIG_ASTARTE_DEVICE_SDK_HTTPS_CA_CERT_TAG, TLS_CREDENTIAL_CA_CERTIFICATE,
        ca_certificate_root, ARRAY_SIZE(ca_certificate_root));

    // Enable mbedtls logging
    mbedtls_debug_set_threshold(1);

#endif

    LOG_INF("Spawning a new thread to poll the eth interface and check connectivity.");
    k_thread_create(&eth_thread_data, eth_thread_stack_area,
        K_THREAD_STACK_SIZEOF(eth_thread_stack_area), eth_thread_entry_point, NULL, NULL, NULL,
        CONFIG_DEVICE_THREAD_PRIORITY, 0, K_NO_WAIT);

    LOG_INF("Running the end to end test.");
    run_end_to_end_test();

    atomic_set_bit(&eth_thread_flags, ETH_THREAD_TERMINATION_FLAG);
    CHECK_HALT(k_thread_join(&eth_thread_data, K_FOREVER) != 0,
        "Failed in waiting for the eth polling thread to terminate.");

    LOG_INF("Returning from the end to end test.");

#if defined(CONFIG_ARCH_POSIX)
    // Required to terminate when on posix
    nsi_exit(0);
#endif
    return 0;
}

/************************************************
 *         Static functions definitions         *
 ***********************************************/

static void eth_thread_entry_point(void *unused1, void *unused2, void *unused3)
{
    ARG_UNUSED(unused1);
    ARG_UNUSED(unused2);
    ARG_UNUSED(unused3);

    LOG_INF("Started the eth polling thread");

    while (!atomic_test_bit(&eth_thread_flags, ETH_THREAD_TERMINATION_FLAG)) {
        k_timepoint_t timepoint = sys_timepoint_calc(K_MSEC(CONFIG_ETH_POLL_PERIOD_MS));

        if (eth_poll() != 0) {
            LOG_ERR("Failed polling Ethernet."); // NOLINT
        }

        k_sleep(sys_timepoint_timeout(timepoint));
    }
}
```

## include/data.h
```c
/*
 * (C) Copyright 2026, SECO Mind Srl
 *
 * SPDX-License-Identifier: Apache-2.0
 */

#ifndef DATA_H
#define DATA_H

#include <astarte_device_sdk/data.h>
#include <astarte_device_sdk/interface.h>
#include <astarte_device_sdk/object.h>

#include "utilities.h"

void data_init(const astarte_interface_t *interfaces[], size_t interfaces_len);
size_t data_size(const astarte_interface_t *interfaces[], size_t interfaces_len);
const astarte_interface_t *data_get_interface(const char *interface_name, size_t len);
void data_free();

int data_add_individual(const astarte_interface_t *interface, const char *path,
    const astarte_data_t *data, const optional_int64_t *timestamp);
int data_add_object(const astarte_interface_t *interface, const char *path,
    const byte_array_t *value, astarte_object_entry_t *entries, size_t entries_length,
    const optional_int64_t *timestamp);
int data_add_set_property(
    const astarte_interface_t *interface, const char *path, const astarte_data_t *data);
int data_add_unset_property(const astarte_interface_t *interface, const char *path);

int data_expected_individual(
    const char *interface_name, const char *path, const astarte_data_t *data);
int data_expected_object(const char *interface_name, const char *path,
    const astarte_object_entry_t *entries, size_t entries_length);
int data_expected_set_property(
    const char *interface_name, const char *path, const astarte_data_t *data);
int data_expected_unset_property(const char *interface_name, const char *path);

#endif // DATA_H
```

## include/device_handler.h
```c
/*
 * (C) Copyright 2025, SECO Mind Srl
 *
 * SPDX-License-Identifier: Apache-2.0
 */

#ifndef DEVICE_HANDLER_H
#define DEVICE_HANDLER_H

#include <astarte_device_sdk/device.h>

#include "utilities.h"

void setup_device();
void free_device();
void wait_for_device_connection();
void disconnect_device();
void wait_for_device_disconnection();
uint64_t perfect_hash_device_interface(const char *interface_name, size_t len);

int device_send_individual(
    const char *interface_name, const char *path, astarte_data_t data, optional_int64_t timestamp);
int device_send_object(const char *interface_name, const char *path,
    astarte_object_entry_t *entries, size_t entries_len, optional_int64_t timestamp);
int device_set_property(const char *interface_name, const char *path, astarte_data_t data);
int device_unset_property(const char *interface_name, const char *path);

#endif /* DEVICE_HANDLER_H */
```

## include/e2edata.h
```c
/*
 * (C) Copyright 2024, SECO Mind Srl
 *
 * SPDX-License-Identifier: Apache-2.0
 */

#ifndef E2EDATA_H
#define E2EDATA_H

#include <zephyr/sys/util.h>

#include <astarte_device_sdk/individual.h>

#define BOOLEAN_DATA (true)
#define DATE_TIME_DATA (1710940988984)
#define DOUBLE_DATA (15.42)
#define INTEGER_DATA (42)
#define LONGINTEGER_DATA (8589934592)

static const uint8_t binary_blob_data[8] = { 0x53, 0x47, 0x56, 0x73, 0x62, 0x47, 0x38, 0x3d };
static const uint8_t binblob_1[8] = { 0x53, 0x47, 0x56, 0x73, 0x62, 0x47, 0x38, 0x3d };
static const uint8_t binblob_2[5] = { 0x64, 0x32, 0x39, 0x79, 0x62 };
static const uint8_t *const binary_blob_array_data[2] = { binblob_1, binblob_2 };
static const size_t binary_blob_array_sizes_data[2]
    = { ARRAY_SIZE(binblob_1), ARRAY_SIZE(binblob_2) };
static const bool boolean_array_data[3] = { true, false, true };
static const int64_t date_time_array_data[1] = { 1710940988984 };
static const double double_array_data[2] = { 1542.25, 88852.6 };
static const int32_t integer_array_data[3] = { 4525, 0, 11 };
static const int64_t longinteger_array_data[3] = { 8589930067, 42, 8589934592 };
static const char string_data[] = "Hello world!";
static const char *const string_array_data[2] = { "Hello ", "world!" };

#endif /* E2EDATA_H */
```

## include/e2erunner.h
```c
/*
 * (C) Copyright 2024, SECO Mind Srl
 *
 * SPDX-License-Identifier: Apache-2.0
 */

#ifndef E2ERUNNER_H
#define E2ERUNNER_H

#include <stdint.h>

#include <zephyr/sys/atomic_types.h>
#include <zephyr/sys/bitarray.h>

#include <astarte_device_sdk/device.h>
#include <astarte_device_sdk/individual.h>
#include <astarte_device_sdk/interface.h>
#include <astarte_device_sdk/object.h>
#include <astarte_device_sdk/util.h>

// Can be used to hold a timestamp and if it should be sent or not
typedef struct
{
    int64_t value;
    bool present;
} e2e_timestamp_option_t;

// Can be used to hold test data for an individual mapping
typedef struct
{
    const char *path;
    astarte_individual_t individual;
    e2e_timestamp_option_t timestamp;
} e2e_individual_data_t;

ASTARTE_UTIL_DEFINE_ARRAY(e2e_individual_data_array_t, const e2e_individual_data_t);

// Property data used to test astarte individual properties interfaces
typedef struct
{
    const char *path;
    astarte_individual_t individual;
    bool unset;
} e2e_property_data_t;

ASTARTE_UTIL_DEFINE_ARRAY(e2e_property_data_array_t, const e2e_property_data_t);

ASTARTE_UTIL_DEFINE_ARRAY(e2e_object_entry_array_t, const astarte_object_entry_t);

// Object data used to test astarte object aggregated interfaces
typedef struct
{
    const char *path;
    e2e_object_entry_array_t entries;
    e2e_timestamp_option_t timestamp;
} e2e_object_data_t;

// Interface definition used in the e2e test that contains the values and the definition of a
// specific interface. It also contains a `received` field that is used to verify that all the
// expected data got received.
typedef struct
{
    const astarte_interface_t *interface;
    union
    {
        e2e_individual_data_array_t individual;
        e2e_property_data_array_t property;
        e2e_object_data_t object;
    } values;
} e2e_interface_data_t;

ASTARTE_UTIL_DEFINE_ARRAY(e2e_interface_data_array_t, e2e_interface_data_t);

// Complete test data contains:
// - the interfaces that will be sent by the server and verified by the client
// - the interfaces that will be sent by the device and verified by the server
typedef struct
{
    e2e_interface_data_array_t device_sent;
    e2e_interface_data_array_t server_sent;
} e2e_test_data_t;

// function that sets up the test data and returns it
typedef e2e_test_data_t (*setup_test_data_fn_t)();

// complete device configuration for an instance of the test
typedef struct
{
    char device_id[ASTARTE_PAIRING_DEVICE_ID_LEN + 1];
    char cred_secr[ASTARTE_PAIRING_CRED_SECR_LEN + 1];
    setup_test_data_fn_t setup;
} e2e_device_config_t;

// run the e2e test on all test devices
void run_e2e_test();

#endif /* E2ERUNNER_H */
```

## include/e2eutilities.h
```c
/*
 * (C) Copyright 2024, SECO Mind Srl
 *
 * SPDX-License-Identifier: Apache-2.0
 */

#ifndef E2EUTILITIES_H
#define E2EUTILITIES_H

#include "astarte_device_sdk/interface.h"
#include "e2erunner.h"

#include <stdlib.h>

/**
 * @file e2eutilities.h
 * @brief Utilities needed in e2e tests
 */

#define CHECK_HALT(expr, ...)                                                                      \
    if (expr) {                                                                                    \
        LOG_ERR(__VA_ARGS__); /* NOLINT */                                                         \
        k_fatal_halt(-1);                                                                          \
    }

#define CHECK_ASTARTE_OK_HALT(expr, ...) CHECK_HALT(expr != ASTARTE_RESULT_OK, __VA_ARGS__)

// clang-format off
#define MAKE_ASTARTE_INDIVIDUAL_SCALAR(ENUM, PARAM, VALUE)                                         \
    (astarte_individual_t)                                                                         \
    {                                                                                              \
        .data = {                                                                                  \
            .PARAM = (VALUE),                                                                      \
        },                                                                                         \
        .tag = (ENUM), \
    }

#define MAKE_ASTARTE_INDIVIDUAL_ARRAY(ENUM, PARAM, ARRAY, LEN)                                     \
    (astarte_individual_t)                                                                         \
    {                                                                                              \
        .data = {                                                                                  \
            .PARAM = {                                                                             \
                .buf = (ARRAY),                                                                    \
                .len = (LEN),                                                                      \
            },                                                                                     \
        },                                                                                         \
        .tag = (ENUM), \
    }

#define MAKE_ASTARTE_INDIVIDUAL_BINARYBLOB_ARRAY(BLOBS, SIZES, COUNT)                              \
    (astarte_individual_t)                                                                         \
    {                                                                                              \
        .data = {                                                                                  \
            .binaryblob_array = {                                                                  \
                .blobs = (BLOBS),                                                                  \
                .sizes = (SIZES),                                                                  \
                .count = (COUNT),                                                                  \
            },                                                                                     \
        },                                                                                         \
        .tag = ASTARTE_MAPPING_TYPE_BINARYBLOBARRAY,                                               \
    }

// clang-format on

e2e_interface_data_t *get_e2e_interface_data(
    e2e_interface_data_array_t *interfaces_array, const char *interface_name);

const e2e_individual_data_t *get_e2e_individual_data(
    const e2e_individual_data_array_t *individuals_array, const char *path);

const astarte_object_entry_t *get_astarte_object_entry(
    const e2e_object_entry_array_t *entries_array, const char *path);

bool astarte_value_equal(astarte_individual_t *a, astarte_individual_t *b);

#endif /* E2EUTILITIES_H */
```

## include/idata.h
```c
/*
 * (C) Copyright 2024, SECO Mind Srl
 *
 * SPDX-License-Identifier: Apache-2.0
 */

#ifndef IDATA_H
#define IDATA_H

/**
 * @file idata.h
 * @brief Interface data (idata) stored in the e2e test to perform checks
 */

#include <zephyr/sys/dlist.h>

#include <astarte_device_sdk/data.h>
#include <astarte_device_sdk/interface.h>
#include <astarte_device_sdk/object.h>

#include "utilities.h"

// Individual data used to store expected values from astarte
typedef struct
{
    // the buffer will be freed by the idata free function
    const char *path;
    // the buffer will be freed by the idata free function
    astarte_data_t data;
    e2e_timestamp_option_t timestamp;
} e2e_individual_data_t;

// Property data used to store expected values from astarte
// if unset is true the data element will contain an invalid value
typedef struct
{
    // the buffer will be freed by the idata free function
    const char *path;
    // the buffer will be freed by the idata free function
    astarte_data_t data;
    bool unset;
} e2e_property_data_t;

// Object data used to store expected values from astarte
typedef struct
{
    // the buffer will be freed by the idata free function
    const char *path;
    // the buffer will be freed by the idata free function
    e2e_object_entry_array_t entries;
    // the buffer will be freed by the idata free function
    e2e_byte_array object_bytes;
    e2e_timestamp_option_t timestamp;
} e2e_object_data_t;

// Data expected in the e2e tests, this stuct identifies an atomic received piece of data
// In case of an individual or property interface this refers to a single individual value
// In case of an object interface to the whole aggregate
// The union follows the type and aggregation of the astarte interface struct
typedef struct
{
    const astarte_interface_t *interface;
    sys_dnode_t node;
    union
    {
        e2e_individual_data_t individual;
        e2e_property_data_t property;
        e2e_object_data_t object;
    } values;
} e2e_idata_unit_t;

void idata_unit_log(e2e_idata_unit_t *idata_unit);

// FIXME for now the order of insertion matters, it has to be the same as the order in which
// messages are received for now it is fixed by giving the user the ability to iterate through the
// matches still i could choose a better alternative
typedef struct
{
    sys_dlist_t *list;
} e2e_idata_t;

e2e_idata_t idata_init();
int idata_add_individual(e2e_idata_t *idata, const astarte_interface_t *interface,
    e2e_individual_data_t expected_individual);
int idata_add_property(e2e_idata_t *idata, const astarte_interface_t *interface,
    e2e_property_data_t expected_property);
int idata_add_object(
    e2e_idata_t *idata, const astarte_interface_t *interface, e2e_object_data_t expected_object);
// get functions, these fetch the next idata unit matching the passed interface name using the
// passed out_individual as starting point if out individual is null they return the first
// occurrence
int idata_get_individual(
    e2e_idata_t *idata, const char *interface, e2e_individual_data_t **out_individual);
int idata_get_property(
    e2e_idata_t *idata, const char *interface, e2e_property_data_t **out_property);
int idata_get_object(e2e_idata_t *idata, const char *interface, e2e_object_data_t **out_object);
bool idata_is_empty(e2e_idata_t *idata);
e2e_idata_unit_t *idata_iter(e2e_idata_t *idata);
e2e_idata_unit_t *idata_iter_next(e2e_idata_t *idata, e2e_idata_unit_t *current);
int idata_remove(e2e_idata_unit_t *idata_unit);
int idata_remove_individual(e2e_individual_data_t *individual);
int idata_remove_property(e2e_property_data_t *property);
int idata_remove_object(e2e_object_data_t *object);
void idata_free(e2e_idata_t idata);

#endif // IDATA_H
```

## include/individual_test.h
```c
/*
 * (C) Copyright 2024, SECO Mind Srl
 *
 * SPDX-License-Identifier: Apache-2.0
 */

#ifndef INDIVIDUAL_TEST_H
#define INDIVIDUAL_TEST_H

/**
 * @file datastream_test.h
 * @brief Datastream test functions
 */

#include "e2erunner.h"

e2e_device_config_t get_individual_test_config();

#endif /* INDIVIDUAL_TEST_H */
```

## include/object_test.h
```c
/*
 * (C) Copyright 2024, SECO Mind Srl
 *
 * SPDX-License-Identifier: Apache-2.0
 */

#ifndef OBJECT_TEST_H
#define OBJECT_TEST_H

/**
 * @file datastream_test.h
 * @brief Datastream test functions
 */

#include "e2erunner.h"

e2e_device_config_t get_object_test_config();

#endif /* OBJECT_TEST_H */
```

## include/property_test.h
```c
/*
 * (C) Copyright 2024, SECO Mind Srl
 *
 * SPDX-License-Identifier: Apache-2.0
 */

#ifndef PROPERTY_TEST_H
#define PROPERTY_TEST_H

/**
 * @file datastream_test.h
 * @brief Datastream test functions
 */

#include "e2erunner.h"

e2e_device_config_t get_property_test_config();

#endif /* PROPERTY_TEST_H */
```

## include/shell_macros.h
```c
/*
 * (C) Copyright 2025, SECO Mind Srl
 *
 * SPDX-License-Identifier: Apache-2.0
 */

#ifndef SHELL_MACROS_H
#define SHELL_MACROS_H

#define SHELL_IS_READY "dvcshellcmd Device shell ready"
#define SHELL_IS_CLOSING "dvcshellcmd Device shell closing"

#endif /* SHELL_MACROS_H */
```

## include/utilities.h
```c
/*
 * (C) Copyright 2024, SECO Mind Srl
 *
 * SPDX-License-Identifier: Apache-2.0
 */

#ifndef UTILITIES_H
#define UTILITIES_H

#include <stdint.h>

#include <zephyr/fatal.h>
#include <zephyr/shell/shell.h>

#include <astarte_device_sdk/data.h>
#include <astarte_device_sdk/interface.h>
#include <astarte_device_sdk/object.h>
#include <astarte_device_sdk/util.h>

#define CHECK_HALT(expr, ...)                                                                      \
    if (expr) {                                                                                    \
        LOG_ERR(__VA_ARGS__);                                                                      \
        k_fatal_halt(-1);                                                                          \
    }

#define CHECK_ASTARTE_OK_HALT(expr, ...) CHECK_HALT(expr != ASTARTE_RESULT_OK, __VA_ARGS__)

#define CHECK_RET_1(expr, ...)                                                                     \
    if (expr) {                                                                                    \
        __VA_OPT__(LOG_ERR(__VA_ARGS__));                                                          \
        return 1;                                                                                  \
    }

#define CHECK_ASTARTE_OK_RET_1(expr, ...) CHECK_RET_1(expr != ASTARTE_RESULT_OK, __VA_ARGS__)

#define CHECK_GOTO(expr, label, ...)                                                               \
    if (expr) {                                                                                    \
        LOG_ERR(__VA_ARGS__);                                                                      \
        goto label;                                                                                \
    }

#define CHECK_ASTARTE_OK_GOTO(expr, label, ...)                                                    \
    CHECK_GOTO(expr != ASTARTE_RESULT_OK, label, __VA_ARGS__)

typedef struct
{
    const uint8_t *buf;
    size_t len;
} byte_array_t;

typedef struct
{
    int64_t value;
    bool present;
} optional_int64_t;

bool astarte_data_are_equal(const astarte_data_t *left, const astarte_data_t *right);
bool astarte_objects_are_equal(const astarte_object_entry_t *left_entries,
    size_t left_entries_length, const astarte_object_entry_t *right_entries,
    size_t right_entries_length);

#endif /* UTILITIES_H */
```

## src/data.c
```c
/*
 * (C) Copyright 2026, SECO Mind Srl
 *
 * SPDX-License-Identifier: Apache-2.0
 */

#include "data.h"

#include <zephyr/logging/log.h>
#include <zephyr/sys/hash_map.h>
#include <zephyr/sys/hash_map_api.h>
#include <zephyr/sys/spsc_lockfree.h>

#include <data/deserialize.h>
#include <object_private.h>

#include "alloc.h"
#include "device_handler.h"
#include "utilities.h"

/************************************************
 *   Constants, static variables and defines    *
 ***********************************************/

LOG_MODULE_REGISTER(e2e_data, CONFIG_DATA_LOG_LEVEL);

enum message_type
{
    INDIVIDUAL,
    OBJECT,
    SET_PROPERTY,
    UNSET_PROPERTY,
};

typedef struct
{
    enum message_type type;
    const char *path;
    astarte_data_t data;
    byte_array_t raw_bson_data;
    astarte_object_entry_t *entries;
    size_t entries_length;
} message_t;

SPSC_DECLARE(messages, message_t);

typedef struct
{
    const astarte_interface_t *interface;
    struct spsc_messages messages;
    message_t messages_buf[2];
} map_value_t;

SYS_HASHMAP_DEFINE_STATIC(interface_map);

/************************************************
 *         Static functions declaration         *
 ***********************************************/

void free_map_entry_callback(uint64_t key, uint64_t value, void *cookie);

/************************************************
 *         Global functions definition          *
 ***********************************************/

void data_init(const astarte_interface_t *interfaces[], size_t interfaces_len)
{
    CHECK_HALT(
        !sys_hashmap_is_empty(&interface_map), "Attempting to initialize non empty device data");

    for (size_t i = 0; i < interfaces_len; ++i) {

        uint64_t key
            = perfect_hash_device_interface(interfaces[i]->name, strlen(interfaces[i]->name));

        map_value_t *value = astarte_calloc(1, sizeof(map_value_t));
        CHECK_HALT(!value, "Could not allocate value required memory");
        value->interface = interfaces[i];
        struct spsc_messages tmp_spsc
            = SPSC_INITIALIZER(ARRAY_SIZE(value->messages_buf), value->messages_buf);
        memcpy(&value->messages, &tmp_spsc, sizeof(struct spsc_messages));

        sys_hashmap_insert(&interface_map, key, POINTER_TO_UINT(value), NULL);
    }
}

void data_free()
{
    sys_hashmap_clear(&interface_map, free_map_entry_callback, NULL);
}

size_t data_size(const astarte_interface_t *interfaces[], size_t interfaces_len)
{
    size_t not_received_count = 0;
    LOG_INF("Checking remaining expected messagges");

    for (size_t i = 0; i < interfaces_len; ++i) {
        const astarte_interface_t *interface = interfaces[i];

        uint64_t key = perfect_hash_device_interface(interface->name, strlen(interface->name));
        uint64_t map_value_p = { 0 };

        CHECK_HALT(!sys_hashmap_get(&interface_map, key, &map_value_p),
            "Extracting data from an unknown interface");

        map_value_t *map_value = UINT_TO_POINTER(map_value_p);

        not_received_count += spsc_consumable(&map_value->messages);
    }

    LOG_INF("Count of expected messages: %zu", not_received_count);
    return not_received_count;
}

const astarte_interface_t *data_get_interface(const char *interface_name, size_t len)
{
    uint64_t key = perfect_hash_device_interface(interface_name, len);
    uint64_t value = { 0 };

    if (sys_hashmap_get(&interface_map, key, &value)) {
        map_value_t *map_value = UINT_TO_POINTER(value);
        return map_value->interface;
    }

    return NULL;
}

int data_add_individual(const astarte_interface_t *interface, const char *path,
    const astarte_data_t *data, const optional_int64_t *timestamp)
{
    uint64_t key = perfect_hash_device_interface(interface->name, strlen(interface->name));
    uint64_t map_value_p = 0;

    if (!sys_hashmap_get(&interface_map, key, &map_value_p)) {
        LOG_ERR("Adding data from an unknown interface");
        return 1;
    }

    map_value_t *map_value = UINT_TO_POINTER(map_value_p);

    message_t *message = spsc_acquire(&map_value->messages);
    CHECK_RET_1(message == NULL, "Space for expected messages is exhausted");
    message->type = INDIVIDUAL;
    message->path = path;
    message->data = *data;
    spsc_produce(&map_value->messages);

    LOG_INF("Added individual to the expected list.");

    return 0;
}

int data_add_object(const astarte_interface_t *interface, const char *path,
    const byte_array_t *value, astarte_object_entry_t *entries, size_t entries_length,
    const optional_int64_t *timestamp)
{
    uint64_t key = perfect_hash_device_interface(interface->name, strlen(interface->name));
    uint64_t map_value_p = 0;

    if (!sys_hashmap_get(&interface_map, key, &map_value_p)) {
        LOG_ERR("Adding data from an unknown interface");
        return 1;
    }

    map_value_t *map_value = UINT_TO_POINTER(map_value_p);

    message_t *message = spsc_acquire(&map_value->messages);
    CHECK_RET_1(message == NULL, "Space for expected messages is exhausted");
    message->type = OBJECT;
    message->path = path;
    // The object data has been deserialized into object entries.
    // However, for the objects the deserialization is partially performed shallowly.
    // As a consequence the original raw bson should be preserved.
    // This is not an issue for individuals and properties, where the deserialization is complete
    // and the original bson can be discarded.
    message->raw_bson_data = *value;
    message->entries = entries;
    message->entries_length = entries_length;
    spsc_produce(&map_value->messages);

    LOG_INF("Added object to the expected list.");

    return 0;
}

int data_add_set_property(
    const astarte_interface_t *interface, const char *path, const astarte_data_t *data)
{
    uint64_t key = perfect_hash_device_interface(interface->name, strlen(interface->name));
    uint64_t map_value_p = { 0 };

    if (!sys_hashmap_get(&interface_map, key, &map_value_p)) {
        LOG_ERR("Adding data from an unknown interface");
        return 1;
    }

    map_value_t *map_value = UINT_TO_POINTER(map_value_p);

    message_t *message = spsc_acquire(&map_value->messages);
    CHECK_RET_1(message == NULL, "Space for expected messages is exhausted");
    message->type = SET_PROPERTY;
    message->path = path;
    message->data = *data;
    spsc_produce(&map_value->messages);

    LOG_INF("Added set property to the expected list.");

    return 0;
}

int data_add_unset_property(const astarte_interface_t *interface, const char *path)
{
    uint64_t key = perfect_hash_device_interface(interface->name, strlen(interface->name));
    uint64_t map_value_p = { 0 };

    if (!sys_hashmap_get(&interface_map, key, &map_value_p)) {
        LOG_ERR("Adding data from an unknown interface");
        return 1;
    }

    map_value_t *map_value = UINT_TO_POINTER(map_value_p);

    message_t *message = spsc_acquire(&map_value->messages);
    CHECK_RET_1(message == NULL, "Space for expected messages is exhausted");
    message->type = UNSET_PROPERTY;
    message->path = path;
    spsc_produce(&map_value->messages);

    LOG_INF("Added unset property to the expected list.");

    return 0;
}

int data_expected_individual(
    const char *interface_name, const char *path, const astarte_data_t *data)
{
    uint64_t key = perfect_hash_device_interface(interface_name, strlen(interface_name));
    uint64_t map_value_p = { 0 };

    if (!sys_hashmap_get(&interface_map, key, &map_value_p)) {
        LOG_ERR("Extracting data from an unknown interface");
        return 1;
    }

    map_value_t *map_value = UINT_TO_POINTER(map_value_p);

    message_t *expected = spsc_peek(&map_value->messages);
    CHECK_RET_1(expected == NULL, "No more expected messages");

    CHECK_RET_1(
        expected->type != INDIVIDUAL, "Expected an individual but got a different message type");
    CHECK_RET_1(strcmp(expected->path, path) != 0, "Received path does not match expected one");

    // Compare the expected message payload with the received one
    CHECK_RET_1(!astarte_data_are_equal(&expected->data, data), "Unexpected element received");

    astarte_free((char *) expected->path);
    astarte_data_destroy_deserialized(expected->data);

    (void *) spsc_consume(&map_value->messages);
    spsc_release(&map_value->messages);

    LOG_INF("Individual received matched expected one");
    return 0;
}

int data_expected_object(const char *interface_name, const char *path,
    const astarte_object_entry_t *entries, size_t entries_length)
{
    uint64_t key = perfect_hash_device_interface(interface_name, strlen(interface_name));
    uint64_t map_value_p = { 0 };

    if (!sys_hashmap_get(&interface_map, key, &map_value_p)) {
        LOG_ERR("Extracting data from an unknown interface");
        return 1;
    }

    map_value_t *map_value = UINT_TO_POINTER(map_value_p);

    message_t *expected = spsc_peek(&map_value->messages);
    CHECK_RET_1(expected == NULL, "No more expected messages");
    CHECK_RET_1(expected->type != OBJECT, "Expected an object but got a different message type");
    CHECK_RET_1(strcmp(expected->path, path) != 0, "Received path does not match expected one");
    // Compare the expected message payload with the received one
    CHECK_RET_1(!astarte_objects_are_equal(
                    expected->entries, expected->entries_length, entries, entries_length),
        "Unexpected element received");

    astarte_free((char *) expected->path);
    astarte_free((void *) expected->raw_bson_data.buf);
    astarte_object_entries_destroy_deserialized(expected->entries, expected->entries_length);

    (void *) spsc_consume(&map_value->messages);
    spsc_release(&map_value->messages);

    LOG_INF("Object received matched expected one");
    return 0;
}

int data_expected_set_property(
    const char *interface_name, const char *path, const astarte_data_t *data)
{
    uint64_t key = perfect_hash_device_interface(interface_name, strlen(interface_name));
    uint64_t map_value_p = { 0 };

    if (!sys_hashmap_get(&interface_map, key, &map_value_p)) {
        LOG_ERR("Extracting data from an unknown interface");
        return 1;
    }

    map_value_t *map_value = UINT_TO_POINTER(map_value_p);

    message_t *expected = spsc_peek(&map_value->messages);
    CHECK_RET_1(expected == NULL, "No more expected messages");

    CHECK_RET_1(expected->type != SET_PROPERTY,
        "Expected an set property but got a different message type");
    CHECK_RET_1(strcmp(expected->path, path) != 0, "Received path does not match expected one");

    // Compare the expected message payload with the received one
    CHECK_RET_1(!astarte_data_are_equal(&expected->data, data), "Unexpected element received");

    astarte_free((char *) expected->path);
    astarte_data_destroy_deserialized(expected->data);

    (void *) spsc_consume(&map_value->messages);
    spsc_release(&map_value->messages);

    LOG_INF("Set property received matched expected one");
    return 0;
}

int data_expected_unset_property(const char *interface_name, const char *path)
{
    uint64_t key = perfect_hash_device_interface(interface_name, strlen(interface_name));
    uint64_t map_value_p = { 0 };

    if (!sys_hashmap_get(&interface_map, key, &map_value_p)) {
        LOG_ERR("Extracting data from an unknown interface");
        return 1;
    }

    map_value_t *map_value = UINT_TO_POINTER(map_value_p);

    message_t *expected = spsc_peek(&map_value->messages);
    CHECK_RET_1(expected == NULL, "No more expected messages");

    CHECK_RET_1(expected->type != UNSET_PROPERTY,
        "Expected an unset property but got a different message type");
    CHECK_RET_1(strcmp(expected->path, path) != 0, "Received path does not match expected one");

    astarte_free((char *) expected->path);

    (void *) spsc_consume(&map_value->messages);
    spsc_release(&map_value->messages);

    LOG_INF("Set property received matched expected one");
    return 0;
}

/************************************************
 *         Static functions definitions         *
 ***********************************************/

void free_map_entry_callback(uint64_t key, uint64_t value, void *cookie)
{
    map_value_t *map_value = UINT_TO_POINTER(value);

    for (message_t *message; (message = spsc_consume(&map_value->messages)) != NULL;) {
        astarte_free((char *) message->path);
        if ((message->type == INDIVIDUAL) || (message->type == SET_PROPERTY)) {
            astarte_data_destroy_deserialized(message->data);
        } else if (message->type == OBJECT) {
            astarte_free((void *) message->raw_bson_data.buf);
            astarte_object_entries_destroy_deserialized(message->entries, message->entries_length);
        }
        spsc_release(&map_value->messages);
    }

    astarte_free(map_value);
}
```

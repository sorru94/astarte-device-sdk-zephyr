## e2e/testcase.yaml
```yaml
# (C) Copyright 2024-2025, SECO Mind Srl
#
# SPDX-License-Identifier: Apache-2.0

tests:
  astarte_device_sdk.e2e:
    filter: CONFIG_SERIAL and dt_chosen_enabled("zephyr,shell-uart")
    harness: pytest
    extra_configs:
      - arch:posix:CONFIG_NATIVE_UART_0_ON_STDINOUT=y
    harness_config:
      pytest_dut_scope: "session"
    timeout: 300
    platform_allow: [native_sim]
    integration_platforms: [native_sim]
    tags:
      - e2e
      - pytest
```

## lib/Kconfig
```kconfig
# (C) Copyright 2024, SECO Mind Srl
#
# SPDX-License-Identifier: Apache-2.0

menu "Astarte device SDK"

rsource "astarte_device_sdk/Kconfig"

endmenu
```

## lib/astarte_device_sdk/Kconfig
```kconfig
# (C) Copyright 2024, SECO Mind Srl
#
# SPDX-License-Identifier: Apache-2.0

config ASTARTE_DEVICE_SDK
	bool "Astarte device SDK"
	depends on JSON_LIBRARY
	depends on HTTP_CLIENT
	depends on NET_SOCKETS
	depends on DNS_RESOLVER
	depends on NETWORKING
	depends on MBEDTLS
	depends on MQTT_LIB
	depends on MQTT_LIB_TLS
	depends on BASE64
	depends on SYS_HASH_MAP
	depends on SYS_HASH_FUNC32
	select ZLIB
	help
	  This option enables the Astarte device SDK library

config ASTARTE_DEVICE_SDK_PAIRING_JWT
	string "JWT to be used when registering a new device"
	depends on ASTARTE_DEVICE_SDK
	help
	  This option should be set to a valid value when using the pairing API to register a new
	  device.

config ASTARTE_DEVICE_SDK_HOSTNAME
	string "Hostname for the Astarte APIs"
	depends on ASTARTE_DEVICE_SDK
	help
	  This hostname will be solved using a DNS to the IP address of the Astarte instance.

config ASTARTE_DEVICE_SDK_HTTPS_CA_CERT_TAG
	int "HTTPs CA root certificate TLS security tag"
	depends on ASTARTE_DEVICE_SDK
	depends on !ASTARTE_DEVICE_SDK_DEVELOP_USE_NON_TLS_HTTP
	help
	  This tag will be used for all HTTPs connections within the Astarte device.
	  A CA certificate should be added by the user with the tls_credential_add function.
	  Set this option to the tag used when adding the CA certificate.

config ASTARTE_DEVICE_SDK_MQTTS_CA_CERT_TAG
	int "MQTTs CA root certificate TLS security tag"
	depends on ASTARTE_DEVICE_SDK
	depends on !ASTARTE_DEVICE_SDK_DEVELOP_USE_NON_TLS_MQTT
	help
	  This tag will be used for all MQTTs connections within the Astarte device.
	  A CA certificate should be added by the user with the tls_credential_add function.
	  Set this option to the tag used when adding the CA certificate.

config ASTARTE_DEVICE_SDK_MQTT_MAX_MSG_SIZE
	int "Maximum message size for MQTT message"
	depends on ASTARTE_DEVICE_SDK
	default 4096
	help
	  Change this value to enable longer MQTT messages to be transmitted and received.

config ASTARTE_DEVICE_SDK_CLIENT_CERT_TAG
	int "TLS security tag for client certificate"
	depends on ASTARTE_DEVICE_SDK
	help
	  The Astarte device SDK will use this TLS security tag to add the client certificate to
	  Zephyr's cretentials.

config ASTARTE_DEVICE_SDK_REALM_NAME
	string "Realm name"
	depends on ASTARTE_DEVICE_SDK
	help
	  Astarte realm name where to connect the device.

config ASTARTE_DEVICE_SDK_RECONNECTION_MQTT_BACKOFF_INITIAL_MS
	int "MQTT reconnection backoff initial delay (ms)"
	depends on ASTARTE_DEVICE_SDK
	default 1000
	help
	  This configuration setting will define an initial delay for the MQTT reconnection backoff
	  strategy.

config ASTARTE_DEVICE_SDK_RECONNECTION_MQTT_BACKOFF_MAX_MS
	int "MQTT reconnection backoff maximum delay (ms)"
	depends on ASTARTE_DEVICE_SDK
	default 60000
	help
	  This configuration setting will define the maximum delay for the MQTT reconnection backoff
	  strategy.

config ASTARTE_DEVICE_SDK_RECONNECTION_ASTARTE_BACKOFF_INITIAL_MS
	int "Astarte reconnection backoff initial delay (ms)"
	depends on ASTARTE_DEVICE_SDK
	default 1000
	help
	  This configuration setting will define an initial delay for the reconnection backoff strategy
	  to Astarte. This backoff strategy will be used when there is no MQTT error but the handshake
	  with Astarte has failed.

config ASTARTE_DEVICE_SDK_RECONNECTION_ASTARTE_BACKOFF_MAX_MS
	int "Astarte reconnection backoff maximum delay (ms)"
	depends on ASTARTE_DEVICE_SDK
	default 60000
	help
	  This configuration setting will define the maximum delay for the reconnection backoff
	  strategy to Astarte. This backoff strategy will be used when there is no MQTT error but the
	  handshake with Astarte has failed.

config ASTARTE_DEVICE_SDK_PERMANENT_STORAGE
	bool "Permanent storage for Astarte device"
	depends on ASTARTE_DEVICE_SDK
	depends on FLASH
	depends on FLASH_MAP
	depends on FLASH_PAGE_LAYOUT
	depends on NVS
	default y
	help
	  This option enables the permanent storage in for the Astarte device.
	  It requires a partition to be present in flash with the exact name 'astarte_partition'.

menu "Development options"

config ASTARTE_DEVICE_SDK_DEVELOP_USE_NON_TLS_HTTP
	bool "Disable TLS for all HTTP requests"
	depends on ASTARTE_DEVICE_SDK
	default false
	help
	  Enable this option to connect to a local Astarte instance.
	  With this option enabled all HTTP(s) operations will be performed over an unsecure channel,
	  without TLS.

	  Should be used only for development purposes as it's highly unsafe.

config ASTARTE_DEVICE_SDK_DEVELOP_USE_NON_TLS_MQTT
	bool "Disable TLS for all MQTT connections"
	depends on ASTARTE_DEVICE_SDK
	default false
	help
	  Enable this option to connect to a local Astarte instance.
	  With this option enabled all MQTT(s) operations will still be perfomed using mutual TLS
	  authentication. However, any error related the server certificate will be ignored.

	  Should be used only for development purposes as it's highly unsafe.

endmenu

menu "Advanced options"

config ASTARTE_DEVICE_SDK_ADVANCED_HTTP_RCV_BUFFER_SIZE
	int "Receive buffer size for HTTP requests"
	depends on ASTARTE_DEVICE_SDK
	default 4096
	help
	  Use this option to increase/decrease the receive buffer size for http requests.

config ASTARTE_DEVICE_SDK_ADVANCED_CLIENT_CRT_BUFFER_SIZE
	int "Buffer size for client TLS certificate"
	depends on ASTARTE_DEVICE_SDK
	default 2048
	help
	  Use this option to increase/decrease the buffer size where the TLS client certificate is
	  stored.

config ASTARTE_DEVICE_SDK_ADVANCED_MQTT_CACHING_HASMAPS_SIZE
	int "Maximum size for the MQTT caching hashmaps"
	depends on ASTARTE_DEVICE_SDK
	default 100
	help
	  Sets the maximum size for the MQTT caching hashmaps. The caching hashmaps are used to retain
	  messages for QoS higher than 0 in order to enable retransmission and avoid duplication.
	  Three caching hashmaps are present, one for subscription messages, one for incoming publish
	  messages and the last one for outgoing publish messages.
	  Increase this value when sending/receiving large bursts of messages with high QoS on slow
	  networks.

menu "Code generation"

config ASTARTE_DEVICE_SDK_ADVANCED_CODE_GENERATION
	bool "Enable build time interface code generation"
	depends on ASTARTE_DEVICE_SDK
	default n
	help
		Enables the automatic code generation of interfaces data structures.
		This generation is tied with the build of the project and every time you change the jsons you
		can re-run the build or build with target `astarte_generate_interfaces` like the following example:
		`west build -t astarte_generate_interfaces`.

config ASTARTE_DEVICE_SDK_ADVANCED_CODE_GENERATION_INTERFACE_DIRECTORY
	string "Path to the interface json directory"
	depends on ASTARTE_DEVICE_SDK_ADVANCED_CODE_GENERATION
	help
		This must be set to the path of a directory containing valid interface jsons.
		Generated interfaces may then be included by adding `#include "astarte_generated_interfaces.h"`.

endmenu

endmenu

menu "Logging options"

module = ASTARTE_DEVICE_SDK_PAIRING
module-str = Log level for Astarte device SDK pairing utilities
module-help = Sets log level for Astarte device SDK pairing utilities.
source "subsys/logging/Kconfig.template.log_config"

module = ASTARTE_DEVICE_SDK_CRYPTO
module-str = Log level for Astarte device SDK certificate generation suite
module-help = Sets log level for Astarte device SDK certificate generation suite.
source "subsys/logging/Kconfig.template.log_config"

module = ASTARTE_DEVICE_SDK_HTTP
module-str = Log level for Astarte device SDK connectivity utilities
module-help = Sets log level for Astarte device SDK connectivity utilities.
source "subsys/logging/Kconfig.template.log_config"

module = ASTARTE_DEVICE_SDK_DEVICE
module-str = Log level for Astarte device SDK device
module-help = Sets log level for Astarte device SDK device.
source "subsys/logging/Kconfig.template.log_config"

module = ASTARTE_DEVICE_SDK_DEVICE_CACHING
module-str = Log level for Astarte device SDK device caching
module-help = Sets log level for Astarte device SDK device caching.
source "subsys/logging/Kconfig.template.log_config"

module = ASTARTE_DEVICE_SDK_UUID
module-str = Log level for Astarte device SDK UUID generation utilities
module-help = Sets log level for Astarte device SDK UUID generation utilities.
source "subsys/logging/Kconfig.template.log_config"

module = ASTARTE_DEVICE_SDK_BSON
module-str = Log level for Astarte device SDK BSON generation utilities
module-help = Sets log level for Astarte device SDK BSON generation utilities.
source "subsys/logging/Kconfig.template.log_config"

module = ASTARTE_DEVICE_SDK_INTROSPECTION
module-str = Log level for Astarte device SDK introspection
module-help = Sets log level for Astarte device SDK introspection.
source "subsys/logging/Kconfig.template.log_config"

module = ASTARTE_DEVICE_SDK_INDIVIDUAL
module-str = Log level for Astarte device SDK individual
module-help = Sets log level for Astarte device SDK individual.
source "subsys/logging/Kconfig.template.log_config"

module = ASTARTE_DEVICE_SDK_OBJECT
module-str = Log level for Astarte device SDK object
module-help = Sets log level for Astarte device SDK object.
source "subsys/logging/Kconfig.template.log_config"

module = ASTARTE_DEVICE_SDK_MAPPING
module-str = Log level for Astarte device SDK mapping
module-help = Sets log level for Astarte device SDK mapping.
source "subsys/logging/Kconfig.template.log_config"

module = ASTARTE_DEVICE_SDK_MQTT
module-str = Log level for Astarte device SDK MQTT wrapper
module-help = Sets log level for Astarte device SDK MQTT wrapper.
source "subsys/logging/Kconfig.template.log_config"

module = ASTARTE_DEVICE_SDK_TLS_CREDENTIALS
module-str = Log level for Astarte device SDK tls credentials wrapper
module-help = Sets log level for Astarte device SDK tls credentials wrapper.
source "subsys/logging/Kconfig.template.log_config"

module = ASTARTE_DEVICE_SDK_KV_STORAGE
module-str = Log level for Astarte device SDK key-value storage
module-help = Sets log level for Astarte device SDK key-value storage.
source "subsys/logging/Kconfig.template.log_config"

module = ASTARTE_DEVICE_SDK_DEVICE_RX
module-str = Log level for Astarte device SDK device reception
module-help = Sets log level for Astarte device SDK device reception.
source "subsys/logging/Kconfig.template.log_config"

module = ASTARTE_DEVICE_SDK_DEVICE_TX
module-str = Log level for Astarte device SDK device transmission
module-help = Sets log level for Astarte device SDK device transmission.
source "subsys/logging/Kconfig.template.log_config"

module = ASTARTE_DEVICE_SDK_DEVICE_CONNECTION
module-str = Log level for Astarte device SDK device connection
module-help = Sets log level for Astarte device SDK device connection.
source "subsys/logging/Kconfig.template.log_config"

module = ASTARTE_DEVICE_SDK_DEVICE_ID
module-str = Log level for Astarte device SDK device ID
module-help = Sets log level for Astarte device SDK device ID.
source "subsys/logging/Kconfig.template.log_config"

endmenu
```

## samples/astarte_app/boards/mimxrt1060_evk_mimxrt1062_qspi_B.conf
```kconfig
# (C) Copyright 2024, SECO Mind Srl
#
# SPDX-License-Identifier: Apache-2.0

# Disable Astarte permanent storage for this board as no dedicated partition is present
CONFIG_ASTARTE_DEVICE_SDK_PERMANENT_STORAGE=n
# Since there is no permanent storage, properties are of little use on this board
# Enabling transmission works but no value will be saved locally
CONFIG_DEVICE_PROPERTY_SET_TRANSMISSION=n
CONFIG_DEVICE_PROPERTY_UNSET_TRANSMISSION=n

# Use a large log buffer size
CONFIG_LOG_BUFFER_SIZE=32768
```

## samples/astarte_app/boards/nrf7002dk_nrf5340_cpuapp.conf
```kconfig
# (C) Copyright 2024, SECO Mind Srl
#
# SPDX-License-Identifier: Apache-2.0

# Use a small log buffer size
CONFIG_LOG_BUFFER_SIZE=8192

# Disable Astarte permanent storage for this board as no dedicated partition is present
CONFIG_ASTARTE_DEVICE_SDK_PERMANENT_STORAGE=n
# Since there is no permanent storage, properties are of little use on this board
# Enabling transmission works but no value will be saved locally
CONFIG_DEVICE_PROPERTY_SET_TRANSMISSION=n
CONFIG_DEVICE_PROPERTY_UNSET_TRANSMISSION=n

# TODO substitute this with a real randomness source
CONFIG_TEST_RANDOM_GENERATOR=y

# Config WiFi for this board
CONFIG_WIFI=y

# Disable crc32 in zlib to avoid conflicts
CONFIG_ZLIB_NO_CRC32=y
```

## tests/lib/astarte_device_sdk/integration/device_caching/testcase.yaml
```yaml
# (C) Copyright 2024, SECO Mind Srl
#
# SPDX-License-Identifier: Apache-2.0

tests:
  lib.astarte_device_sdk.integration.device_caching:
    tags: astarte_device_sdk
    platform_allow:
      - native_sim
    integration_platforms:
      - native_sim
```

## tests/lib/astarte_device_sdk/integration/key_value/testcase.yaml
```yaml
# (C) Copyright 2026, SECO Mind Srl
#
# SPDX-License-Identifier: Apache-2.0

tests:
  lib.astarte_device_sdk.integration.astarte_key_value:
    tags: astarte_device_sdk
    platform_allow:
      - native_sim
      - frdm_rw612
    integration_platforms:
      - native_sim
      - frdm_rw612
```

## tests/lib/astarte_device_sdk/integration/testcase.yaml
```yaml
# (C) Copyright 2024, SECO Mind Srl
#
# SPDX-License-Identifier: Apache-2.0

tests:
  lib.astarte_device_sdk.integration:
    tags: astarte_device_sdk
    integration_platforms:
      - native_sim
```

## tests/lib/astarte_device_sdk/unit/bson/testcase.yaml
```yaml
# (C) Copyright 2024, SECO Mind Srl
#
# SPDX-License-Identifier: Apache-2.0

tests:
  lib.astarte_device_sdk.unit.bson:
    tags: astarte_device_sdk
    type: unit
```

## tests/lib/astarte_device_sdk/unit/interface/testcase.yaml
```yaml
# (C) Copyright 2024, SECO Mind Srl
#
# SPDX-License-Identifier: Apache-2.0

tests:
  lib.astarte_device_sdk.unit.interface:
    tags: astarte_device_sdk
    type: unit
```

## west.yml
```yaml
# (C) Copyright 2024, SECO Mind Srl
#
# SPDX-License-Identifier: Apache-2.0

manifest:
  self:
    west-commands: scripts/west-commands.yml

  remotes:
    - name: zephyrproject-rtos
      url-base: https://github.com/zephyrproject-rtos
    - name: secomind
      url-base: https://github.com/secomind

  projects:
    - name: zephyr
      remote: zephyrproject-rtos
      revision: v4.4.1
      import: true
```

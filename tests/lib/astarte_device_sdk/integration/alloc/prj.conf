## CMakeLists.txt
```
# (C) Copyright 2024, SECO Mind Srl
#
# SPDX-License-Identifier: Apache-2.0

cmake_minimum_required(VERSION 3.20.0)
find_package(Zephyr REQUIRED HINTS $ENV{ZEPHYR_BASE})
project(astarte_device_sdk_integration_alloc)

target_include_directories(app PRIVATE
    ${ZEPHYR_BASE}/../astarte-device-sdk-zephyr/lib/astarte_device_sdk/include
)

FILE(GLOB app_sources src/*.c)
target_sources(app PRIVATE ${app_sources})
```

## prj.conf
```kconfig
# (C) Copyright 2024, SECO Mind Srl
#
# SPDX-License-Identifier: Apache-2.0

CONFIG_ZTEST=y

# Enable custom heap
CONFIG_ASTARTE_DEVICE_SDK_ENABLE_HEAP=y

# Enable scoped cleanup helpers
CONFIG_SCOPE_CLEANUP_HELPERS=y

# This is necessary to check if the sdk allocates on a different heap than the dedicated one
CONFIG_HEAP_MEM_POOL_SIZE=0
CONFIG_HEAP_MEM_POOL_IGNORE_MIN=y

CONFIG_ASTARTE_DEVICE_SDK_PERMANENT_STORAGE=n

CONFIG_ENTROPY_GENERATOR=y
CONFIG_TEST_RANDOM_GENERATOR=y
CONFIG_LOG=y
CONFIG_TEST_LOGGING_DEFAULTS=n

CONFIG_TLS_CREDENTIALS=y

# Base MbedTLS & heap configuration
CONFIG_MBEDTLS=y
CONFIG_MBEDTLS_BUILTIN=y
CONFIG_MBEDTLS_ENABLE_HEAP=y
CONFIG_MBEDTLS_HEAP_SIZE=55000

# Enable PSA Crypto Backend
CONFIG_PSA_CRYPTO=y
CONFIG_PSA_CRYPTO_ENABLE_ALL=y
CONFIG_MBEDTLS_PSA_CRYPTO_C=y

# TLS & X.509
CONFIG_MBEDTLS_SSL_MAX_CONTENT_LEN=8192
CONFIG_MBEDTLS_PEM_PARSE_C=y
CONFIG_MBEDTLS_PEM_WRITE_C=y
CONFIG_MBEDTLS_BASE64_C=y
CONFIG_MBEDTLS_PK_WRITE_C=y
CONFIG_MBEDTLS_SSL_PROTO_TLS1_2=y
CONFIG_MBEDTLS_SSL_SERVER_NAME_INDICATION=y
CONFIG_MBEDTLS_X509_USE_C=y
CONFIG_MBEDTLS_X509_CRT_PARSE_C=y
CONFIG_MBEDTLS_X509_CRL_PARSE_C=y
CONFIG_MBEDTLS_X509_CSR_PARSE_C=y
CONFIG_MBEDTLS_X509_CSR_WRITE_C=y
CONFIG_MBEDTLS_PKCS5_C=y
CONFIG_MBEDTLS_KEY_EXCHANGE_ECDHE_ECDSA_ENABLED=y
CONFIG_MBEDTLS_KEY_EXCHANGE_ECDHE_RSA_ENABLED=y

# Astarte device SDK
CONFIG_ASTARTE_DEVICE_SDK=y
CONFIG_ASTARTE_DEVICE_SDK_HOSTNAME="."
CONFIG_ASTARTE_DEVICE_SDK_HTTPS_CA_CERT_TAG=1
CONFIG_ASTARTE_DEVICE_SDK_MQTTS_CA_CERT_TAG=1
CONFIG_ASTARTE_DEVICE_SDK_CLIENT_CERT_TAG=2
CONFIG_ASTARTE_DEVICE_SDK_PAIRING_JWT=""
CONFIG_ASTARTE_DEVICE_SDK_REALM_NAME="."

# Use picolib
CONFIG_PICOLIBC_USE_MODULE=y
CONFIG_PICOLIBC=y

# Enable networking
CONFIG_NETWORKING=y

# Enable HTTP client
CONFIG_HTTP_CLIENT=y

# MQTT options
CONFIG_MQTT_LIB=y
CONFIG_MQTT_LIB_TLS=y
CONFIG_MQTT_KEEPALIVE=60

# Enable base64 encoding and decoding
CONFIG_BASE64=y

# Enable system hashmaps
CONFIG_SYS_HASH_MAP=y

# Enable JSON library
CONFIG_JSON_LIBRARY=y

# Enable entropy generator
CONFIG_ENTROPY_GENERATOR=y

# DNS resolver
CONFIG_DNS_RESOLVER=y

# Enable UUID
CONFIG_UUID=y
CONFIG_UUID_V4=y
CONFIG_UUID_V5=y
CONFIG_UUID_BASE64=y

# Enable events
CONFIG_EVENTS=y
```

## src/main.c
```c
/*
 * (C) Copyright 2026, SECO Mind Srl
 *
 * SPDX-License-Identifier: Apache-2.0
 */

#include <zephyr/ztest.h>

#include "backoff.h"

#include "astarte_device_sdk/device.h"

#include <errno.h>

ZTEST_SUITE(astarte_device_sdk_backoff, NULL, NULL, NULL, NULL, NULL);

ZTEST(astarte_device_sdk_backoff, test_correct_allocation)
{
    astarte_device_config_t device_config = { 0 };
    astarte_device_handle_t device = NULL;

    // Even with an empty config, the device_new function should allocate some space on the heap.
    // Since CONFIG_HEAP_MEM_POOL_SIZE is set to 0, if this test succeeds it means it allocated only
    // on the custom heap, not on the default one.
    zassert_not_equal(ASTARTE_RESULT_OK, astarte_device_new(&device_config, &device),
        "Astarte device creation failure.");
    zassert_equal(ASTARTE_RESULT_OK, astarte_device_destroy(device),
        "Astarte device destroy should safely handle NULL.");
}
```

## Kconfig
```
# (C) Copyright 2024, SECO Mind Srl
#
# SPDX-License-Identifier: Apache-2.0
#
# This file is the application Kconfig entry point. All application Kconfig
# options can be defined here or included via other application Kconfig files.
# You can browse these options using the west targets menuconfig (terminal) or
# guiconfig (GUI).

menu "Zephyr"
source "Kconfig.zephyr"
endmenu

rsource "../../Kconfig"

menu "Sample application"
config SLEEP_MS
    int "Sleeping milliseconds"
    default 1000
    help
        The sleeping time used in the sample application.
endmenu

module = APP
module-str = APP
source "subsys/logging/Kconfig.template.log_config"
```

## prj.conf
```kconfig
# (C) Copyright 2024, SECO Mind Srl
#
# SPDX-License-Identifier: Apache-2.0
#
# This is a Kconfig fragment which can be used to enable debug-related options
# in the application. See the README for more details.

# compiler
CONFIG_DEBUG_OPTIMIZATIONS=y

# console
CONFIG_CONSOLE=y

# UART console
CONFIG_SERIAL=y
CONFIG_UART_CONSOLE=y

# logging
CONFIG_LOG=y
CONFIG_APP_LOG_LEVEL_DBG=y

# custom library
CONFIG_ASTARTE_DEVICE_SDK=y

# sample configuration
CONFIG_SLEEP_MS=1500

# (debug) logging for Astarte SDK
CONFIG_ASTARTE_DEVICE_SDK_BSON_LOG_LEVEL_DBG=y
```

## src/main.c
```c
/*
 * (C) Copyright 2024, SECO Mind Srl
 *
 * SPDX-License-Identifier: Apache-2.0
 */

#include <zephyr/kernel.h>

#include <zephyr/logging/log.h>
LOG_MODULE_REGISTER(main, CONFIG_APP_LOG_LEVEL); // NOLINT

int main(void)
{
    while (1) {
        LOG_INF("Hello world! %s\n", CONFIG_BOARD); // NOLINT
        k_msleep(CONFIG_SLEEP_MS); // sleep for 1 second
    }
    return 0;
}
```

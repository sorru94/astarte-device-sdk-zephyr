## Kconfig
```
# (C) Copyright 2024, SECO Mind Srl
#
# SPDX-License-Identifier: Apache-2.0

config WIFI_SSID
    string "WiFi SSID"
    default "myssid"
    help
        SSID (network name) for the example to connect to.

config WIFI_PASSWORD
    string "WiFi Password"
    default "mypassword"
    help
        WiFi password (WPA or WPA2) for the example to use.
```

## prj.conf
```kconfig
# (C) Copyright 2024, SECO Mind Srl
#
# SPDX-License-Identifier: Apache-2.0
#
# This is a Kconfig fragment which can be used to enable debug-related options
# in the application. See the README for more details.

# Enable logging with floating point support
CONFIG_LOG=y
CONFIG_CBPRINTF_FP_SUPPORT=y

# Enable base64 encoding and decoding
CONFIG_BASE64=y

# Enable system hashmaps
CONFIG_SYS_HASH_MAP=y
CONFIG_SYS_HASH_FUNC32=y

# Enable JSON library
CONFIG_JSON_LIBRARY=y

# Enable entropy generator
CONFIG_ENTROPY_GENERATOR=y

# DNS resolver
CONFIG_DNS_RESOLVER=y
CONFIG_DNS_SERVER_IP_ADDRESSES=y
CONFIG_DNS_SERVER1="8.8.8.8" # Google DNS

# MbedTLS
CONFIG_MBEDTLS=y
CONFIG_MBEDTLS_BUILTIN=y
CONFIG_MBEDTLS_ENABLE_HEAP=y
# 55kB is the max absolute value, could be set much lower
CONFIG_MBEDTLS_HEAP_SIZE=55000
# 16384 is the max absolute value, could be set much lower
CONFIG_MBEDTLS_SSL_MAX_CONTENT_LEN=16384
CONFIG_MBEDTLS_PEM_CERTIFICATE_FORMAT=y # Does not include writing
CONFIG_MBEDTLS_PK_WRITE_C=y # Required for PEM writing (also needs MBEDTLS_PEM_WRITE_C)
CONFIG_MBEDTLS_ENTROPY_ENABLED=y
CONFIG_MBEDTLS_ZEPHYR_ENTROPY=y
CONFIG_MBEDTLS_USER_CONFIG_ENABLE=y
CONFIG_MBEDTLS_USER_CONFIG_FILE="../samples/common/include/tls-conf.h"
CONFIG_MBEDTLS_TLS_VERSION_1_2=y
CONFIG_MBEDTLS_CIPHER=y
CONFIG_MBEDTLS_CIPHER_ALL_ENABLED=y
CONFIG_MBEDTLS_SERVER_NAME_INDICATION=y
CONFIG_MBEDTLS_KEY_EXCHANGE_ALL_ENABLED=y
CONFIG_MBEDTLS_HASH_ALL_ENABLED=y
CONFIG_MBEDTLS_CTR_DRBG_ENABLED=y
CONFIG_MBEDTLS_HMAC_DRBG_ENABLED=y
CONFIG_MBEDTLS_CHACHAPOLY_AEAD_ENABLED=y
CONFIG_MBEDTLS_ECDH_C=y
CONFIG_MBEDTLS_ECDSA_C=y
CONFIG_MBEDTLS_ECJPAKE_C=y
CONFIG_MBEDTLS_ECP_C=y
CONFIG_MBEDTLS_ECP_ALL_ENABLED=y
CONFIG_MBEDTLS_GENPRIME_ENABLED=y
CONFIG_MBEDTLS_PKCS5_C=y
CONFIG_MBEDTLS_X509_CRL_PARSE_C=y
CONFIG_MBEDTLS_X509_CSR_PARSE_C=y
CONFIG_MBEDTLS_X509_CSR_WRITE_C=y

# Enable networking
CONFIG_NETWORKING=y

# Sockets
CONFIG_NET_SOCKETS=y
CONFIG_NET_SOCKETS_POLL_MAX=4
CONFIG_NET_SOCKETS_SOCKOPT_TLS=y

# Use DHCP for IPv4 and IPv6
CONFIG_NET_DHCPV4=y
CONFIG_NET_DHCPV6=y

# Generic networking options
CONFIG_NET_TX_STACK_SIZE=2048
CONFIG_NET_RX_STACK_SIZE=2048
CONFIG_NET_PKT_RX_COUNT=10
CONFIG_NET_PKT_TX_COUNT=10
CONFIG_NET_BUF_RX_COUNT=20
CONFIG_NET_BUF_TX_COUNT=20
CONFIG_NET_MAX_CONTEXTS=10
CONFIG_NET_MGMT=y
CONFIG_NET_MGMT_EVENT=y
CONFIG_NET_IPV4=y
CONFIG_NET_IPV6=y
CONFIG_NET_TCP=y

# Enable HTTP client
CONFIG_HTTP_CLIENT=y

# MQTT options
CONFIG_MQTT_LIB=y
CONFIG_MQTT_LIB_TLS=y
CONFIG_MQTT_KEEPALIVE=60

# Enable flash
CONFIG_FLASH=y
CONFIG_FLASH_MAP=y
CONFIG_FLASH_PAGE_LAYOUT=y

# Enable NVS
CONFIG_NVS=y
CONFIG_NVS_LOG_LEVEL_WRN=y
```

## boards/esp_wrover_kit.conf
```kconfig
# (C) Copyright 2024, SECO Mind Srl
#
# SPDX-License-Identifier: Apache-2.0

# Enable wifi drivers
CONFIG_WIFI=y
CONFIG_WIFI_ESP32=y

# Added to prevent error with missing #include <ethernet/eth_stats.h> for esp_wifi_drv.c
# Adding this line will cause CMAKE Warning: No SOURCES given to Zephyr library: drivers__ethernet
# Just ignore.
CONFIG_NET_L2_ETHERNET=y

CONFIG_NET_CONFIG_SETTINGS=y

# Disable Astarte permanent storage for this board as no dedicated partition is present
CONFIG_ASTARTE_DEVICE_SDK_PERMANENT_STORAGE=n
```

## boards/mimxrt1060_evk.conf
```kconfig
# (C) Copyright 2024, SECO Mind Srl
#
# SPDX-License-Identifier: Apache-2.0

# Ethernet settings
CONFIG_NET_L2_ETHERNET=y
CONFIG_NET_L2_ETHERNET_MGMT=y
```

## boards/mimxrt1060_evkb.conf
```kconfig
# (C) Copyright 2024, SECO Mind Srl
#
# SPDX-License-Identifier: Apache-2.0

# Disable Astarte permanent storage for this board as no dedicated partition is present
CONFIG_ASTARTE_DEVICE_SDK_PERMANENT_STORAGE=n
```

## boards/native_sim.conf
```kconfig
# (C) Copyright 2024, SECO Mind Srl
#
# SPDX-License-Identifier: Apache-2.0

CONFIG_PICOLIBC_USE_MODULE=y
CONFIG_PICOLIBC=y

# Ethernet settings
CONFIG_NET_L2_ETHERNET=y
CONFIG_NET_L2_ETHERNET_MGMT=y

# Network application options and configuration
CONFIG_NET_DHCPV4=n
CONFIG_NET_DHCPV6=n
CONFIG_NET_CONFIG_SETTINGS=y
CONFIG_NET_CONFIG_NEED_IPV6=y
CONFIG_NET_CONFIG_MY_IPV6_ADDR="2001:db8::1"
CONFIG_NET_CONFIG_PEER_IPV6_ADDR="2001:db8::2"
CONFIG_NET_CONFIG_NEED_IPV4=y
CONFIG_NET_CONFIG_MY_IPV4_ADDR="192.0.2.1"
CONFIG_NET_CONFIG_PEER_IPV4_ADDR="192.0.2.2"
CONFIG_NET_CONFIG_MY_IPV4_GW="192.0.2.2"
#CONFIG_DNS_SERVER1="192.0.2.2:53"
#CONFIG_DNS_SERVER2="[2001:db8::2]:53"

# Use a large log buffer size
CONFIG_LOG_BUFFER_SIZE=32768
```

## include/eth.h
```c
/*
 * (C) Copyright 2024, SECO Mind Srl
 *
 * SPDX-License-Identifier: Apache-2.0
 */

#ifndef ETH_H
#define ETH_H

#include <stdbool.h>
#include <stddef.h>

/**
 * @brief Blocking function to connect the device to internet.
 *
 * @note This is not actually initializing the ethernet module which is intialized by default.
 *
 * @return 0 upon success, -1 otherwise.
 */
int eth_connect(void);

#endif /* ETH_H */
```

## include/tls-conf.h
```c
/*
 * (C) Copyright 2024, SECO Mind Srl
 *
 * SPDX-License-Identifier: Apache-2.0
 */

#ifndef TLS_CONF_H
#define TLS_CONF_H

/**
 * \def MBEDTLS_PEM_WRITE_C
 *
 * Enable PEM encoding / writing.
 *
 * Module:  library/pem.c
 * Caller:  library/pkwrite.c
 *          library/x509write_crt.c
 *          library/x509write_csr.c
 *
 * Requires: MBEDTLS_BASE64_C
 *
 * This modules adds support for encoding / writing PEM files.
 */
#define MBEDTLS_PEM_WRITE_C

#endif /* TLS_CONF_H */
```

## include/utils.h
```c
/*
 * (C) Copyright 2024, SECO Mind Srl
 *
 * SPDX-License-Identifier: Apache-2.0
 */

#ifndef UTILS_H
#define UTILS_H

/**
 * @file utils.h
 * @brief Contains some common utilities for the samples.
 *
 * @details This file contains a function to "pretty print" an Astarte individual and a set of
 * standard data to use when streaming datastreams or setting properties in the samples.
 * The standard data contains an element for each possible Astarte type. This allows the samples
 * to demonstrate transmission of all existing Astarte types.
 * Each data element is paired to a string representing a mapping endpoint for the interfaces to
 * be used in the samples.
 */

#include <astarte_device_sdk/individual.h>

#define UTILS_DATA_ELEMENTS 14

extern const uint8_t utils_binary_blob_data[8];
extern const uint8_t *const utils_binary_blobs_data[2];
extern const size_t utils_binary_blobs_sizes_data[2];
extern const bool utils_boolean_data;
extern const bool utils_boolean_array_data[3];
extern const int64_t utils_unix_time_data;
extern const int64_t utils_unix_time_array_data[1];
extern const double utils_double_data;
extern const double utils_double_array_data[2];
extern const int32_t utils_integer_data;
extern const int32_t utils_integer_array_data[3];
extern const int64_t utils_longinteger_data;
extern const int64_t utils_longinteger_array_data[3];
extern const char utils_string_data[];
extern const char *const utils_string_array_data[2];

/**
 * @brief Pretty print to the log output an Astarte individual.
 *
 * @param[in] individual The individual to log
 */
void utils_log_astarte_individual(astarte_individual_t individual);

#endif /* UTILS_H */
```

## src/eth.c
```c
/*
 * (C) Copyright 2024, SECO Mind Srl
 *
 * SPDX-License-Identifier: Apache-2.0
 */

#include "eth.h"

#include <zephyr/kernel.h>
#include <zephyr/net/ethernet.h>
#include <zephyr/net/ethernet_mgmt.h>

#include <zephyr/logging/log.h>
LOG_MODULE_REGISTER(eth, CONFIG_APP_LOG_LEVEL); // NOLINT

/************************************************
 *        Constants, statics and defines        *
 ***********************************************/

// NOLINTBEGIN(cppcoreguidelines-avoid-non-const-global-variables)
static struct net_mgmt_event_callback eth_cb;
static struct net_mgmt_event_callback status_cb;
static struct net_mgmt_event_callback ipv6_cb;
static struct net_mgmt_event_callback ipv4_cb;
static struct net_mgmt_event_callback l4_cb;

static K_SEM_DEFINE(ipv4_address_obtained, 0, 1);
// NOLINTEND(cppcoreguidelines-avoid-non-const-global-variables)

/************************************************
 *       Callbacks declaration/definition       *
 ***********************************************/

static void eth_mgmt_event_handler(
    struct net_mgmt_event_callback *event_cb, uint32_t mgmt_event, struct net_if *iface)
{
    (void) event_cb;
    (void) iface;

    // NOLINTBEGIN(hicpp-signed-bitwise)
    switch (mgmt_event) {
        case NET_EVENT_ETHERNET_CARRIER_ON:
            LOG_DBG("Ethernet event: NET_EVENT_ETHERNET_CARRIER_ON."); // NOLINT
            break;

        case NET_EVENT_ETHERNET_CARRIER_OFF:
            LOG_DBG("Ethernet event: NET_EVENT_ETHERNET_CARRIER_OFF."); // NOLINT
            break;

        case NET_EVENT_ETHERNET_VLAN_TAG_ENABLED:
            LOG_DBG("Ethernet event: NET_EVENT_ETHERNET_VLAN_TAG_ENABLED."); // NOLINT
            break;

        case NET_EVENT_ETHERNET_VLAN_TAG_DISABLED:
            LOG_DBG("Ethernet event: NET_EVENT_ETHERNET_VLAN_TAG_DISABLED."); // NOLINT
            break;

        default:
            LOG_DBG("Status network event: %d.", mgmt_event); // NOLINT
            break;
    }
    // NOLINTEND(hicpp-signed-bitwise)
}

static void status_mgmt_event_handler(
    struct net_mgmt_event_callback *event_cb, uint32_t mgmt_event, struct net_if *iface)
{
    (void) event_cb;
    (void) iface;

    // NOLINTBEGIN(hicpp-signed-bitwise)
    switch (mgmt_event) {
        case NET_EVENT_IF_DOWN:
            LOG_DBG("Network event: NET_EVENT_IF_DOWN."); // NOLINT
            break;

        case NET_EVENT_IF_UP:
            LOG_DBG("Network event: NET_EVENT_IF_UP."); // NOLINT
            break;

        case NET_EVENT_IF_ADMIN_DOWN:
            LOG_DBG("Network event: NET_EVENT_IF_ADMIN_DOWN."); // NOLINT
            break;

        case NET_EVENT_IF_ADMIN_UP:
            LOG_DBG("Network event: NET_EVENT_IF_ADMIN_UP."); // NOLINT
            break;

        default:
            LOG_DBG("Status network event: %d.", mgmt_event); // NOLINT
            break;
    }
    // NOLINTEND(hicpp-signed-bitwise)
}

static void ipv6_mgmt_event_handler(
    struct net_mgmt_event_callback *event_cb, uint32_t mgmt_event, struct net_if *iface)
{
    (void) event_cb;
    (void) iface;

    // NOLINTBEGIN(hicpp-signed-bitwise)
    switch (mgmt_event) {

        case NET_EVENT_IPV6_ADDR_ADD:
            LOG_DBG("IPv6 network event: NET_EVENT_IPV6_ADDR_ADD."); // NOLINT
            break;

        case NET_EVENT_IPV6_ADDR_DEL:
            LOG_DBG("IPv6 network event: NET_EVENT_IPV6_ADDR_DEL."); // NOLINT
            break;

        case NET_EVENT_IPV6_MADDR_ADD:
            LOG_DBG("IPv6 network event: NET_EVENT_IPV6_MADDR_ADD."); // NOLINT
            break;

        case NET_EVENT_IPV6_MADDR_DEL:
            LOG_DBG("IPv6 network event: NET_EVENT_IPV6_MADDR_DEL."); // NOLINT
            break;

        case NET_EVENT_IPV6_PREFIX_ADD:
            LOG_DBG("IPv6 network event: NET_EVENT_IPV6_PREFIX_ADD."); // NOLINT
            break;

        case NET_EVENT_IPV6_PREFIX_DEL:
            LOG_DBG("IPv6 network event: NET_EVENT_IPV6_PREFIX_DEL."); // NOLINT
            break;

        case NET_EVENT_IPV6_MCAST_JOIN:
            LOG_DBG("IPv6 network event: NET_EVENT_IPV6_MCAST_JOIN."); // NOLINT
            break;

        case NET_EVENT_IPV6_MCAST_LEAVE:
            LOG_DBG("IPv6 network event: NET_EVENT_IPV6_MCAST_LEAVE."); // NOLINT
            break;

        case NET_EVENT_IPV6_ROUTER_ADD:
            LOG_DBG("IPv6 network event: NET_EVENT_IPV6_ROUTER_ADD."); // NOLINT
            break;

        case NET_EVENT_IPV6_ROUTER_DEL:
            LOG_DBG("IPv6 network event: NET_EVENT_IPV6_ROUTER_DEL."); // NOLINT
            break;

        case NET_EVENT_IPV6_ROUTE_ADD:
            LOG_DBG("IPv6 network event: NET_EVENT_IPV6_ROUTE_ADD."); // NOLINT
            break;

        case NET_EVENT_IPV6_ROUTE_DEL:
            LOG_DBG("IPv6 network event: NET_EVENT_IPV6_ROUTE_DEL."); // NOLINT
            break;

        case NET_EVENT_IPV6_DAD_SUCCEED:
            LOG_DBG("IPv6 network event: NET_EVENT_IPV6_DAD_SUCCEED."); // NOLINT
            break;

        case NET_EVENT_IPV6_DAD_FAILED:
            LOG_DBG("IPv6 network event: NET_EVENT_IPV6_DAD_FAILED."); // NOLINT
            break;

        case NET_EVENT_IPV6_NBR_ADD:
            LOG_DBG("IPv6 network event: NET_EVENT_IPV6_NBR_ADD."); // NOLINT
            break;

        case NET_EVENT_IPV6_NBR_DEL:
            LOG_DBG("IPv6 network event: NET_EVENT_IPV6_NBR_DEL."); // NOLINT
            break;

        case NET_EVENT_IPV6_DHCP_START:
            LOG_DBG("IPv6 network event: NET_EVENT_IPV6_DHCP_START."); // NOLINT
            break;

        case NET_EVENT_IPV6_DHCP_BOUND:
            LOG_DBG("IPv6 network event: NET_EVENT_IPV6_DHCP_BOUND."); // NOLINT
            break;

        case NET_EVENT_IPV6_DHCP_STOP:
            LOG_DBG("IPv6 network event: NET_EVENT_IPV6_DHCP_STOP."); // NOLINT
            break;

        default:
            LOG_DBG("IPv6 network event: %d.", mgmt_event); // NOLINT
            break;
    }
    // NOLINTEND(hicpp-signed-bitwise)
}

static void ipv4_mgmt_event_handler(
    struct net_mgmt_event_callback *event_cb, uint32_t mgmt_event, struct net_if *iface)
{
    (void) event_cb;
    (void) iface;

    // NOLINTBEGIN(hicpp-signed-bitwise)
    switch (mgmt_event) {

        case NET_EVENT_IPV4_ADDR_ADD:
            LOG_DBG("Network event: NET_EVENT_IPV4_ADDR_ADD."); // NOLINT
            k_sem_give(&ipv4_address_obtained);
            break;

        case NET_EVENT_IPV4_ADDR_DEL:
            LOG_DBG("Network event: NET_EVENT_IPV4_ADDR_DEL."); // NOLINT
            k_sem_take(&ipv4_address_obtained, K_NO_WAIT);
            break;

        case NET_EVENT_IPV4_MADDR_ADD:
            LOG_DBG("Network event: NET_EVENT_IPV4_MADDR_ADD."); // NOLINT
            break;

        case NET_EVENT_IPV4_MADDR_DEL:
            LOG_DBG("Network event: NET_EVENT_IPV4_MADDR_DEL."); // NOLINT
            break;

        case NET_EVENT_IPV4_ROUTER_ADD:
            LOG_DBG("Network event: NET_EVENT_IPV4_ROUTER_ADD."); // NOLINT
            break;

        case NET_EVENT_IPV4_ROUTER_DEL:
            LOG_DBG("Network event: NET_EVENT_IPV4_ROUTER_DEL."); // NOLINT
            break;

        case NET_EVENT_IPV4_DHCP_START:
            LOG_DBG("Network event: NET_EVENT_IPV4_DHCP_START."); // NOLINT
            break;

        case NET_EVENT_IPV4_DHCP_BOUND:
            LOG_DBG("Network event: NET_EVENT_IPV4_DHCP_BOUND."); // NOLINT
            break;

        case NET_EVENT_IPV4_DHCP_STOP:
            LOG_DBG("Network event: NET_EVENT_IPV4_DHCP_STOP."); // NOLINT
            break;

        case NET_EVENT_IPV4_MCAST_JOIN:
            LOG_DBG("Network event: NET_EVENT_IPV4_MCAST_JOIN."); // NOLINT
            break;

        case NET_EVENT_IPV4_MCAST_LEAVE:
            LOG_DBG("Network event: NET_EVENT_IPV4_MCAST_LEAVE."); // NOLINT
            break;

        default:
            LOG_DBG("Network event: %d.", mgmt_event); // NOLINT
            break;
    }
    // NOLINTEND(hicpp-signed-bitwise)
}

static void l4_mgmt_event_handler(
    struct net_mgmt_event_callback *event_cb, uint32_t mgmt_event, struct net_if *iface)
{
    (void) event_cb;
    (void) iface;

    // NOLINTBEGIN(hicpp-signed-bitwise)
    switch (mgmt_event) {

        case NET_EVENT_L4_CONNECTED:
            LOG_DBG("Network event: NET_EVENT_L4_CONNECTED."); // NOLINT
            break;

        case NET_EVENT_L4_DISCONNECTED:
            LOG_DBG("Network event: NET_EVENT_L4_DISCONNECTED."); // NOLINT
            break;

        case NET_EVENT_DNS_SERVER_ADD:
            LOG_DBG("Network event: NET_EVENT_DNS_SERVER_ADD."); // NOLINT
            break;

        case NET_EVENT_DNS_SERVER_DEL:
            LOG_DBG("Network event: NET_EVENT_DNS_SERVER_DEL."); // NOLINT
            break;

        case NET_EVENT_HOSTNAME_CHANGED:
            LOG_DBG("Network event: NET_EVENT_HOSTNAME_CHANGED."); // NOLINT
            break;

        default:
            LOG_DBG("Network event: %d.", mgmt_event); // NOLINT
            break;
    }
    // NOLINTEND(hicpp-signed-bitwise)
}

/************************************************
 * Global functions definition
 ***********************************************/

int eth_connect(void)
{
    LOG_INF("Connecting through ethernet..."); // NOLINT

    // NOLINTBEGIN(hicpp-signed-bitwise, misc-redundant-expression)
    net_mgmt_init_event_callback(&eth_cb, eth_mgmt_event_handler,
        NET_EVENT_ETHERNET_CARRIER_ON | NET_EVENT_ETHERNET_CARRIER_OFF
            | NET_EVENT_ETHERNET_VLAN_TAG_ENABLED | NET_EVENT_ETHERNET_VLAN_TAG_DISABLED);
    net_mgmt_init_event_callback(&status_cb, status_mgmt_event_handler,
        NET_EVENT_IF_DOWN | NET_EVENT_IF_UP | NET_EVENT_IF_ADMIN_DOWN | NET_EVENT_IF_ADMIN_UP);
    net_mgmt_init_event_callback(&ipv6_cb, ipv6_mgmt_event_handler,
        NET_EVENT_IPV6_ADDR_ADD | NET_EVENT_IPV6_ADDR_DEL | NET_EVENT_IPV6_MADDR_ADD
            | NET_EVENT_IPV6_MADDR_DEL | NET_EVENT_IPV6_PREFIX_ADD | NET_EVENT_IPV6_PREFIX_DEL
            | NET_EVENT_IPV6_MCAST_JOIN | NET_EVENT_IPV6_MCAST_LEAVE | NET_EVENT_IPV6_ROUTER_ADD
            | NET_EVENT_IPV6_ROUTER_DEL | NET_EVENT_IPV6_ROUTE_ADD | NET_EVENT_IPV6_ROUTE_DEL
            | NET_EVENT_IPV6_DAD_SUCCEED | NET_EVENT_IPV6_DAD_FAILED | NET_EVENT_IPV6_NBR_ADD
            | NET_EVENT_IPV6_NBR_DEL | NET_EVENT_IPV6_DHCP_START | NET_EVENT_IPV6_DHCP_BOUND
            | NET_EVENT_IPV6_DHCP_STOP);
    net_mgmt_init_event_callback(&ipv4_cb, ipv4_mgmt_event_handler,
        NET_EVENT_IPV4_ADDR_ADD | NET_EVENT_IPV4_ADDR_DEL | NET_EVENT_IPV4_MADDR_ADD
            | NET_EVENT_IPV4_MADDR_DEL | NET_EVENT_IPV4_ROUTER_ADD | NET_EVENT_IPV4_ROUTER_DEL
            | NET_EVENT_IPV4_DHCP_START | NET_EVENT_IPV4_DHCP_BOUND | NET_EVENT_IPV4_DHCP_STOP
            | NET_EVENT_IPV4_MCAST_JOIN | NET_EVENT_IPV4_MCAST_LEAVE);
    net_mgmt_init_event_callback(&l4_cb, l4_mgmt_event_handler,
        NET_EVENT_L4_CONNECTED | NET_EVENT_L4_DISCONNECTED | NET_EVENT_DNS_SERVER_ADD
            | NET_EVENT_DNS_SERVER_DEL | NET_EVENT_HOSTNAME_CHANGED);
    // NOLINTEND(hicpp-signed-bitwise, misc-redundant-expression)

    net_mgmt_add_event_callback(&eth_cb);
    net_mgmt_add_event_callback(&status_cb);
    net_mgmt_add_event_callback(&ipv6_cb);
    net_mgmt_add_event_callback(&ipv4_cb);
    net_mgmt_add_event_callback(&l4_cb);

    struct net_if *iface = net_if_get_default();
    if (!iface) {
        LOG_ERR("Default interface non existant."); // NOLINT
        return -1;
    }

    LOG_INF("Waiting for Ethernet interface to be operational."); // NOLINT
    while (net_if_oper_state(iface) != NET_IF_OPER_UP) {
        k_sleep(K_MSEC(200));
    }

    const struct device *dev = net_if_get_device(iface);
    LOG_INF("Default network interface device name: %s.", dev->name); // NOLINT
    struct ethernet_context *eth_ctx = net_if_l2_data(iface);
    LOG_INF("Ethernet carrier: %s.", eth_ctx->is_net_carrier_up ? "UP" : "DOWN"); // NOLINT
    LOG_INF("Ethernet context is initialized: %s.", eth_ctx->is_init ? "YES" : "NO"); // NOLINT
    enum net_if_oper_state iface_oper_state = net_if_oper_state(iface);
    LOG_INF("Default network interface operational state: %d.", iface_oper_state); // NOLINT

    net_dhcpv4_start(iface);
    LOG_INF("Waiting for an IPv4 address (DHCP)."); // NOLINT
    while (k_sem_count_get(&ipv4_address_obtained) == 0) {
        k_sleep(K_MSEC(200));
    }

    k_sleep(K_MSEC(500));

    LOG_INF("Ready..."); // NOLINT

    return 0;
}

void eth_poll(void)
{
    struct net_if *iface = net_if_get_default();
    if (!iface) {
        LOG_ERR("Default interface non existant."); // NOLINT
        return;
    }

    // Check if connected
    while (net_if_oper_state(iface) != NET_IF_OPER_UP) {
        LOG_WRN("Ethernet interface is non operational."); // NOLINT
        k_sleep(K_SECONDS(1));
    }

    // Restart DHCP if required.
    if (k_sem_count_get(&ipv4_address_obtained) == 0) {
        LOG_WRN("Missing IPv4 address."); // NOLINT
        net_dhcpv4_restart(iface);
        LOG_INF("Waiting for an IPv4 address (DHCP)."); // NOLINT
        while (k_sem_count_get(&ipv4_address_obtained) == 0) {
            k_sleep(K_MSEC(200));
        }
        LOG_INF("Ready..."); // NOLINT
    }

    k_sleep(K_MSEC(500));
}
```

## src/utils.c
```c
/*
 * (C) Copyright 2024, SECO Mind Srl
 *
 * SPDX-License-Identifier: Apache-2.0
 */

#include "utils.h"

#include <stdlib.h>

#include <zephyr/logging/log.h>
#include <zephyr/sys/timeutil.h>

LOG_MODULE_REGISTER(utils, CONFIG_APP_LOG_LEVEL); // NOLINT

/************************************************
 * Constants, static variables and defines
 ***********************************************/

// Maximum size for the datetime string
#define DATETIME_MAX_STR_LEN 30

// NOLINTBEGIN(readability-magic-numbers, cppcoreguidelines-avoid-magic-numbers)
const uint8_t utils_binary_blob_data[8] = { 0x53, 0x47, 0x56, 0x73, 0x62, 0x47, 0x38, 0x3d };
static const uint8_t binblob_1[8] = { 0x53, 0x47, 0x56, 0x73, 0x62, 0x47, 0x38, 0x3d };
static const uint8_t binblob_2[5] = { 0x64, 0x32, 0x39, 0x79, 0x62 };
const uint8_t *const utils_binary_blobs_data[2] = { binblob_1, binblob_2 };
const size_t utils_binary_blobs_sizes_data[2] = { ARRAY_SIZE(binblob_1), ARRAY_SIZE(binblob_2) };
const bool utils_boolean_data = true;
const bool utils_boolean_array_data[3] = { true, false, true };
const int64_t utils_unix_time_data = 1710940988984;
const int64_t utils_unix_time_array_data[1] = { 1710940988984 };
const double utils_double_data = 15.42;
const double utils_double_array_data[2] = { 1542.25, 88852.6 };
const int32_t utils_integer_data = 42;
const int32_t utils_integer_array_data[3] = { 4525, 0, 11 };
const int64_t utils_longinteger_data = 8589934592;
const int64_t utils_longinteger_array_data[3] = { 8589930067, 42, 8589934592 };
const char utils_string_data[] = "Hello world!";
const char *const utils_string_array_data[2] = { "Hello ", "world!" };
// NOLINTEND(readability-magic-numbers, cppcoreguidelines-avoid-magic-numbers)

/************************************************
 * Global functions definition
 ***********************************************/

// NOLINTNEXTLINE(hicpp-function-size)
void utils_log_astarte_individual(astarte_individual_t individual)
{
    struct tm *tm_obj = NULL;
    char tm_str[DATETIME_MAX_STR_LEN] = { 0 };

    switch (astarte_individual_get_type(individual)) {
        case ASTARTE_MAPPING_TYPE_BINARYBLOB:
            void *blob = NULL;
            size_t blob_len = 0;
            (void) astarte_individual_to_binaryblob(individual, &blob, &blob_len);
            LOG_HEXDUMP_INF(blob, blob_len, "Astarte binaryblob:"); // NOLINT
            break;
        case ASTARTE_MAPPING_TYPE_BINARYBLOBARRAY:
            LOG_INF("Astarte binaryblobarray:"); // NOLINT
            const void **blobs = NULL;
            size_t *sizes = NULL;
            size_t count = 0;
            (void) astarte_individual_to_binaryblob_array(individual, &blobs, &sizes, &count);
            for (size_t i = 0; i < count; i++) {
                LOG_HEXDUMP_INF(blobs[i], sizes[i], ""); // NOLINT
            }
            break;
        case ASTARTE_MAPPING_TYPE_BOOLEAN:
            bool boolean = false;
            (void) astarte_individual_to_boolean(individual, &boolean);
            LOG_INF("Astarte boolean: %s", (boolean) ? "true" : "false"); // NOLINT
            break;
        case ASTARTE_MAPPING_TYPE_BOOLEANARRAY:
            LOG_INF("Astarte booleanarray:"); // NOLINT
            bool *bools = NULL;
            size_t bools_len = 0;
            (void) astarte_individual_to_boolean_array(individual, &bools, &bools_len);
            for (size_t i = 0; i < bools_len; i++) {
                LOG_INF("    %zi: %s", i, (bools[i]) ? "true" : "false"); // NOLINT
            }
            break;
        case ASTARTE_MAPPING_TYPE_DATETIME:
            int64_t datetime = false;
            (void) astarte_individual_to_datetime(individual, &datetime);
            tm_obj = gmtime(&datetime);
            (void) strftime(tm_str, DATETIME_MAX_STR_LEN, "%Y-%m-%dT%H:%M:%S%z", tm_obj);
            LOG_INF("Astarte datetime: %s", tm_str); // NOLINT
            break;
        case ASTARTE_MAPPING_TYPE_DATETIMEARRAY:
            LOG_INF("Astarte datetimearray:"); // NOLINT
            int64_t *datetimes = NULL;
            size_t datetimes_len = 0;
            (void) astarte_individual_to_datetime_array(individual, &datetimes, &datetimes_len);
            for (size_t i = 0; i < datetimes_len; i++) {
                tm_obj = gmtime(&datetimes[i]);
                (void) strftime(tm_str, DATETIME_MAX_STR_LEN, "%Y-%m-%dT%H:%M:%S%z", tm_obj);
                LOG_INF("    %zi: %s", i, tm_str); // NOLINT
            }
            break;
        case ASTARTE_MAPPING_TYPE_DOUBLE:
            double dbl = false;
            (void) astarte_individual_to_double(individual, &dbl);
            LOG_INF("Astarte double: %f", dbl); // NOLINT
            break;
        case ASTARTE_MAPPING_TYPE_DOUBLEARRAY:
            LOG_INF("Astarte doublearray:"); // NOLINT
            double *doubles = NULL;
            size_t doubles_len = 0;
            (void) astarte_individual_to_double_array(individual, &doubles, &doubles_len);
            for (size_t i = 0; i < doubles_len; i++) {
                LOG_INF("    %zi: %f", i, doubles[i]); // NOLINT
            }
            break;
        case ASTARTE_MAPPING_TYPE_INTEGER:
            int32_t integer = false;
            (void) astarte_individual_to_integer(individual, &integer);
            LOG_INF("Astarte integer: %i", integer); // NOLINT
            break;
        case ASTARTE_MAPPING_TYPE_INTEGERARRAY:
            LOG_INF("Astarte integerarray:"); // NOLINT
            int32_t *integers = NULL;
            size_t integers_len = 0;
            (void) astarte_individual_to_integer_array(individual, &integers, &integers_len);
            for (size_t i = 0; i < integers_len; i++) {
                LOG_INF("    %zi: %i", i, integers[i]); // NOLINT
            }
            break;
        case ASTARTE_MAPPING_TYPE_LONGINTEGER:
            int64_t longinteger = false;
            (void) astarte_individual_to_longinteger(individual, &longinteger);
            LOG_INF("Astarte longinteger: %lli", longinteger); // NOLINT
            break;
        case ASTARTE_MAPPING_TYPE_LONGINTEGERARRAY:
            LOG_INF("Astarte longintegerarray:"); // NOLINT
            int64_t *longintegers = NULL;
            size_t longintegers_len = 0;
            (void) astarte_individual_to_longinteger_array(
                individual, &longintegers, &longintegers_len);
            for (size_t i = 0; i < longintegers_len; i++) {
                LOG_INF("    %zi: %lli", i, longintegers[i]); // NOLINT
            }
            break;
        case ASTARTE_MAPPING_TYPE_STRING:
            const char *string = false;
            (void) astarte_individual_to_string(individual, &string);
            LOG_INF("Astarte string: %s", string); // NOLINT
            break;
        case ASTARTE_MAPPING_TYPE_STRINGARRAY:
            LOG_INF("Astarte stringarray:"); // NOLINT
            const char **strings = NULL;
            size_t strings_len = 0;
            (void) astarte_individual_to_string_array(individual, &strings, &strings_len);
            for (size_t i = 0; i < strings_len; i++) {
                LOG_INF("    %zi: %s", i, strings[i]); // NOLINT
            }
            break;
        default:
            LOG_ERR("Astarte individual has invalid tag!"); // NOLINT
            break;
    }
}
```

## src/wifi.c
```c
/*
 * (C) Copyright 2024, SECO Mind Srl
 *
 * SPDX-License-Identifier: Apache-2.0
 */

#include "wifi.h"

#include <errno.h>

#include <zephyr/kernel.h>
#include <zephyr/logging/log.h>
#include <zephyr/net/net_event.h>
#include <zephyr/net/net_if.h>
#include <zephyr/net/wifi_mgmt.h>

LOG_MODULE_REGISTER(wifi, CONFIG_APP_LOG_LEVEL); // NOLINT

/************************************************
 * Constants and defines
 ***********************************************/

static K_SEM_DEFINE(wifi_connected, 0, 1);
static K_SEM_DEFINE(ipv4_address_obtained, 0, 1);

static struct net_mgmt_event_callback wifi_cb;
static struct net_mgmt_event_callback ipv4_cb;

/************************************************
 * Static functions declaration
 ***********************************************/

static void handle_wifi_connect_result(struct net_mgmt_event_callback *cb);
static void handle_wifi_disconnect_result(struct net_mgmt_event_callback *cb);
static void handle_ipv4_result(struct net_if *iface);

static void wifi_connect(void);
static void wifi_status(void);

/************************************************
 *       Callbacks declaration/definition       *
 ***********************************************/

static void wifi_mgmt_event_handler(
    struct net_mgmt_event_callback *cb, uint32_t mgmt_event, struct net_if *iface)
{
    switch (mgmt_event) {

        case NET_EVENT_WIFI_CONNECT_RESULT:
            handle_wifi_connect_result(cb);
            break;

        case NET_EVENT_WIFI_DISCONNECT_RESULT:
            handle_wifi_disconnect_result(cb);
            break;

        case NET_EVENT_IPV4_ADDR_ADD:
            handle_ipv4_result(iface);
            break;

        default:
            LOG_DBG("Received unhandled wifi mgmt event %d", mgmt_event);
            break;
    }
}

/************************************************
 * Global functions definition
 ***********************************************/

void wifi_init(void)
{
    LOG_INF("Initializing wifi...\n\n");

    net_mgmt_init_event_callback(&wifi_cb, wifi_mgmt_event_handler,
        NET_EVENT_WIFI_CONNECT_RESULT | NET_EVENT_WIFI_DISCONNECT_RESULT);

    net_mgmt_init_event_callback(&ipv4_cb, wifi_mgmt_event_handler, NET_EVENT_IPV4_ADDR_ADD);

    net_mgmt_add_event_callback(&wifi_cb);
    net_mgmt_add_event_callback(&ipv4_cb);

    do {
        wifi_connect();
        k_sleep(K_SECONDS(1));
    } while (k_sem_count_get(&wifi_connected) == 0);
    wifi_status();
    while (k_sem_count_get(&ipv4_address_obtained) == 0) {
        k_sleep(K_SECONDS(1));
    }

    LOG_INF("Ready...\n\n");
}

void wifi_poll(void)
{
    // Attempt reconnection if disconnected
    while (k_sem_count_get(&wifi_connected) == 0) {
        wifi_connect();
        k_sleep(K_SECONDS(1));
    }
}
/************************************************
 *         Static functions definitions         *
 ***********************************************/

static void handle_wifi_connect_result(struct net_mgmt_event_callback *cb)
{
    const struct wifi_status *status = (const struct wifi_status *) cb->info;

    if (status->status) {
        LOG_ERR("Connection request failed (%d)\n", status->status);
    } else {
        LOG_INF("Connected\n");
        k_sem_give(&wifi_connected);
    }
}

static void handle_wifi_disconnect_result(struct net_mgmt_event_callback *cb)
{
    const struct wifi_status *status = (const struct wifi_status *) cb->info;

    if (status->status) {
        LOG_ERR("Disconnection request (%d)\n", status->status);
    } else {
        LOG_INF("Disconnected\n");
        k_sem_take(&wifi_connected, K_NO_WAIT);
    }
}

static void handle_ipv4_result(struct net_if *iface)
{
    int i = 0;

    for (i = 0; i < NET_IF_MAX_IPV4_ADDR; i++) {

        char buf[NET_IPV4_ADDR_LEN];

        if (iface->config.ip.ipv4->unicast[i].ipv4.addr_type != NET_ADDR_DHCP) {
            continue;
        }

        LOG_INF("IPv4 address: %s\n",
            net_addr_ntop(AF_INET, &iface->config.ip.ipv4->unicast[i].ipv4.address.in_addr, buf,
                sizeof(buf)));
        LOG_INF("Subnet: %s\n",
            net_addr_ntop(AF_INET, &iface->config.ip.ipv4->unicast[i].netmask, buf, sizeof(buf)));
        LOG_INF(
            "Router: %s\n", net_addr_ntop(AF_INET, &iface->config.ip.ipv4->gw, buf, sizeof(buf)));
    }

    k_sem_give(&ipv4_address_obtained);
}

static void wifi_connect(void)
{
    struct net_if *iface = net_if_get_default();

    struct wifi_connect_req_params wifi_params = { 0 };

    wifi_params.ssid = CONFIG_WIFI_SSID;
    wifi_params.psk = CONFIG_WIFI_PASSWORD;
    wifi_params.ssid_length = strlen(CONFIG_WIFI_SSID);
    wifi_params.psk_length = strlen(CONFIG_WIFI_PASSWORD);
    wifi_params.channel = WIFI_CHANNEL_ANY;
    wifi_params.security = WIFI_SECURITY_TYPE_PSK;
    wifi_params.band = WIFI_FREQ_BAND_2_4_GHZ;
    wifi_params.mfp = WIFI_MFP_OPTIONAL;

    LOG_INF("Connecting to SSID: %s\n", wifi_params.ssid);

    if (net_mgmt(NET_REQUEST_WIFI_CONNECT, iface, &wifi_params,
            sizeof(struct wifi_connect_req_params))) {
        LOG_INF("WiFi Connection Request Failed\n");
    }
}

static void wifi_status(void)
{
    struct net_if *iface = net_if_get_default();

    struct wifi_iface_status status = { 0 };

    if (net_mgmt(NET_REQUEST_WIFI_IFACE_STATUS, iface, &status, sizeof(struct wifi_iface_status))) {
        LOG_INF("WiFi Status Request Failed\n");
    }

    LOG_INF("\n");

    if (status.state >= WIFI_STATE_ASSOCIATED) {
        LOG_INF("SSID: %-32s\n", status.ssid);
        LOG_INF("Band: %s\n", wifi_band_txt(status.band));
        LOG_INF("Channel: %d\n", status.channel);
        LOG_INF("Security: %s\n", wifi_security_txt(status.security));
        LOG_INF("RSSI: %d\n", status.rssi);
    }
}
```

## prj.conf
```kconfig
# (C) Copyright 2024, SECO Mind Srl
#
# SPDX-License-Identifier: Apache-2.0

CONFIG_ZTEST=y
CONFIG_ZTEST_STACK_SIZE=4096
CONFIG_STDOUT_CONSOLE=y

CONFIG_HEAP_MEM_POOL_SIZE=16384

# Activate flash
CONFIG_FLASH=y
CONFIG_FLASH_MAP=y
CONFIG_FLASH_PAGE_LAYOUT=y

# Activate storage
CONFIG_ZMS=y
CONFIG_LOG=y
CONFIG_ZMS_LOG_LEVEL_DBG=y

# Enable hash functions
CONFIG_SYS_HASH_FUNC32=y
CONFIG_SYS_HASH_FUNC32_MURMUR3=y

# Use picolib
CONFIG_PICOLIBC_USE_MODULE=y
CONFIG_PICOLIBC=y

# Astarte device SDK
CONFIG_ASTARTE_DEVICE_SDK=y
CONFIG_ASTARTE_DEVICE_SDK_HOSTNAME="."
CONFIG_ASTARTE_DEVICE_SDK_HTTPS_CA_CERT_TAG=1
CONFIG_ASTARTE_DEVICE_SDK_MQTTS_CA_CERT_TAG=1
CONFIG_ASTARTE_DEVICE_SDK_CLIENT_CERT_TAG=2
CONFIG_ASTARTE_DEVICE_SDK_PAIRING_JWT=""
CONFIG_ASTARTE_DEVICE_SDK_REALM_NAME="."

# Base MbedTLS & heap configuration
CONFIG_MBEDTLS=y
CONFIG_MBEDTLS_BUILTIN=y
CONFIG_MBEDTLS_ENABLE_HEAP=y
CONFIG_MBEDTLS_HEAP_SIZE=55000

# Enable PSA Crypto Backend
CONFIG_PSA_CRYPTO=y
CONFIG_PSA_CRYPTO_ENABLE_ALL=y
CONFIG_MBEDTLS_PSA_CRYPTO_C=y

# TLS & X.509
CONFIG_MBEDTLS_SSL_MAX_CONTENT_LEN=8192
CONFIG_MBEDTLS_PEM_PARSE_C=y
CONFIG_MBEDTLS_PEM_WRITE_C=y
CONFIG_MBEDTLS_BASE64_C=y
CONFIG_MBEDTLS_PK_WRITE_C=y
CONFIG_MBEDTLS_SSL_PROTO_TLS1_2=y
CONFIG_MBEDTLS_SSL_SERVER_NAME_INDICATION=y
CONFIG_MBEDTLS_X509_USE_C=y
CONFIG_MBEDTLS_X509_CRT_PARSE_C=y
CONFIG_MBEDTLS_X509_CRL_PARSE_C=y
CONFIG_MBEDTLS_X509_CSR_PARSE_C=y
CONFIG_MBEDTLS_X509_CSR_WRITE_C=y
CONFIG_MBEDTLS_PKCS5_C=y
CONFIG_MBEDTLS_KEY_EXCHANGE_ECDHE_ECDSA_ENABLED=y
CONFIG_MBEDTLS_KEY_EXCHANGE_ECDHE_RSA_ENABLED=y

# Enable networking
CONFIG_NETWORKING=y

# Enable HTTP client
CONFIG_HTTP_CLIENT=y

# MQTT options
CONFIG_MQTT_LIB=y
CONFIG_MQTT_LIB_TLS=y
CONFIG_MQTT_KEEPALIVE=60

# Enable base64 encoding and decoding
CONFIG_BASE64=y

# Enable system hashmaps
CONFIG_SYS_HASH_MAP=y

# Enable JSON library
CONFIG_JSON_LIBRARY=y

# Enable entropy generator
CONFIG_ENTROPY_GENERATOR=y

# DNS resolver
CONFIG_DNS_RESOLVER=y

# Enable UUID
CONFIG_UUID=y
CONFIG_UUID_V4=y
CONFIG_UUID_V5=y
CONFIG_UUID_BASE64=y

# Enable scoped cleanup helpers
CONFIG_SCOPE_CLEANUP_HELPERS=y

# Enable events
CONFIG_EVENTS=y
```

## include/test_storage_common.h
```c
/*
 * (C) Copyright 2026, SECO Mind Srl
 *
 * SPDX-License-Identifier: Apache-2.0
 */

#ifndef TEST_STORAGE_COMMON_H
#define TEST_STORAGE_COMMON_H

#include <zephyr/ztest.h>

#include "astarte_device_sdk/data.h"
#include "astarte_device_sdk/result.h"

#include "introspection.h"
#include "storage/core.h"

struct astarte_device_sdk_storage_fixture
{
    const struct device *flash_device;
    introspection_t introspection;
    off_t flash_offset;
    uint16_t flash_sector_size;
    uint16_t flash_sector_count;
    struct k_mutex test_mutex;
    astarte_storage_data_t caching_handle;
};

/**
 * @brief Helper to compare two Astarte data variants.
 */
bool astarte_data_is_equal(astarte_data_t first, astarte_data_t second);

#endif /* TEST_STORAGE_COMMON_H */
```

## src/storage_test_core.c
```c
/*
 * (C) Copyright 2024, SECO Mind Srl
 *
 * SPDX-License-Identifier: Apache-2.0
 */

#include "test_storage_common.h"

#include "storage/introsp.h"
#include "storage/sync.h"
#include "storage/trans.h"

ZTEST_F(astarte_device_sdk_storage, test_device_astarte_storage_invalid_params)
{
    astarte_result_t ares = ASTARTE_RESULT_OK;

    // Test passing NULL to the initialization function
    ares = astarte_storage_init(NULL);
    zassert_equal(ares, ASTARTE_RESULT_INVALID_PARAM, "Init with NULL should return INVALID_PARAM");

    // Test passing NULL to other subsystem functions
    astarte_storage_transmission_indexes_t indexes = { 0 };
    ares = astarte_storage_transmission_get_indexes(NULL, &indexes);
    zassert_equal(ares, ASTARTE_RESULT_INVALID_PARAM, "Expected INVALID_PARAM for NULL handle");
}

ZTEST_F(astarte_device_sdk_storage, test_device_astarte_storage_synchronization)
{
    bool sync = false;
    astarte_result_t ares = ASTARTE_RESULT_OK;

    ares = astarte_storage_synchronization_get(&fixture->caching_handle, &sync);
    zassert_equal(ares, ASTARTE_RESULT_NOT_FOUND, "Res:%s", astarte_result_to_name(ares));
    zassert_equal(sync, false, "sync variable has been modified");

    sync = true;
    ares = astarte_storage_synchronization_get(&fixture->caching_handle, &sync);
    zassert_equal(ares, ASTARTE_RESULT_NOT_FOUND, "Res:%s", astarte_result_to_name(ares));
    zassert_equal(sync, true, "sync variable has been modified");

    sync = true;
    ares = astarte_storage_synchronization_set(&fixture->caching_handle, sync);
    zassert_equal(ares, ASTARTE_RESULT_OK, "Res:%s", astarte_result_to_name(ares));

    sync = false;
    ares = astarte_storage_synchronization_get(&fixture->caching_handle, &sync);
    zassert_equal(ares, ASTARTE_RESULT_OK, "Res:%s", astarte_result_to_name(ares));
    zassert_equal(sync, true, "Sync variable not set correctly");
}

ZTEST_F(astarte_device_sdk_storage, test_device_astarte_storage_store_introspection)
{
    astarte_result_t ares = ASTARTE_RESULT_OK;

    const char intr_1_str[] = "interface1;interface2;interface3";
    const char intr_2_str[] = "interface2;interface3";
    const char intr_3_str[] = "interface1;interface2;interface3;interface4";

    ares = astarte_storage_introspection_check(
        &fixture->caching_handle, intr_1_str, ARRAY_SIZE(intr_1_str));
    zassert_equal(ares, ASTARTE_RESULT_DEVICE_CACHING_OUTDATED_INTROSPECTION, "Res:%s",
        astarte_result_to_name(ares));

    ares = astarte_storage_introspection_store(
        &fixture->caching_handle, intr_1_str, ARRAY_SIZE(intr_1_str));
    zassert_equal(ares, ASTARTE_RESULT_OK, "Res:%s", astarte_result_to_name(ares));

    ares = astarte_storage_introspection_check(
        &fixture->caching_handle, intr_1_str, ARRAY_SIZE(intr_1_str));
    zassert_equal(ares, ASTARTE_RESULT_OK, "Res:%s", astarte_result_to_name(ares));

    ares = astarte_storage_introspection_store(
        &fixture->caching_handle, intr_2_str, ARRAY_SIZE(intr_2_str));
    zassert_equal(ares, ASTARTE_RESULT_OK, "Res:%s", astarte_result_to_name(ares));

    ares = astarte_storage_introspection_check(
        &fixture->caching_handle, intr_1_str, ARRAY_SIZE(intr_1_str));
    zassert_equal(ares, ASTARTE_RESULT_DEVICE_CACHING_OUTDATED_INTROSPECTION, "Res:%s",
        astarte_result_to_name(ares));

    ares = astarte_storage_introspection_check(
        &fixture->caching_handle, intr_2_str, ARRAY_SIZE(intr_2_str));
    zassert_equal(ares, ASTARTE_RESULT_OK, "Res:%s", astarte_result_to_name(ares));

    ares = astarte_storage_introspection_store(
        &fixture->caching_handle, intr_3_str, ARRAY_SIZE(intr_3_str));
    zassert_equal(ares, ASTARTE_RESULT_OK, "Res:%s", astarte_result_to_name(ares));

    ares = astarte_storage_introspection_check(
        &fixture->caching_handle, intr_1_str, ARRAY_SIZE(intr_1_str));
    zassert_equal(ares, ASTARTE_RESULT_DEVICE_CACHING_OUTDATED_INTROSPECTION, "Res:%s",
        astarte_result_to_name(ares));

    ares = astarte_storage_introspection_check(
        &fixture->caching_handle, intr_2_str, ARRAY_SIZE(intr_2_str));
    zassert_equal(ares, ASTARTE_RESULT_DEVICE_CACHING_OUTDATED_INTROSPECTION, "Res:%s",
        astarte_result_to_name(ares));

    ares = astarte_storage_introspection_check(
        &fixture->caching_handle, intr_3_str, ARRAY_SIZE(intr_3_str));
    zassert_equal(ares, ASTARTE_RESULT_OK, "Res:%s", astarte_result_to_name(ares));
}
```

## src/storage_test_main.c
```c
/*
 * (C) Copyright 2024, SECO Mind Srl
 *
 * SPDX-License-Identifier: Apache-2.0
 */

#include <stdlib.h>
#include <string.h>

#include <zephyr/drivers/flash.h>
#include <zephyr/storage/flash_map.h>
#include <zephyr/version.h>
#include <zephyr/ztest.h>

#if KERNEL_VERSION_NUMBER >= ZEPHYR_VERSION(4, 4, 0)
#include <zephyr/kvss/zms.h>
#else
#include <zephyr/fs/zms.h>
#endif

#include "alloc.h"
#include "generated_interfaces.h"
#include "test_storage_common.h"

static void *astarte_storage_test_setup(void)
{
    struct flash_pages_info fp_info;
    const struct device *device = PARTITION_DEVICE(astarte_partition);
    off_t offset = PARTITION_OFFSET(astarte_partition);
    zassert(device_is_ready(device), "Flash device is not ready.");
    zassert_equal(flash_get_page_info_by_offs(device, offset, &fp_info), 0, "Can't get page info.");

    struct astarte_device_sdk_storage_fixture *fixture
        = astarte_calloc(1, sizeof(struct astarte_device_sdk_storage_fixture));
    zassert_not_null(fixture, "Failed allocating test fixture");

    (void) introspection_init(&fixture->introspection);
    (void) introspection_add(
        &fixture->introspection, &org_astarteplatform_zephyr_examples_DeviceProperty);
    (void) introspection_add(
        &fixture->introspection, &org_astarteplatform_zephyr_examples_ServerProperty);
    fixture->flash_device = PARTITION_DEVICE(astarte_partition);
    fixture->flash_offset = PARTITION_OFFSET(astarte_partition);
    fixture->flash_sector_count = PARTITION_SIZE(astarte_partition) / fp_info.size;
    fixture->flash_sector_size = fp_info.size;
    k_mutex_init(&fixture->test_mutex);

    return fixture;
}

static void astarte_storage_test_before(void *f)
{
    struct astarte_device_sdk_storage_fixture *fixture
        = (struct astarte_device_sdk_storage_fixture *) f;

    k_mutex_lock(&fixture->test_mutex, K_FOREVER);

    struct zms_fs zms_fs = { 0 };
    zms_fs.flash_device = fixture->flash_device;
    zms_fs.offset = fixture->flash_offset;
    zms_fs.sector_size = fixture->flash_sector_size;
    zms_fs.sector_count = fixture->flash_sector_count;

    zassert_equal(zms_mount(&zms_fs), 0, "ZMS mounting failed.");
    zassert_equal(zms_clear(&zms_fs), 0, "ZMS clear failed.");

    astarte_result_t ares = astarte_storage_init(&fixture->caching_handle);
    zassert_equal(ares, ASTARTE_RESULT_OK, "Init failed: %s", astarte_result_to_name(ares));
}

static void astarte_storage_test_after(void *f)
{
    struct astarte_device_sdk_storage_fixture *fixture
        = (struct astarte_device_sdk_storage_fixture *) f;

    astarte_storage_destroy(&fixture->caching_handle);

    struct zms_fs zms_fs = { 0 };
    zms_fs.flash_device = fixture->flash_device;
    zms_fs.offset = fixture->flash_offset;
    zms_fs.sector_size = fixture->flash_sector_size;
    zms_fs.sector_count = fixture->flash_sector_count;

    zassert_equal(zms_mount(&zms_fs), 0, "ZMS mounting failed.");
    zassert_equal(zms_clear(&zms_fs), 0, "ZMS clear failed.");

    k_mutex_unlock(&fixture->test_mutex);
}

static void astarte_storage_test_teardown(void *f)
{
    struct astarte_device_sdk_storage_fixture *fixture
        = (struct astarte_device_sdk_storage_fixture *) f;

    astarte_free(fixture);
}

bool astarte_data_is_equal(astarte_data_t first, astarte_data_t second)
{
    if (first.tag != second.tag) {
        return false;
    }
    switch (first.tag) {
        case ASTARTE_MAPPING_TYPE_BOOLEAN:
            if (first.data.boolean != second.data.boolean) {
                return false;
            }
            break;
        case ASTARTE_MAPPING_TYPE_DATETIME:
            if (first.data.datetime != second.data.datetime) {
                return false;
            }
            break;
        case ASTARTE_MAPPING_TYPE_DOUBLE:
            if (first.data.dbl != second.data.dbl) {
                return false;
            }
            break;
        case ASTARTE_MAPPING_TYPE_INTEGER:
            if (first.data.integer != second.data.integer) {
                return false;
            }
            break;
        case ASTARTE_MAPPING_TYPE_LONGINTEGER:
            if (first.data.longinteger != second.data.longinteger) {
                return false;
            }
            break;
        case ASTARTE_MAPPING_TYPE_STRING:
            if (strcmp(first.data.string, second.data.string) != 0) {
                return false;
            }
            break;
        case ASTARTE_MAPPING_TYPE_BINARYBLOB:
        case ASTARTE_MAPPING_TYPE_BINARYBLOBARRAY:
        case ASTARTE_MAPPING_TYPE_BOOLEANARRAY:
        case ASTARTE_MAPPING_TYPE_DATETIMEARRAY:
        case ASTARTE_MAPPING_TYPE_DOUBLEARRAY:
        case ASTARTE_MAPPING_TYPE_INTEGERARRAY:
        case ASTARTE_MAPPING_TYPE_LONGINTEGERARRAY:
        case ASTARTE_MAPPING_TYPE_STRINGARRAY:
            return false; // Implement when needed
            break;
        default:
            break;
    }
    return true;
}

ZTEST_SUITE(astarte_device_sdk_storage, NULL, astarte_storage_test_setup,
    astarte_storage_test_before, astarte_storage_test_after, astarte_storage_test_teardown);
```

## src/storage_test_mqtt.c
```c
/*
 * (C) Copyright 2024, SECO Mind Srl
 *
 * SPDX-License-Identifier: Apache-2.0
 */

#include "storage/mqtt.h"
#include "test_storage_common.h"

ZTEST_F(astarte_device_sdk_storage, test_device_astarte_storage_mqtt_flow)
{
    astarte_result_t ares = ASTARTE_RESULT_OK;
    const uint16_t packet_id = 12345;

    // Create a mock MQTT message
    astarte_storage_mqtt_message_t msg_in = { .type = 3, // e.g., PUBLISH
        .qos = 2,
        .topic = "test/astarte/topic",
        .data_size = 14,
        .data = "mock_payload_1" };

    astarte_storage_mqtt_message_t msg_out = { 0 };

    // 1. Verify fetching a non-existent message returns NOT_FOUND
    ares = astarte_storage_mqtt_find_alloc(
        &fixture->caching_handle, STORAGE_MQTT_MSG_INCOMING, packet_id, &msg_out);
    zassert_equal(ares, ASTARTE_RESULT_NOT_FOUND, "Expected NOT_FOUND for empty storage");

    // 2. Insert the message
    ares = astarte_storage_mqtt_insert(
        &fixture->caching_handle, STORAGE_MQTT_MSG_INCOMING, packet_id, &msg_in);
    zassert_equal(ares, ASTARTE_RESULT_OK, "MQTT Insert failed: %s", astarte_result_to_name(ares));

    // 3. Find and allocate the stored message
    ares = astarte_storage_mqtt_find_alloc(
        &fixture->caching_handle, STORAGE_MQTT_MSG_INCOMING, packet_id, &msg_out);
    zassert_equal(ares, ASTARTE_RESULT_OK, "MQTT Find failed: %s", astarte_result_to_name(ares));

    // 4. Verify data integrity
    zassert_equal(msg_out.type, msg_in.type, "Type mismatch");
    zassert_equal(msg_out.qos, msg_in.qos, "QoS mismatch");
    zassert_equal(msg_out.data_size, msg_in.data_size, "Data size mismatch");
    zassert_mem_equal(
        msg_out.topic, msg_in.topic, strlen(msg_in.topic) + 1, "Topic string mismatch");
    zassert_mem_equal(msg_out.data, msg_in.data, msg_in.data_size, "Payload data mismatch");

    // 5. Free the dynamically allocated output message
    astarte_storage_mqtt_find_free(&msg_out);
    zassert_is_null(msg_out.topic, "Topic pointer should be NULL after free");
    zassert_is_null(msg_out.data, "Data pointer should be NULL after free");

    // 6. Delete the message
    ares = astarte_storage_mqtt_delete(
        &fixture->caching_handle, STORAGE_MQTT_MSG_INCOMING, packet_id);
    zassert_equal(ares, ASTARTE_RESULT_OK, "MQTT Delete failed: %s", astarte_result_to_name(ares));

    // 7. Verify deletion
    ares = astarte_storage_mqtt_find_alloc(
        &fixture->caching_handle, STORAGE_MQTT_MSG_INCOMING, packet_id, &msg_out);
    zassert_equal(ares, ASTARTE_RESULT_NOT_FOUND, "Message should have been deleted");
}
```

## src/storage_test_trans.c
```c
/*
 * (C) Copyright 2024, SECO Mind Srl
 *
 * SPDX-License-Identifier: Apache-2.0
 */

#include "storage/trans.h"
#include "test_storage_common.h"

ZTEST_F(astarte_device_sdk_storage, test_device_astarte_storage_trans_invalid_params)
{
    astarte_result_t ares = ASTARTE_RESULT_OK;
    astarte_storage_transmission_indexes_t indexes = { 0 };

    struct astarte_storage_transmission_msg msg_valid = { .interface_name = "org.test",
        .path = "/1",
        .payload = "data",
        .payload_len = 4,
        .qos = 1,
        .timestamp = 0 };

    // Test NULL handle
    ares = astarte_storage_transmission_push(NULL, &indexes, &msg_valid);
    zassert_equal(ares, ASTARTE_RESULT_INVALID_PARAM, "Expected INVALID_PARAM for NULL handle");

    // Test NULL indexes
    ares = astarte_storage_transmission_push(&fixture->caching_handle, NULL, &msg_valid);
    zassert_equal(ares, ASTARTE_RESULT_INVALID_PARAM, "Expected INVALID_PARAM for NULL indexes");

    // Test Invalid payload configuration (length > 0 but null pointer)
    struct astarte_storage_transmission_msg msg_inv_payload = msg_valid;
    msg_inv_payload.payload_len = 5;
    msg_inv_payload.payload = NULL;
    ares = astarte_storage_transmission_push(&fixture->caching_handle, &indexes, &msg_inv_payload);
    zassert_equal(
        ares, ASTARTE_RESULT_INVALID_PARAM, "Expected INVALID_PARAM for malformed payload");

    // Test missing interface or path
    struct astarte_storage_transmission_msg msg_no_iface = msg_valid;
    msg_no_iface.interface_name = NULL;
    ares = astarte_storage_transmission_push(&fixture->caching_handle, &indexes, &msg_no_iface);
    zassert_equal(ares, ASTARTE_RESULT_INVALID_PARAM, "Expected INVALID_PARAM for NULL interface");

    // Peek/Get with NULL parameters
    ares = astarte_storage_transmission_peek(&fixture->caching_handle, NULL, &msg_valid);
    zassert_equal(
        ares, ASTARTE_RESULT_INVALID_PARAM, "Expected INVALID_PARAM for NULL indexes on peek");

    ares = astarte_storage_transmission_get(&fixture->caching_handle, &indexes, NULL);
    zassert_equal(
        ares, ASTARTE_RESULT_INVALID_PARAM, "Expected INVALID_PARAM for NULL message on get");
}

ZTEST_F(astarte_device_sdk_storage, test_device_astarte_storage_transmission_queue)
{
    astarte_result_t ares = ASTARTE_RESULT_OK;
    astarte_storage_transmission_indexes_t indexes = { 0 };

    // Verify default indexes on empty queue
    ares = astarte_storage_transmission_get_indexes(&fixture->caching_handle, &indexes);
    zassert_equal(ares, ASTARTE_RESULT_OK, "Get indexes failed");
    zassert_equal(indexes.head, 1, "Empty queue head should default to 1");
    zassert_equal(indexes.tail, 0, "Empty queue tail should default to 0");

    // Setup a mock transmission message
    struct astarte_storage_transmission_msg msg_push
        = { .interface_name = "org.astarteplatform.test.Interface",
              .path = "/test/path/1",
              .payload = "sensor_data",
              .payload_len = 11,
              .qos = 1,
              .timestamp = 1672531199000 };

    // Push message into the queue
    ares = astarte_storage_transmission_push(&fixture->caching_handle, &indexes, &msg_push);
    zassert_equal(ares, ASTARTE_RESULT_OK, "Transmission push failed");
    zassert_equal(indexes.tail, 1, "Tail should have incremented to 1");

    // Peek at the message (reads without deleting)
    struct astarte_storage_transmission_msg msg_peek = { 0 };
    ares = astarte_storage_transmission_peek(&fixture->caching_handle, &indexes, &msg_peek);
    zassert_equal(ares, ASTARTE_RESULT_OK, "Transmission peek failed");
    zassert_equal(msg_peek.qos, msg_push.qos, "QoS mismatch on peek");
    zassert_equal(msg_peek.timestamp, msg_push.timestamp, "Timestamp mismatch on peek");
    zassert_mem_equal(msg_peek.interface_name, msg_push.interface_name,
        strlen(msg_push.interface_name) + 1, "Interface name mismatch");
    zassert_mem_equal(msg_peek.path, msg_push.path, strlen(msg_push.path) + 1, "Path mismatch");

    // Cleanup peeked message
    astarte_storage_transmission_msg_cleanup(&msg_peek);

    // Get the message (reads AND deletes from queue, incrementing head)
    struct astarte_storage_transmission_msg msg_get = { 0 };
    ares = astarte_storage_transmission_get(&fixture->caching_handle, &indexes, &msg_get);
    zassert_equal(ares, ASTARTE_RESULT_OK, "Transmission get failed");
    zassert_equal(indexes.head, 2, "Head should have incremented to 2 after get");

    // Cleanup retrieved message
    astarte_storage_transmission_msg_cleanup(&msg_get);

    // Verify the queue is now conceptually empty
    ares = astarte_storage_transmission_peek(&fixture->caching_handle, &indexes, &msg_peek);
    zassert_equal(ares, ASTARTE_RESULT_NOT_FOUND, "Queue should be empty after get");
}

ZTEST_F(astarte_device_sdk_storage, test_device_astarte_storage_transmission_discard)
{
    astarte_result_t ares = ASTARTE_RESULT_OK;
    astarte_storage_transmission_indexes_t indexes = { 0 };
    ares = astarte_storage_transmission_get_indexes(&fixture->caching_handle, &indexes);

    struct astarte_storage_transmission_msg msg_push
        = { .interface_name = "org.astarteplatform.test.Discard",
              .path = "/discard/test",
              .payload = "data",
              .payload_len = 4,
              .qos = 0,
              .timestamp = 1000 };

    // Push a message
    ares = astarte_storage_transmission_push(&fixture->caching_handle, &indexes, &msg_push);
    zassert_equal(ares, ASTARTE_RESULT_OK, "Push failed");

    uint32_t expected_head_after_discard = indexes.head + 1;

    // Discard the message directly
    ares = astarte_storage_transmission_discard(&fixture->caching_handle, &indexes);
    zassert_equal(ares, ASTARTE_RESULT_OK, "Discard failed");
    zassert_equal(indexes.head, expected_head_after_discard, "Head should increment upon discard");

    // Verify it is gone
    struct astarte_storage_transmission_msg msg_peek = { 0 };
    ares = astarte_storage_transmission_peek(&fixture->caching_handle, &indexes, &msg_peek);
    zassert_equal(ares, ASTARTE_RESULT_NOT_FOUND, "Message should not exist after discard");
}

ZTEST_F(astarte_device_sdk_storage, test_device_astarte_storage_trans_zero_payload)
{
    astarte_result_t ares = ASTARTE_RESULT_OK;
    astarte_storage_transmission_indexes_t indexes = { 0 };
    ares = astarte_storage_transmission_get_indexes(&fixture->caching_handle, &indexes);

    struct astarte_storage_transmission_msg msg_push
        = { .interface_name = "org.astarteplatform.test.Empty",
              .path = "/empty",
              .payload = NULL,
              .payload_len = 0,
              .qos = 2,
              .timestamp = 1000 };

    // Push the zero-length message
    ares = astarte_storage_transmission_push(&fixture->caching_handle, &indexes, &msg_push);
    zassert_equal(ares, ASTARTE_RESULT_OK, "Push zero-payload failed");

    // Retrieve it
    struct astarte_storage_transmission_msg msg_get = { 0 };
    ares = astarte_storage_transmission_get(&fixture->caching_handle, &indexes, &msg_get);
    zassert_equal(ares, ASTARTE_RESULT_OK, "Get zero-payload failed");

    // Verify payload configuration safely navigated `extract_payload`
    zassert_equal(msg_get.payload_len, 0, "Payload length should be exactly 0");
    zassert_is_null(msg_get.payload, "Payload pointer should be strictly NULL");
    zassert_mem_equal(msg_get.interface_name, msg_push.interface_name,
        strlen(msg_push.interface_name) + 1, "Interface mismatch");

    astarte_storage_transmission_msg_cleanup(&msg_get);
}

ZTEST_F(astarte_device_sdk_storage, test_device_astarte_storage_trans_index_wrap_around)
{
    astarte_result_t ares = ASTARTE_RESULT_OK;
    astarte_storage_transmission_indexes_t indexes = { 0 };

    // To test the complex arithmetic sequence math in `get_indexes`, we simulate
    // a queue that has wrapped around the 32-bit integer limit.
    // We manually insert entries at keys: (UINT32_MAX - 1), UINT32_MAX, 0, 1.

    uint8_t dummy_buf[1] = { 0xFF }; // A single byte payload to satisfy key_value_insert
    char key[12]; // MAX_UINT32_STR_LEN is 11, +1 for safety

    uint32_t expected_head = UINT32_MAX - 1;
    uint32_t expected_tail = 1;

    // Insert element 1: UINT32_MAX - 1
    snprintf(key, sizeof(key), "%010u", UINT32_MAX - 1);
    astarte_key_value_insert(
        &fixture->caching_handle.trans_storage, key, dummy_buf, sizeof(dummy_buf));

    // Insert element 2: UINT32_MAX
    snprintf(key, sizeof(key), "%010u", UINT32_MAX);
    astarte_key_value_insert(
        &fixture->caching_handle.trans_storage, key, dummy_buf, sizeof(dummy_buf));

    // Insert element 3: 0
    snprintf(key, sizeof(key), "%010u", 0);
    astarte_key_value_insert(
        &fixture->caching_handle.trans_storage, key, dummy_buf, sizeof(dummy_buf));

    // Insert element 4: 1
    snprintf(key, sizeof(key), "%010u", 1);
    astarte_key_value_insert(
        &fixture->caching_handle.trans_storage, key, dummy_buf, sizeof(dummy_buf));

    // Trigger the index calculation mechanism
    ares = astarte_storage_transmission_get_indexes(&fixture->caching_handle, &indexes);

    // Verify the math worked successfully
    zassert_equal(ares, ASTARTE_RESULT_OK, "Get indexes failed after wrap-around simulation");
    zassert_equal(indexes.head, expected_head, "Calculated head %u does not match expected %u",
        indexes.head, expected_head);
    zassert_equal(indexes.tail, expected_tail, "Calculated tail %u does not match expected %u",
        indexes.tail, expected_tail);
}
```

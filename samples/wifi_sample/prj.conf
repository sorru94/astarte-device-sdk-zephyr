## CMakeLists.txt
```
# SPDX-License-Identifier: Apache-2.0

cmake_minimum_required(VERSION 3.20.0)

include(${CMAKE_SOURCE_DIR}/Utils.cmake)
concat_if_exists(${CMAKE_SOURCE_DIR}/private.conf EXTRA_CONF_FILE)

find_package(Zephyr REQUIRED HINTS $ENV{ZEPHYR_BASE})
project(wifi-sample)

FILE(GLOB app_sources src/*.c)
target_sources(app PRIVATE ${app_sources})
target_include_directories(app PRIVATE include)
```

## Kconfig
```
# (C) Copyright 2024, SECO Mind Srl
#
# SPDX-License-Identifier: Apache-2.0
#
# This file is the application Kconfig entry point. All application Kconfig
# options can be defined here or included via other application Kconfig files.
# You can browse these options using the west targets menuconfig (terminal) or
# guiconfig (GUI).

menu "Zephyr"
source "Kconfig.zephyr"
endmenu

menu "Wifi sample application"

config WIFI_SSID
    string "WiFi SSID"
    default ""
	help
	  WiFi access point SSID.

config WIFI_PASSWORD
    string "WiFi password"
    default ""
    help
        WiFi access point password.

endmenu
```

## prj.conf
```kconfig
CONFIG_WIFI=y

CONFIG_MAIN_STACK_SIZE=16384

CONFIG_NETWORKING=y
CONFIG_TEST_RANDOM_GENERATOR=y

CONFIG_NET_TX_STACK_SIZE=2048
CONFIG_NET_RX_STACK_SIZE=2048

CONFIG_NET_PKT_RX_COUNT=10
CONFIG_NET_PKT_TX_COUNT=10
CONFIG_NET_BUF_RX_COUNT=20
CONFIG_NET_BUF_TX_COUNT=20
CONFIG_NET_MAX_CONTEXTS=10
CONFIG_NET_DHCPV4=y

CONFIG_NET_IPV4=y
CONFIG_NET_IPV6=n

CONFIG_NET_TCP=y

CONFIG_LOG=y
CONFIG_REQUIRES_FLOAT_PRINTF=y
```

## boards/frdm_rw612.conf
```kconfig
# (C) Copyright 2025, SECO Mind Srl
#
# SPDX-License-Identifier: Apache-2.0

CONFIG_WIFI_NXP=y
CONFIG_NXP_RW610=y
CONFIG_ETH_DRIVER=n

# Use a large log buffer size
CONFIG_LOG_BUFFER_SIZE=32768
```

## boards/mimxrt1060_evkb.conf
```kconfig
CONFIG_WIFI=y
CONFIG_NET_L2_WIFI_MGMT=y
CONFIG_NET_L2_ETHERNET=y
```

## socs/esp32_procpu.conf
```kconfig
CONFIG_WIFI=y
CONFIG_NET_L2_WIFI_MGMT=y
CONFIG_NET_L2_ETHERNET=y

CONFIG_ESP32_WIFI_STA_AUTO_DHCPV4=y
CONFIG_ESP32_WIFI_STA_RECONNECT=y
```

## boards/frdm_rw612.overlay
```dts
/*
 * (C) Copyright 2024, SECO Mind Srl
 *
 * SPDX-License-Identifier: Apache-2.0
 */

&w25q512jvfiq {
	partitions {
		astarte_partition: partition@3E00000 {
			label = "astarte";
			reg = <0x03E00000 DT_SIZE_K(128)>;
		};
	};
};

&standby {
	status = "okay";
};
```

## src/wifi.c
```c
/*
 * (C) Copyright 2024, SECO Mind Srl
 *
 * SPDX-License-Identifier: Apache-2.0
 */

#include "wifi.h"

#include <zephyr/kernel.h>
#include <zephyr/net/wifi_mgmt.h>

/************************************************
 *        Defines, constants and typedef        *
 ***********************************************/

#define WIFI_SHELL_MGMT_EVENTS (NET_EVENT_WIFI_CONNECT_RESULT | NET_EVENT_WIFI_DISCONNECT_RESULT)

static struct net_mgmt_event_callback wifi_shell_mgmt_cb;
static struct net_mgmt_event_callback ipv4_cb;

static K_SEM_DEFINE(wifi_connected, 0, 1);
static K_SEM_DEFINE(ipv4_address_obtained, 0, 1);

/************************************************
 *       Callbacks declaration/definition       *
 ***********************************************/

static void wifi_mgmt_event_handler(struct net_mgmt_event_callback *event_cb,
				    uint64_t mgmt_event, struct net_if *iface)
{
    const struct wifi_status *status = (const struct wifi_status *) event_cb->info;
	switch (mgmt_event) {
	case NET_EVENT_WIFI_CONNECT_RESULT:
        if (status->status) {
            printk("WiFi connection request failed (%d)\n", status->status);
            k_sem_take(&wifi_connected, K_NO_WAIT);
        } else {
            printk("WiFi connected\n");
            k_sem_give(&wifi_connected);
        }
		break;
	case NET_EVENT_WIFI_DISCONNECT_RESULT:
        if (status->status) {
            printk("WiFi disconnection error, status: (%d)\n", status->status);
            k_sem_take(&wifi_connected, K_NO_WAIT);
        } else {
            printk("WiFi disconnected");
            k_sem_take(&wifi_connected, K_NO_WAIT);
        }
		break;
	default:
		break;
	}
}

static void ipv4_mgmt_event_handler(
    struct net_mgmt_event_callback *event_cb, uint64_t mgmt_event, struct net_if *iface)
{
    (void) event_cb;
    (void) iface;

    switch (mgmt_event) {

        case NET_EVENT_IPV4_ADDR_ADD:
            printk("Network event: NET_EVENT_IPV4_ADDR_ADD.\n"); // NOLINT
            k_sem_give(&ipv4_address_obtained);
            break;

        case NET_EVENT_IPV4_ADDR_DEL:
            printk("Network event: NET_EVENT_IPV4_ADDR_DEL.\n"); // NOLINT
            k_sem_take(&ipv4_address_obtained, K_NO_WAIT);
            break;

        default:
            break;
    }
}


/************************************************
 *         Global functions definitions         *
 ***********************************************/

void app_wifi_init(void)
{
	net_mgmt_init_event_callback(&wifi_shell_mgmt_cb,
				     wifi_mgmt_event_handler,
				     WIFI_SHELL_MGMT_EVENTS);
    net_mgmt_init_event_callback(&ipv4_cb, ipv4_mgmt_event_handler,
        NET_EVENT_IPV4_ADDR_ADD | NET_EVENT_IPV4_ADDR_DEL);

	net_mgmt_add_event_callback(&wifi_shell_mgmt_cb);
    net_mgmt_add_event_callback(&ipv4_cb);
}

int app_wifi_connect(const char *ssid, enum wifi_security_type sec, const char *psk)
{
    printk("Connecting through wifi...\n"); // NOLINT

	struct net_if *iface = net_if_get_wifi_sta();
	struct wifi_connect_req_params cnx_params = { 0 };
	int ret;

	cnx_params.band = WIFI_FREQ_BAND_UNKNOWN;
	cnx_params.channel = WIFI_CHANNEL_ANY;
	cnx_params.security = WIFI_SECURITY_TYPE_NONE;
	cnx_params.mfp = WIFI_MFP_OPTIONAL;

	cnx_params.ssid = ssid;
	cnx_params.ssid_length = strlen(cnx_params.ssid);
	cnx_params.security = sec;
	cnx_params.psk = psk;
	cnx_params.psk_length = strlen(cnx_params.psk);

	ret = net_mgmt(NET_REQUEST_WIFI_CONNECT, iface,
		       &cnx_params, sizeof(struct wifi_connect_req_params));
	if (ret) {
		printk("Connection request failed with error: %d\n", ret);
		return -ENOEXEC;
	}

    printk("Waiting for WiFi to be connected.\n");
    while (k_sem_count_get(&wifi_connected) == 0) {
        k_sleep(K_MSEC(200));
    }

    net_dhcpv4_start(iface);

    printk("Waiting for an IPv4 address (DHCP).\n"); // NOLINT
    while (k_sem_count_get(&ipv4_address_obtained) == 0) {
        k_sleep(K_MSEC(200));
    }

    printk("WiFi ready...\n"); // NOLINT

	return 0;
}
```

## src/wifi_test.c
```c
/*
 * Copyright (c) 2016 Intel Corporation.
 *
 * SPDX-License-Identifier: Apache-2.0
 */

#include <zephyr/kernel.h>

#include "wifi.h"

int main(void)
{
	printk("Started WiFi test application.\n");

	app_wifi_init();

	k_sleep(K_SECONDS(5));

	printk("Attempting a WiFi connection.\n");
	const char *ssid = CONFIG_WIFI_SSID;
	enum wifi_security_type sec = WIFI_SECURITY_TYPE_PSK;
	const char *psk = CONFIG_WIFI_PASSWORD;
	app_wifi_connect(ssid, sec, psk);

	while (true) {
		k_sleep(K_SECONDS(5));
	}

	return 0;
}
```
